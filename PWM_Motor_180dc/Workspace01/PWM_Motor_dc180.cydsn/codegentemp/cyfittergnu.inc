/*******************************************************************************
* File Name: cyfittergnu.inc
* 
* PSoC Creator  4.4
*
* Description:
* 
* This file is automatically generated by PSoC Creator.
*
********************************************************************************
* Copyright (c) 2007-2020 Cypress Semiconductor.  All rights reserved.
* You may use this file only in accordance with the license, terms, conditions, 
* disclaimers, and limitations in the end user license agreement accompanying 
* the software package with which this file was provided.
********************************************************************************/

.ifndef INCLUDED_CYFITTERGNU_INC
.set INCLUDED_CYFITTERGNU_INC, 1
.include "cydevicegnu.inc"
.include "cydevicegnu_trm.inc"

/* Com */
.set Com__0__INTTYPE, CYREG_PICU2_INTTYPE4
.set Com__0__MASK, 0x10
.set Com__0__PC, CYREG_PRT2_PC4
.set Com__0__PORT, 2
.set Com__0__SHIFT, 4
.set Com__1__INTTYPE, CYREG_PICU2_INTTYPE3
.set Com__1__MASK, 0x08
.set Com__1__PC, CYREG_PRT2_PC3
.set Com__1__PORT, 2
.set Com__1__SHIFT, 3
.set Com__2__INTTYPE, CYREG_PICU2_INTTYPE2
.set Com__2__MASK, 0x04
.set Com__2__PC, CYREG_PRT2_PC2
.set Com__2__PORT, 2
.set Com__2__SHIFT, 2
.set Com__3__INTTYPE, CYREG_PICU2_INTTYPE1
.set Com__3__MASK, 0x02
.set Com__3__PC, CYREG_PRT2_PC1
.set Com__3__PORT, 2
.set Com__3__SHIFT, 1
.set Com__AG, CYREG_PRT2_AG
.set Com__AMUX, CYREG_PRT2_AMUX
.set Com__BIE, CYREG_PRT2_BIE
.set Com__BIT_MASK, CYREG_PRT2_BIT_MASK
.set Com__BYP, CYREG_PRT2_BYP
.set Com__CTL, CYREG_PRT2_CTL
.set Com__DM0, CYREG_PRT2_DM0
.set Com__DM1, CYREG_PRT2_DM1
.set Com__DM2, CYREG_PRT2_DM2
.set Com__DR, CYREG_PRT2_DR
.set Com__INP_DIS, CYREG_PRT2_INP_DIS
.set Com__INTTYPE_BASE, CYDEV_PICU_INTTYPE_PICU2_BASE
.set Com__LCD_COM_SEG, CYREG_PRT2_LCD_COM_SEG
.set Com__LCD_EN, CYREG_PRT2_LCD_EN
.set Com__PORT, 2
.set Com__PRT, CYREG_PRT2_PRT
.set Com__PRTDSI__CAPS_SEL, CYREG_PRT2_CAPS_SEL
.set Com__PRTDSI__DBL_SYNC_IN, CYREG_PRT2_DBL_SYNC_IN
.set Com__PRTDSI__OE_SEL0, CYREG_PRT2_OE_SEL0
.set Com__PRTDSI__OE_SEL1, CYREG_PRT2_OE_SEL1
.set Com__PRTDSI__OUT_SEL0, CYREG_PRT2_OUT_SEL0
.set Com__PRTDSI__OUT_SEL1, CYREG_PRT2_OUT_SEL1
.set Com__PRTDSI__SYNC_OUT, CYREG_PRT2_SYNC_OUT
.set Com__PS, CYREG_PRT2_PS
.set Com__SLW, CYREG_PRT2_SLW

/* Mas */
.set Mas__0__INTTYPE, CYREG_PICU3_INTTYPE0
.set Mas__0__MASK, 0x01
.set Mas__0__PC, CYREG_PRT3_PC0
.set Mas__0__PORT, 3
.set Mas__0__SHIFT, 0
.set Mas__AG, CYREG_PRT3_AG
.set Mas__AMUX, CYREG_PRT3_AMUX
.set Mas__BIE, CYREG_PRT3_BIE
.set Mas__BIT_MASK, CYREG_PRT3_BIT_MASK
.set Mas__BYP, CYREG_PRT3_BYP
.set Mas__CTL, CYREG_PRT3_CTL
.set Mas__DM0, CYREG_PRT3_DM0
.set Mas__DM1, CYREG_PRT3_DM1
.set Mas__DM2, CYREG_PRT3_DM2
.set Mas__DR, CYREG_PRT3_DR
.set Mas__INP_DIS, CYREG_PRT3_INP_DIS
.set Mas__INTTYPE_BASE, CYDEV_PICU_INTTYPE_PICU3_BASE
.set Mas__LCD_COM_SEG, CYREG_PRT3_LCD_COM_SEG
.set Mas__LCD_EN, CYREG_PRT3_LCD_EN
.set Mas__MASK, 0x01
.set Mas__PORT, 3
.set Mas__PRT, CYREG_PRT3_PRT
.set Mas__PRTDSI__CAPS_SEL, CYREG_PRT3_CAPS_SEL
.set Mas__PRTDSI__DBL_SYNC_IN, CYREG_PRT3_DBL_SYNC_IN
.set Mas__PRTDSI__OE_SEL0, CYREG_PRT3_OE_SEL0
.set Mas__PRTDSI__OE_SEL1, CYREG_PRT3_OE_SEL1
.set Mas__PRTDSI__OUT_SEL0, CYREG_PRT3_OUT_SEL0
.set Mas__PRTDSI__OUT_SEL1, CYREG_PRT3_OUT_SEL1
.set Mas__PRTDSI__SYNC_OUT, CYREG_PRT3_SYNC_OUT
.set Mas__PS, CYREG_PRT3_PS
.set Mas__SHIFT, 0
.set Mas__SLW, CYREG_PRT3_SLW

/* PWM */
.set PWM_PWMHW__CAP0, CYREG_TMR0_CAP0
.set PWM_PWMHW__CAP1, CYREG_TMR0_CAP1
.set PWM_PWMHW__CFG0, CYREG_TMR0_CFG0
.set PWM_PWMHW__CFG1, CYREG_TMR0_CFG1
.set PWM_PWMHW__CFG2, CYREG_TMR0_CFG2
.set PWM_PWMHW__CNT_CMP0, CYREG_TMR0_CNT_CMP0
.set PWM_PWMHW__CNT_CMP1, CYREG_TMR0_CNT_CMP1
.set PWM_PWMHW__PER0, CYREG_TMR0_PER0
.set PWM_PWMHW__PER1, CYREG_TMR0_PER1
.set PWM_PWMHW__PM_ACT_CFG, CYREG_PM_ACT_CFG3
.set PWM_PWMHW__PM_ACT_MSK, 0x01
.set PWM_PWMHW__PM_STBY_CFG, CYREG_PM_STBY_CFG3
.set PWM_PWMHW__PM_STBY_MSK, 0x01
.set PWM_PWMHW__RT0, CYREG_TMR0_RT0
.set PWM_PWMHW__RT1, CYREG_TMR0_RT1
.set PWM_PWMHW__SR0, CYREG_TMR0_SR0

/* Seg */
.set Seg__0__AG, CYREG_PRT2_AG
.set Seg__0__AMUX, CYREG_PRT2_AMUX
.set Seg__0__BIE, CYREG_PRT2_BIE
.set Seg__0__BIT_MASK, CYREG_PRT2_BIT_MASK
.set Seg__0__BYP, CYREG_PRT2_BYP
.set Seg__0__CTL, CYREG_PRT2_CTL
.set Seg__0__DM0, CYREG_PRT2_DM0
.set Seg__0__DM1, CYREG_PRT2_DM1
.set Seg__0__DM2, CYREG_PRT2_DM2
.set Seg__0__DR, CYREG_PRT2_DR
.set Seg__0__INP_DIS, CYREG_PRT2_INP_DIS
.set Seg__0__INTTYPE, CYREG_PICU2_INTTYPE5
.set Seg__0__LCD_COM_SEG, CYREG_PRT2_LCD_COM_SEG
.set Seg__0__LCD_EN, CYREG_PRT2_LCD_EN
.set Seg__0__MASK, 0x20
.set Seg__0__PC, CYREG_PRT2_PC5
.set Seg__0__PORT, 2
.set Seg__0__PRT, CYREG_PRT2_PRT
.set Seg__0__PRTDSI__CAPS_SEL, CYREG_PRT2_CAPS_SEL
.set Seg__0__PRTDSI__DBL_SYNC_IN, CYREG_PRT2_DBL_SYNC_IN
.set Seg__0__PRTDSI__OE_SEL0, CYREG_PRT2_OE_SEL0
.set Seg__0__PRTDSI__OE_SEL1, CYREG_PRT2_OE_SEL1
.set Seg__0__PRTDSI__OUT_SEL0, CYREG_PRT2_OUT_SEL0
.set Seg__0__PRTDSI__OUT_SEL1, CYREG_PRT2_OUT_SEL1
.set Seg__0__PRTDSI__SYNC_OUT, CYREG_PRT2_SYNC_OUT
.set Seg__0__PS, CYREG_PRT2_PS
.set Seg__0__SHIFT, 5
.set Seg__0__SLW, CYREG_PRT2_SLW
.set Seg__1__AG, CYREG_PRT2_AG
.set Seg__1__AMUX, CYREG_PRT2_AMUX
.set Seg__1__BIE, CYREG_PRT2_BIE
.set Seg__1__BIT_MASK, CYREG_PRT2_BIT_MASK
.set Seg__1__BYP, CYREG_PRT2_BYP
.set Seg__1__CTL, CYREG_PRT2_CTL
.set Seg__1__DM0, CYREG_PRT2_DM0
.set Seg__1__DM1, CYREG_PRT2_DM1
.set Seg__1__DM2, CYREG_PRT2_DM2
.set Seg__1__DR, CYREG_PRT2_DR
.set Seg__1__INP_DIS, CYREG_PRT2_INP_DIS
.set Seg__1__INTTYPE, CYREG_PICU2_INTTYPE6
.set Seg__1__LCD_COM_SEG, CYREG_PRT2_LCD_COM_SEG
.set Seg__1__LCD_EN, CYREG_PRT2_LCD_EN
.set Seg__1__MASK, 0x40
.set Seg__1__PC, CYREG_PRT2_PC6
.set Seg__1__PORT, 2
.set Seg__1__PRT, CYREG_PRT2_PRT
.set Seg__1__PRTDSI__CAPS_SEL, CYREG_PRT2_CAPS_SEL
.set Seg__1__PRTDSI__DBL_SYNC_IN, CYREG_PRT2_DBL_SYNC_IN
.set Seg__1__PRTDSI__OE_SEL0, CYREG_PRT2_OE_SEL0
.set Seg__1__PRTDSI__OE_SEL1, CYREG_PRT2_OE_SEL1
.set Seg__1__PRTDSI__OUT_SEL0, CYREG_PRT2_OUT_SEL0
.set Seg__1__PRTDSI__OUT_SEL1, CYREG_PRT2_OUT_SEL1
.set Seg__1__PRTDSI__SYNC_OUT, CYREG_PRT2_SYNC_OUT
.set Seg__1__PS, CYREG_PRT2_PS
.set Seg__1__SHIFT, 6
.set Seg__1__SLW, CYREG_PRT2_SLW
.set Seg__2__AG, CYREG_PRT2_AG
.set Seg__2__AMUX, CYREG_PRT2_AMUX
.set Seg__2__BIE, CYREG_PRT2_BIE
.set Seg__2__BIT_MASK, CYREG_PRT2_BIT_MASK
.set Seg__2__BYP, CYREG_PRT2_BYP
.set Seg__2__CTL, CYREG_PRT2_CTL
.set Seg__2__DM0, CYREG_PRT2_DM0
.set Seg__2__DM1, CYREG_PRT2_DM1
.set Seg__2__DM2, CYREG_PRT2_DM2
.set Seg__2__DR, CYREG_PRT2_DR
.set Seg__2__INP_DIS, CYREG_PRT2_INP_DIS
.set Seg__2__INTTYPE, CYREG_PICU2_INTTYPE7
.set Seg__2__LCD_COM_SEG, CYREG_PRT2_LCD_COM_SEG
.set Seg__2__LCD_EN, CYREG_PRT2_LCD_EN
.set Seg__2__MASK, 0x80
.set Seg__2__PC, CYREG_PRT2_PC7
.set Seg__2__PORT, 2
.set Seg__2__PRT, CYREG_PRT2_PRT
.set Seg__2__PRTDSI__CAPS_SEL, CYREG_PRT2_CAPS_SEL
.set Seg__2__PRTDSI__DBL_SYNC_IN, CYREG_PRT2_DBL_SYNC_IN
.set Seg__2__PRTDSI__OE_SEL0, CYREG_PRT2_OE_SEL0
.set Seg__2__PRTDSI__OE_SEL1, CYREG_PRT2_OE_SEL1
.set Seg__2__PRTDSI__OUT_SEL0, CYREG_PRT2_OUT_SEL0
.set Seg__2__PRTDSI__OUT_SEL1, CYREG_PRT2_OUT_SEL1
.set Seg__2__PRTDSI__SYNC_OUT, CYREG_PRT2_SYNC_OUT
.set Seg__2__PS, CYREG_PRT2_PS
.set Seg__2__SHIFT, 7
.set Seg__2__SLW, CYREG_PRT2_SLW
.set Seg__3__AG, CYREG_PRT1_AG
.set Seg__3__AMUX, CYREG_PRT1_AMUX
.set Seg__3__BIE, CYREG_PRT1_BIE
.set Seg__3__BIT_MASK, CYREG_PRT1_BIT_MASK
.set Seg__3__BYP, CYREG_PRT1_BYP
.set Seg__3__CTL, CYREG_PRT1_CTL
.set Seg__3__DM0, CYREG_PRT1_DM0
.set Seg__3__DM1, CYREG_PRT1_DM1
.set Seg__3__DM2, CYREG_PRT1_DM2
.set Seg__3__DR, CYREG_PRT1_DR
.set Seg__3__INP_DIS, CYREG_PRT1_INP_DIS
.set Seg__3__INTTYPE, CYREG_PICU1_INTTYPE2
.set Seg__3__LCD_COM_SEG, CYREG_PRT1_LCD_COM_SEG
.set Seg__3__LCD_EN, CYREG_PRT1_LCD_EN
.set Seg__3__MASK, 0x04
.set Seg__3__PC, CYREG_PRT1_PC2
.set Seg__3__PORT, 1
.set Seg__3__PRT, CYREG_PRT1_PRT
.set Seg__3__PRTDSI__CAPS_SEL, CYREG_PRT1_CAPS_SEL
.set Seg__3__PRTDSI__DBL_SYNC_IN, CYREG_PRT1_DBL_SYNC_IN
.set Seg__3__PRTDSI__OE_SEL0, CYREG_PRT1_OE_SEL0
.set Seg__3__PRTDSI__OE_SEL1, CYREG_PRT1_OE_SEL1
.set Seg__3__PRTDSI__OUT_SEL0, CYREG_PRT1_OUT_SEL0
.set Seg__3__PRTDSI__OUT_SEL1, CYREG_PRT1_OUT_SEL1
.set Seg__3__PRTDSI__SYNC_OUT, CYREG_PRT1_SYNC_OUT
.set Seg__3__PS, CYREG_PRT1_PS
.set Seg__3__SHIFT, 2
.set Seg__3__SLW, CYREG_PRT1_SLW
.set Seg__4__AG, CYREG_PRT1_AG
.set Seg__4__AMUX, CYREG_PRT1_AMUX
.set Seg__4__BIE, CYREG_PRT1_BIE
.set Seg__4__BIT_MASK, CYREG_PRT1_BIT_MASK
.set Seg__4__BYP, CYREG_PRT1_BYP
.set Seg__4__CTL, CYREG_PRT1_CTL
.set Seg__4__DM0, CYREG_PRT1_DM0
.set Seg__4__DM1, CYREG_PRT1_DM1
.set Seg__4__DM2, CYREG_PRT1_DM2
.set Seg__4__DR, CYREG_PRT1_DR
.set Seg__4__INP_DIS, CYREG_PRT1_INP_DIS
.set Seg__4__INTTYPE, CYREG_PICU1_INTTYPE4
.set Seg__4__LCD_COM_SEG, CYREG_PRT1_LCD_COM_SEG
.set Seg__4__LCD_EN, CYREG_PRT1_LCD_EN
.set Seg__4__MASK, 0x10
.set Seg__4__PC, CYREG_PRT1_PC4
.set Seg__4__PORT, 1
.set Seg__4__PRT, CYREG_PRT1_PRT
.set Seg__4__PRTDSI__CAPS_SEL, CYREG_PRT1_CAPS_SEL
.set Seg__4__PRTDSI__DBL_SYNC_IN, CYREG_PRT1_DBL_SYNC_IN
.set Seg__4__PRTDSI__OE_SEL0, CYREG_PRT1_OE_SEL0
.set Seg__4__PRTDSI__OE_SEL1, CYREG_PRT1_OE_SEL1
.set Seg__4__PRTDSI__OUT_SEL0, CYREG_PRT1_OUT_SEL0
.set Seg__4__PRTDSI__OUT_SEL1, CYREG_PRT1_OUT_SEL1
.set Seg__4__PRTDSI__SYNC_OUT, CYREG_PRT1_SYNC_OUT
.set Seg__4__PS, CYREG_PRT1_PS
.set Seg__4__SHIFT, 4
.set Seg__4__SLW, CYREG_PRT1_SLW
.set Seg__5__AG, CYREG_PRT1_AG
.set Seg__5__AMUX, CYREG_PRT1_AMUX
.set Seg__5__BIE, CYREG_PRT1_BIE
.set Seg__5__BIT_MASK, CYREG_PRT1_BIT_MASK
.set Seg__5__BYP, CYREG_PRT1_BYP
.set Seg__5__CTL, CYREG_PRT1_CTL
.set Seg__5__DM0, CYREG_PRT1_DM0
.set Seg__5__DM1, CYREG_PRT1_DM1
.set Seg__5__DM2, CYREG_PRT1_DM2
.set Seg__5__DR, CYREG_PRT1_DR
.set Seg__5__INP_DIS, CYREG_PRT1_INP_DIS
.set Seg__5__INTTYPE, CYREG_PICU1_INTTYPE5
.set Seg__5__LCD_COM_SEG, CYREG_PRT1_LCD_COM_SEG
.set Seg__5__LCD_EN, CYREG_PRT1_LCD_EN
.set Seg__5__MASK, 0x20
.set Seg__5__PC, CYREG_PRT1_PC5
.set Seg__5__PORT, 1
.set Seg__5__PRT, CYREG_PRT1_PRT
.set Seg__5__PRTDSI__CAPS_SEL, CYREG_PRT1_CAPS_SEL
.set Seg__5__PRTDSI__DBL_SYNC_IN, CYREG_PRT1_DBL_SYNC_IN
.set Seg__5__PRTDSI__OE_SEL0, CYREG_PRT1_OE_SEL0
.set Seg__5__PRTDSI__OE_SEL1, CYREG_PRT1_OE_SEL1
.set Seg__5__PRTDSI__OUT_SEL0, CYREG_PRT1_OUT_SEL0
.set Seg__5__PRTDSI__OUT_SEL1, CYREG_PRT1_OUT_SEL1
.set Seg__5__PRTDSI__SYNC_OUT, CYREG_PRT1_SYNC_OUT
.set Seg__5__PS, CYREG_PRT1_PS
.set Seg__5__SHIFT, 5
.set Seg__5__SLW, CYREG_PRT1_SLW
.set Seg__6__AG, CYREG_PRT1_AG
.set Seg__6__AMUX, CYREG_PRT1_AMUX
.set Seg__6__BIE, CYREG_PRT1_BIE
.set Seg__6__BIT_MASK, CYREG_PRT1_BIT_MASK
.set Seg__6__BYP, CYREG_PRT1_BYP
.set Seg__6__CTL, CYREG_PRT1_CTL
.set Seg__6__DM0, CYREG_PRT1_DM0
.set Seg__6__DM1, CYREG_PRT1_DM1
.set Seg__6__DM2, CYREG_PRT1_DM2
.set Seg__6__DR, CYREG_PRT1_DR
.set Seg__6__INP_DIS, CYREG_PRT1_INP_DIS
.set Seg__6__INTTYPE, CYREG_PICU1_INTTYPE6
.set Seg__6__LCD_COM_SEG, CYREG_PRT1_LCD_COM_SEG
.set Seg__6__LCD_EN, CYREG_PRT1_LCD_EN
.set Seg__6__MASK, 0x40
.set Seg__6__PC, CYREG_PRT1_PC6
.set Seg__6__PORT, 1
.set Seg__6__PRT, CYREG_PRT1_PRT
.set Seg__6__PRTDSI__CAPS_SEL, CYREG_PRT1_CAPS_SEL
.set Seg__6__PRTDSI__DBL_SYNC_IN, CYREG_PRT1_DBL_SYNC_IN
.set Seg__6__PRTDSI__OE_SEL0, CYREG_PRT1_OE_SEL0
.set Seg__6__PRTDSI__OE_SEL1, CYREG_PRT1_OE_SEL1
.set Seg__6__PRTDSI__OUT_SEL0, CYREG_PRT1_OUT_SEL0
.set Seg__6__PRTDSI__OUT_SEL1, CYREG_PRT1_OUT_SEL1
.set Seg__6__PRTDSI__SYNC_OUT, CYREG_PRT1_SYNC_OUT
.set Seg__6__PS, CYREG_PRT1_PS
.set Seg__6__SHIFT, 6
.set Seg__6__SLW, CYREG_PRT1_SLW
.set Seg__7__AG, CYREG_PRT1_AG
.set Seg__7__AMUX, CYREG_PRT1_AMUX
.set Seg__7__BIE, CYREG_PRT1_BIE
.set Seg__7__BIT_MASK, CYREG_PRT1_BIT_MASK
.set Seg__7__BYP, CYREG_PRT1_BYP
.set Seg__7__CTL, CYREG_PRT1_CTL
.set Seg__7__DM0, CYREG_PRT1_DM0
.set Seg__7__DM1, CYREG_PRT1_DM1
.set Seg__7__DM2, CYREG_PRT1_DM2
.set Seg__7__DR, CYREG_PRT1_DR
.set Seg__7__INP_DIS, CYREG_PRT1_INP_DIS
.set Seg__7__INTTYPE, CYREG_PICU1_INTTYPE7
.set Seg__7__LCD_COM_SEG, CYREG_PRT1_LCD_COM_SEG
.set Seg__7__LCD_EN, CYREG_PRT1_LCD_EN
.set Seg__7__MASK, 0x80
.set Seg__7__PC, CYREG_PRT1_PC7
.set Seg__7__PORT, 1
.set Seg__7__PRT, CYREG_PRT1_PRT
.set Seg__7__PRTDSI__CAPS_SEL, CYREG_PRT1_CAPS_SEL
.set Seg__7__PRTDSI__DBL_SYNC_IN, CYREG_PRT1_DBL_SYNC_IN
.set Seg__7__PRTDSI__OE_SEL0, CYREG_PRT1_OE_SEL0
.set Seg__7__PRTDSI__OE_SEL1, CYREG_PRT1_OE_SEL1
.set Seg__7__PRTDSI__OUT_SEL0, CYREG_PRT1_OUT_SEL0
.set Seg__7__PRTDSI__OUT_SEL1, CYREG_PRT1_OUT_SEL1
.set Seg__7__PRTDSI__SYNC_OUT, CYREG_PRT1_SYNC_OUT
.set Seg__7__PS, CYREG_PRT1_PS
.set Seg__7__SHIFT, 7
.set Seg__7__SLW, CYREG_PRT1_SLW

/* Menos */
.set Menos__0__INTTYPE, CYREG_PICU3_INTTYPE1
.set Menos__0__MASK, 0x02
.set Menos__0__PC, CYREG_PRT3_PC1
.set Menos__0__PORT, 3
.set Menos__0__SHIFT, 1
.set Menos__AG, CYREG_PRT3_AG
.set Menos__AMUX, CYREG_PRT3_AMUX
.set Menos__BIE, CYREG_PRT3_BIE
.set Menos__BIT_MASK, CYREG_PRT3_BIT_MASK
.set Menos__BYP, CYREG_PRT3_BYP
.set Menos__CTL, CYREG_PRT3_CTL
.set Menos__DM0, CYREG_PRT3_DM0
.set Menos__DM1, CYREG_PRT3_DM1
.set Menos__DM2, CYREG_PRT3_DM2
.set Menos__DR, CYREG_PRT3_DR
.set Menos__INP_DIS, CYREG_PRT3_INP_DIS
.set Menos__INTTYPE_BASE, CYDEV_PICU_INTTYPE_PICU3_BASE
.set Menos__LCD_COM_SEG, CYREG_PRT3_LCD_COM_SEG
.set Menos__LCD_EN, CYREG_PRT3_LCD_EN
.set Menos__MASK, 0x02
.set Menos__PORT, 3
.set Menos__PRT, CYREG_PRT3_PRT
.set Menos__PRTDSI__CAPS_SEL, CYREG_PRT3_CAPS_SEL
.set Menos__PRTDSI__DBL_SYNC_IN, CYREG_PRT3_DBL_SYNC_IN
.set Menos__PRTDSI__OE_SEL0, CYREG_PRT3_OE_SEL0
.set Menos__PRTDSI__OE_SEL1, CYREG_PRT3_OE_SEL1
.set Menos__PRTDSI__OUT_SEL0, CYREG_PRT3_OUT_SEL0
.set Menos__PRTDSI__OUT_SEL1, CYREG_PRT3_OUT_SEL1
.set Menos__PRTDSI__SYNC_OUT, CYREG_PRT3_SYNC_OUT
.set Menos__PS, CYREG_PRT3_PS
.set Menos__SHIFT, 1
.set Menos__SLW, CYREG_PRT3_SLW

/* Botones */
.set Botones_sts_sts_reg__0__MASK, 0x01
.set Botones_sts_sts_reg__0__POS, 0
.set Botones_sts_sts_reg__1__MASK, 0x02
.set Botones_sts_sts_reg__1__POS, 1
.set Botones_sts_sts_reg__16BIT_STATUS_AUX_CTL_REG, CYREG_B1_UDB08_09_ACTL
.set Botones_sts_sts_reg__16BIT_STATUS_REG, CYREG_B1_UDB08_09_ST
.set Botones_sts_sts_reg__MASK, 0x03
.set Botones_sts_sts_reg__MASK_REG, CYREG_B1_UDB08_MSK
.set Botones_sts_sts_reg__MASK_ST_AUX_CTL_REG, CYREG_B1_UDB08_MSK_ACTL
.set Botones_sts_sts_reg__PER_ST_AUX_CTL_REG, CYREG_B1_UDB08_MSK_ACTL
.set Botones_sts_sts_reg__STATUS_AUX_CTL_REG, CYREG_B1_UDB08_ACTL
.set Botones_sts_sts_reg__STATUS_CNT_REG, CYREG_B1_UDB08_ST_CTL
.set Botones_sts_sts_reg__STATUS_CONTROL_REG, CYREG_B1_UDB08_ST_CTL
.set Botones_sts_sts_reg__STATUS_REG, CYREG_B1_UDB08_ST

/* Clock_1 */
.set Clock_1__CFG0, CYREG_CLKDIST_DCFG1_CFG0
.set Clock_1__CFG1, CYREG_CLKDIST_DCFG1_CFG1
.set Clock_1__CFG2, CYREG_CLKDIST_DCFG1_CFG2
.set Clock_1__CFG2_SRC_SEL_MASK, 0x07
.set Clock_1__INDEX, 0x01
.set Clock_1__PM_ACT_CFG, CYREG_PM_ACT_CFG2
.set Clock_1__PM_ACT_MSK, 0x02
.set Clock_1__PM_STBY_CFG, CYREG_PM_STBY_CFG2
.set Clock_1__PM_STBY_MSK, 0x02

/* LED_Drive */
.set LED_Drive_ClkInternal__CFG0, CYREG_CLKDIST_DCFG0_CFG0
.set LED_Drive_ClkInternal__CFG1, CYREG_CLKDIST_DCFG0_CFG1
.set LED_Drive_ClkInternal__CFG2, CYREG_CLKDIST_DCFG0_CFG2
.set LED_Drive_ClkInternal__CFG2_SRC_SEL_MASK, 0x07
.set LED_Drive_ClkInternal__INDEX, 0x00
.set LED_Drive_ClkInternal__PM_ACT_CFG, CYREG_PM_ACT_CFG2
.set LED_Drive_ClkInternal__PM_ACT_MSK, 0x01
.set LED_Drive_ClkInternal__PM_STBY_CFG, CYREG_PM_STBY_CFG2
.set LED_Drive_ClkInternal__PM_STBY_MSK, 0x01
.set LED_Drive_Com_Driver_Sync_ctrl_reg__0__MASK, 0x01
.set LED_Drive_Com_Driver_Sync_ctrl_reg__0__POS, 0
.set LED_Drive_Com_Driver_Sync_ctrl_reg__1__MASK, 0x02
.set LED_Drive_Com_Driver_Sync_ctrl_reg__1__POS, 1
.set LED_Drive_Com_Driver_Sync_ctrl_reg__16BIT_CONTROL_AUX_CTL_REG, CYREG_B1_UDB08_09_ACTL
.set LED_Drive_Com_Driver_Sync_ctrl_reg__16BIT_CONTROL_CONTROL_REG, CYREG_B1_UDB08_09_CTL
.set LED_Drive_Com_Driver_Sync_ctrl_reg__16BIT_CONTROL_COUNT_REG, CYREG_B1_UDB08_09_CTL
.set LED_Drive_Com_Driver_Sync_ctrl_reg__16BIT_COUNT_CONTROL_REG, CYREG_B1_UDB08_09_CTL
.set LED_Drive_Com_Driver_Sync_ctrl_reg__16BIT_COUNT_COUNT_REG, CYREG_B1_UDB08_09_CTL
.set LED_Drive_Com_Driver_Sync_ctrl_reg__16BIT_MASK_MASK_REG, CYREG_B1_UDB08_09_MSK
.set LED_Drive_Com_Driver_Sync_ctrl_reg__16BIT_MASK_PERIOD_REG, CYREG_B1_UDB08_09_MSK
.set LED_Drive_Com_Driver_Sync_ctrl_reg__16BIT_PERIOD_MASK_REG, CYREG_B1_UDB08_09_MSK
.set LED_Drive_Com_Driver_Sync_ctrl_reg__16BIT_PERIOD_PERIOD_REG, CYREG_B1_UDB08_09_MSK
.set LED_Drive_Com_Driver_Sync_ctrl_reg__2__MASK, 0x04
.set LED_Drive_Com_Driver_Sync_ctrl_reg__2__POS, 2
.set LED_Drive_Com_Driver_Sync_ctrl_reg__3__MASK, 0x08
.set LED_Drive_Com_Driver_Sync_ctrl_reg__3__POS, 3
.set LED_Drive_Com_Driver_Sync_ctrl_reg__CONTROL_AUX_CTL_REG, CYREG_B1_UDB08_ACTL
.set LED_Drive_Com_Driver_Sync_ctrl_reg__CONTROL_REG, CYREG_B1_UDB08_CTL
.set LED_Drive_Com_Driver_Sync_ctrl_reg__CONTROL_ST_REG, CYREG_B1_UDB08_ST_CTL
.set LED_Drive_Com_Driver_Sync_ctrl_reg__COUNT_REG, CYREG_B1_UDB08_CTL
.set LED_Drive_Com_Driver_Sync_ctrl_reg__COUNT_ST_REG, CYREG_B1_UDB08_ST_CTL
.set LED_Drive_Com_Driver_Sync_ctrl_reg__MASK, 0x0F
.set LED_Drive_Com_Driver_Sync_ctrl_reg__MASK_CTL_AUX_CTL_REG, CYREG_B1_UDB08_MSK_ACTL
.set LED_Drive_Com_Driver_Sync_ctrl_reg__PER_CTL_AUX_CTL_REG, CYREG_B1_UDB08_MSK_ACTL
.set LED_Drive_Com_Driver_Sync_ctrl_reg__PERIOD_REG, CYREG_B1_UDB08_MSK
.set LED_Drive_DMA_Com__DRQ_CTL, CYREG_IDMUX_DRQ_CTL0
.set LED_Drive_DMA_Com__DRQ_NUMBER, 0
.set LED_Drive_DMA_Com__NUMBEROF_TDS, 0
.set LED_Drive_DMA_Com__PRIORITY, 2
.set LED_Drive_DMA_Com__TERMIN_EN, 0
.set LED_Drive_DMA_Com__TERMIN_SEL, 0
.set LED_Drive_DMA_Com__TERMOUT0_EN, 1
.set LED_Drive_DMA_Com__TERMOUT0_SEL, 0
.set LED_Drive_DMA_Com__TERMOUT1_EN, 0
.set LED_Drive_DMA_Com__TERMOUT1_SEL, 0
.set LED_Drive_DMA_Seg__DRQ_CTL, CYREG_IDMUX_DRQ_CTL0
.set LED_Drive_DMA_Seg__DRQ_NUMBER, 1
.set LED_Drive_DMA_Seg__NUMBEROF_TDS, 0
.set LED_Drive_DMA_Seg__PRIORITY, 2
.set LED_Drive_DMA_Seg__TERMIN_EN, 0
.set LED_Drive_DMA_Seg__TERMIN_SEL, 0
.set LED_Drive_DMA_Seg__TERMOUT0_EN, 1
.set LED_Drive_DMA_Seg__TERMOUT0_SEL, 1
.set LED_Drive_DMA_Seg__TERMOUT1_EN, 0
.set LED_Drive_DMA_Seg__TERMOUT1_SEL, 0
.set LED_Drive_Seg_Driver_L_Sync_ctrl_reg__0__MASK, 0x01
.set LED_Drive_Seg_Driver_L_Sync_ctrl_reg__0__POS, 0
.set LED_Drive_Seg_Driver_L_Sync_ctrl_reg__1__MASK, 0x02
.set LED_Drive_Seg_Driver_L_Sync_ctrl_reg__1__POS, 1
.set LED_Drive_Seg_Driver_L_Sync_ctrl_reg__16BIT_CONTROL_AUX_CTL_REG, CYREG_B1_UDB09_10_ACTL
.set LED_Drive_Seg_Driver_L_Sync_ctrl_reg__16BIT_CONTROL_CONTROL_REG, CYREG_B1_UDB09_10_CTL
.set LED_Drive_Seg_Driver_L_Sync_ctrl_reg__16BIT_CONTROL_COUNT_REG, CYREG_B1_UDB09_10_CTL
.set LED_Drive_Seg_Driver_L_Sync_ctrl_reg__16BIT_COUNT_CONTROL_REG, CYREG_B1_UDB09_10_CTL
.set LED_Drive_Seg_Driver_L_Sync_ctrl_reg__16BIT_COUNT_COUNT_REG, CYREG_B1_UDB09_10_CTL
.set LED_Drive_Seg_Driver_L_Sync_ctrl_reg__16BIT_MASK_MASK_REG, CYREG_B1_UDB09_10_MSK
.set LED_Drive_Seg_Driver_L_Sync_ctrl_reg__16BIT_MASK_PERIOD_REG, CYREG_B1_UDB09_10_MSK
.set LED_Drive_Seg_Driver_L_Sync_ctrl_reg__16BIT_PERIOD_MASK_REG, CYREG_B1_UDB09_10_MSK
.set LED_Drive_Seg_Driver_L_Sync_ctrl_reg__16BIT_PERIOD_PERIOD_REG, CYREG_B1_UDB09_10_MSK
.set LED_Drive_Seg_Driver_L_Sync_ctrl_reg__2__MASK, 0x04
.set LED_Drive_Seg_Driver_L_Sync_ctrl_reg__2__POS, 2
.set LED_Drive_Seg_Driver_L_Sync_ctrl_reg__3__MASK, 0x08
.set LED_Drive_Seg_Driver_L_Sync_ctrl_reg__3__POS, 3
.set LED_Drive_Seg_Driver_L_Sync_ctrl_reg__4__MASK, 0x10
.set LED_Drive_Seg_Driver_L_Sync_ctrl_reg__4__POS, 4
.set LED_Drive_Seg_Driver_L_Sync_ctrl_reg__5__MASK, 0x20
.set LED_Drive_Seg_Driver_L_Sync_ctrl_reg__5__POS, 5
.set LED_Drive_Seg_Driver_L_Sync_ctrl_reg__6__MASK, 0x40
.set LED_Drive_Seg_Driver_L_Sync_ctrl_reg__6__POS, 6
.set LED_Drive_Seg_Driver_L_Sync_ctrl_reg__7__MASK, 0x80
.set LED_Drive_Seg_Driver_L_Sync_ctrl_reg__7__POS, 7
.set LED_Drive_Seg_Driver_L_Sync_ctrl_reg__CONTROL_AUX_CTL_REG, CYREG_B1_UDB09_ACTL
.set LED_Drive_Seg_Driver_L_Sync_ctrl_reg__CONTROL_REG, CYREG_B1_UDB09_CTL
.set LED_Drive_Seg_Driver_L_Sync_ctrl_reg__CONTROL_ST_REG, CYREG_B1_UDB09_ST_CTL
.set LED_Drive_Seg_Driver_L_Sync_ctrl_reg__COUNT_REG, CYREG_B1_UDB09_CTL
.set LED_Drive_Seg_Driver_L_Sync_ctrl_reg__COUNT_ST_REG, CYREG_B1_UDB09_ST_CTL
.set LED_Drive_Seg_Driver_L_Sync_ctrl_reg__MASK, 0xFF
.set LED_Drive_Seg_Driver_L_Sync_ctrl_reg__MASK_CTL_AUX_CTL_REG, CYREG_B1_UDB09_MSK_ACTL
.set LED_Drive_Seg_Driver_L_Sync_ctrl_reg__PER_CTL_AUX_CTL_REG, CYREG_B1_UDB09_MSK_ACTL
.set LED_Drive_Seg_Driver_L_Sync_ctrl_reg__PERIOD_REG, CYREG_B1_UDB09_MSK

/* Driver_motor */
.set Driver_motor__0__INTTYPE, CYREG_PICU0_INTTYPE7
.set Driver_motor__0__MASK, 0x80
.set Driver_motor__0__PC, CYREG_PRT0_PC7
.set Driver_motor__0__PORT, 0
.set Driver_motor__0__SHIFT, 7
.set Driver_motor__AG, CYREG_PRT0_AG
.set Driver_motor__AMUX, CYREG_PRT0_AMUX
.set Driver_motor__BIE, CYREG_PRT0_BIE
.set Driver_motor__BIT_MASK, CYREG_PRT0_BIT_MASK
.set Driver_motor__BYP, CYREG_PRT0_BYP
.set Driver_motor__CTL, CYREG_PRT0_CTL
.set Driver_motor__DM0, CYREG_PRT0_DM0
.set Driver_motor__DM1, CYREG_PRT0_DM1
.set Driver_motor__DM2, CYREG_PRT0_DM2
.set Driver_motor__DR, CYREG_PRT0_DR
.set Driver_motor__INP_DIS, CYREG_PRT0_INP_DIS
.set Driver_motor__INTTYPE_BASE, CYDEV_PICU_INTTYPE_PICU0_BASE
.set Driver_motor__LCD_COM_SEG, CYREG_PRT0_LCD_COM_SEG
.set Driver_motor__LCD_EN, CYREG_PRT0_LCD_EN
.set Driver_motor__MASK, 0x80
.set Driver_motor__PORT, 0
.set Driver_motor__PRT, CYREG_PRT0_PRT
.set Driver_motor__PRTDSI__CAPS_SEL, CYREG_PRT0_CAPS_SEL
.set Driver_motor__PRTDSI__DBL_SYNC_IN, CYREG_PRT0_DBL_SYNC_IN
.set Driver_motor__PRTDSI__OE_SEL0, CYREG_PRT0_OE_SEL0
.set Driver_motor__PRTDSI__OE_SEL1, CYREG_PRT0_OE_SEL1
.set Driver_motor__PRTDSI__OUT_SEL0, CYREG_PRT0_OUT_SEL0
.set Driver_motor__PRTDSI__OUT_SEL1, CYREG_PRT0_OUT_SEL1
.set Driver_motor__PRTDSI__SYNC_OUT, CYREG_PRT0_SYNC_OUT
.set Driver_motor__PS, CYREG_PRT0_PS
.set Driver_motor__SHIFT, 7
.set Driver_motor__SLW, CYREG_PRT0_SLW

/* Miscellaneous */
.set BCLK__BUS_CLK__HZ, 24000000
.set BCLK__BUS_CLK__KHZ, 24000
.set BCLK__BUS_CLK__MHZ, 24
.set CYDEV_CHIP_DIE_LEOPARD, 1
.set CYDEV_CHIP_DIE_PSOC4A, 26
.set CYDEV_CHIP_DIE_PSOC5LP, 2
.set CYDEV_CHIP_DIE_PSOC5TM, 3
.set CYDEV_CHIP_DIE_TMA4, 4
.set CYDEV_CHIP_DIE_UNKNOWN, 0
.set CYDEV_CHIP_FAMILY_FM0P, 5
.set CYDEV_CHIP_FAMILY_FM3, 6
.set CYDEV_CHIP_FAMILY_FM4, 7
.set CYDEV_CHIP_FAMILY_PSOC3, 1
.set CYDEV_CHIP_FAMILY_PSOC4, 2
.set CYDEV_CHIP_FAMILY_PSOC5, 3
.set CYDEV_CHIP_FAMILY_PSOC6, 4
.set CYDEV_CHIP_FAMILY_UNKNOWN, 0
.set CYDEV_CHIP_FAMILY_USED, CYDEV_CHIP_FAMILY_PSOC5
.set CYDEV_CHIP_JTAG_ID, 0x2E161069
.set CYDEV_CHIP_MEMBER_3A, 1
.set CYDEV_CHIP_MEMBER_4A, 26
.set CYDEV_CHIP_MEMBER_4AA, 25
.set CYDEV_CHIP_MEMBER_4AB, 30
.set CYDEV_CHIP_MEMBER_4AC, 14
.set CYDEV_CHIP_MEMBER_4AD, 15
.set CYDEV_CHIP_MEMBER_4AE, 16
.set CYDEV_CHIP_MEMBER_4D, 20
.set CYDEV_CHIP_MEMBER_4E, 6
.set CYDEV_CHIP_MEMBER_4F, 27
.set CYDEV_CHIP_MEMBER_4G, 4
.set CYDEV_CHIP_MEMBER_4H, 24
.set CYDEV_CHIP_MEMBER_4I, 32
.set CYDEV_CHIP_MEMBER_4J, 21
.set CYDEV_CHIP_MEMBER_4K, 22
.set CYDEV_CHIP_MEMBER_4L, 31
.set CYDEV_CHIP_MEMBER_4M, 29
.set CYDEV_CHIP_MEMBER_4N, 11
.set CYDEV_CHIP_MEMBER_4O, 8
.set CYDEV_CHIP_MEMBER_4P, 28
.set CYDEV_CHIP_MEMBER_4Q, 17
.set CYDEV_CHIP_MEMBER_4R, 9
.set CYDEV_CHIP_MEMBER_4S, 12
.set CYDEV_CHIP_MEMBER_4T, 10
.set CYDEV_CHIP_MEMBER_4U, 5
.set CYDEV_CHIP_MEMBER_4V, 23
.set CYDEV_CHIP_MEMBER_4W, 13
.set CYDEV_CHIP_MEMBER_4X, 7
.set CYDEV_CHIP_MEMBER_4Y, 18
.set CYDEV_CHIP_MEMBER_4Z, 19
.set CYDEV_CHIP_MEMBER_5A, 3
.set CYDEV_CHIP_MEMBER_5B, 2
.set CYDEV_CHIP_MEMBER_6A, 33
.set CYDEV_CHIP_MEMBER_FM3, 37
.set CYDEV_CHIP_MEMBER_FM4, 38
.set CYDEV_CHIP_MEMBER_PDL_FM0P_TYPE1, 34
.set CYDEV_CHIP_MEMBER_PDL_FM0P_TYPE2, 35
.set CYDEV_CHIP_MEMBER_PDL_FM0P_TYPE3, 36
.set CYDEV_CHIP_MEMBER_UNKNOWN, 0
.set CYDEV_CHIP_MEMBER_USED, CYDEV_CHIP_MEMBER_5B
.set CYDEV_CHIP_DIE_EXPECT, CYDEV_CHIP_MEMBER_USED
.set CYDEV_CHIP_DIE_ACTUAL, CYDEV_CHIP_DIE_EXPECT
.set CYDEV_CHIP_REV_LEOPARD_ES1, 0
.set CYDEV_CHIP_REV_LEOPARD_ES2, 1
.set CYDEV_CHIP_REV_LEOPARD_ES3, 3
.set CYDEV_CHIP_REV_LEOPARD_PRODUCTION, 3
.set CYDEV_CHIP_REV_PSOC4A_ES0, 17
.set CYDEV_CHIP_REV_PSOC4A_PRODUCTION, 17
.set CYDEV_CHIP_REV_PSOC5LP_ES0, 0
.set CYDEV_CHIP_REV_PSOC5LP_PRODUCTION, 0
.set CYDEV_CHIP_REV_PSOC5TM_ES0, 0
.set CYDEV_CHIP_REV_PSOC5TM_ES1, 1
.set CYDEV_CHIP_REV_PSOC5TM_PRODUCTION, 1
.set CYDEV_CHIP_REV_TMA4_ES, 17
.set CYDEV_CHIP_REV_TMA4_ES2, 33
.set CYDEV_CHIP_REV_TMA4_PRODUCTION, 17
.set CYDEV_CHIP_REVISION_3A_ES1, 0
.set CYDEV_CHIP_REVISION_3A_ES2, 1
.set CYDEV_CHIP_REVISION_3A_ES3, 3
.set CYDEV_CHIP_REVISION_3A_PRODUCTION, 3
.set CYDEV_CHIP_REVISION_4A_ES0, 17
.set CYDEV_CHIP_REVISION_4A_PRODUCTION, 17
.set CYDEV_CHIP_REVISION_4AA_PRODUCTION, 0
.set CYDEV_CHIP_REVISION_4AB_PRODUCTION, 0
.set CYDEV_CHIP_REVISION_4AC_PRODUCTION, 0
.set CYDEV_CHIP_REVISION_4AD_PRODUCTION, 0
.set CYDEV_CHIP_REVISION_4AE_PRODUCTION, 0
.set CYDEV_CHIP_REVISION_4D_PRODUCTION, 0
.set CYDEV_CHIP_REVISION_4E_CCG2_NO_USBPD, 0
.set CYDEV_CHIP_REVISION_4E_PRODUCTION, 0
.set CYDEV_CHIP_REVISION_4F_PRODUCTION, 0
.set CYDEV_CHIP_REVISION_4F_PRODUCTION_256DMA, 0
.set CYDEV_CHIP_REVISION_4F_PRODUCTION_256K, 0
.set CYDEV_CHIP_REVISION_4G_ES, 17
.set CYDEV_CHIP_REVISION_4G_ES2, 33
.set CYDEV_CHIP_REVISION_4G_PRODUCTION, 17
.set CYDEV_CHIP_REVISION_4H_PRODUCTION, 0
.set CYDEV_CHIP_REVISION_4I_PRODUCTION, 0
.set CYDEV_CHIP_REVISION_4J_PRODUCTION, 0
.set CYDEV_CHIP_REVISION_4K_PRODUCTION, 0
.set CYDEV_CHIP_REVISION_4L_PRODUCTION, 0
.set CYDEV_CHIP_REVISION_4M_PRODUCTION, 0
.set CYDEV_CHIP_REVISION_4N_PRODUCTION, 0
.set CYDEV_CHIP_REVISION_4O_PRODUCTION, 0
.set CYDEV_CHIP_REVISION_4P_PRODUCTION, 0
.set CYDEV_CHIP_REVISION_4Q_PRODUCTION, 0
.set CYDEV_CHIP_REVISION_4R_PRODUCTION, 0
.set CYDEV_CHIP_REVISION_4S_PRODUCTION, 0
.set CYDEV_CHIP_REVISION_4T_PRODUCTION, 0
.set CYDEV_CHIP_REVISION_4U_PRODUCTION, 0
.set CYDEV_CHIP_REVISION_4V_PRODUCTION, 0
.set CYDEV_CHIP_REVISION_4W_PRODUCTION, 0
.set CYDEV_CHIP_REVISION_4X_PRODUCTION, 0
.set CYDEV_CHIP_REVISION_4Y_PRODUCTION, 0
.set CYDEV_CHIP_REVISION_4Z_PRODUCTION, 0
.set CYDEV_CHIP_REVISION_5A_ES0, 0
.set CYDEV_CHIP_REVISION_5A_ES1, 1
.set CYDEV_CHIP_REVISION_5A_PRODUCTION, 1
.set CYDEV_CHIP_REVISION_5B_ES0, 0
.set CYDEV_CHIP_REVISION_5B_PRODUCTION, 0
.set CYDEV_CHIP_REVISION_6A_ES, 17
.set CYDEV_CHIP_REVISION_6A_NO_UDB, 33
.set CYDEV_CHIP_REVISION_6A_PRODUCTION, 33
.set CYDEV_CHIP_REVISION_FM3_PRODUCTION, 0
.set CYDEV_CHIP_REVISION_FM4_PRODUCTION, 0
.set CYDEV_CHIP_REVISION_PDL_FM0P_TYPE1_PRODUCTION, 0
.set CYDEV_CHIP_REVISION_PDL_FM0P_TYPE2_PRODUCTION, 0
.set CYDEV_CHIP_REVISION_PDL_FM0P_TYPE3_PRODUCTION, 0
.set CYDEV_CHIP_REVISION_USED, CYDEV_CHIP_REVISION_5B_PRODUCTION
.set CYDEV_CHIP_REV_EXPECT, CYDEV_CHIP_REVISION_USED
.set CYDEV_CONFIG_FASTBOOT_ENABLED, 1
.set CYDEV_CONFIG_UNUSED_IO_AllowButWarn, 0
.set CYDEV_CONFIG_UNUSED_IO, CYDEV_CONFIG_UNUSED_IO_AllowButWarn
.set CYDEV_CONFIG_UNUSED_IO_AllowWithInfo, 1
.set CYDEV_CONFIG_UNUSED_IO_Disallowed, 2
.set CYDEV_CONFIGURATION_COMPRESSED, 1
.set CYDEV_CONFIGURATION_DMA, 0
.set CYDEV_CONFIGURATION_ECC, 1
.set CYDEV_CONFIGURATION_IMOENABLED, CYDEV_CONFIG_FASTBOOT_ENABLED
.set CYDEV_CONFIGURATION_MODE_COMPRESSED, 0
.set CYDEV_CONFIGURATION_MODE, CYDEV_CONFIGURATION_MODE_COMPRESSED
.set CYDEV_CONFIGURATION_MODE_DMA, 2
.set CYDEV_CONFIGURATION_MODE_UNCOMPRESSED, 1
.set CYDEV_DEBUG_ENABLE_MASK, 0x20
.set CYDEV_DEBUG_ENABLE_REGISTER, CYREG_MLOGIC_DEBUG
.set CYDEV_DEBUGGING_DPS_Disable, 3
.set CYDEV_DEBUGGING_DPS_JTAG_4, 1
.set CYDEV_DEBUGGING_DPS_JTAG_5, 0
.set CYDEV_DEBUGGING_DPS_SWD, 2
.set CYDEV_DEBUGGING_DPS_SWD_SWV, 6
.set CYDEV_DEBUGGING_DPS, CYDEV_DEBUGGING_DPS_SWD_SWV
.set CYDEV_DEBUGGING_ENABLE, 1
.set CYDEV_DEBUGGING_XRES, 0
.set CYDEV_DMA_CHANNELS_AVAILABLE, 24
.set CYDEV_ECC_ENABLE, 0
.set CYDEV_HEAP_SIZE, 0x80
.set CYDEV_INSTRUCT_CACHE_ENABLED, 1
.set CYDEV_INTR_RISING, 0x00000000
.set CYDEV_IS_EXPORTING_CODE, 0
.set CYDEV_IS_IMPORTING_CODE, 0
.set CYDEV_PROJ_TYPE, 0
.set CYDEV_PROJ_TYPE_BOOTLOADER, 1
.set CYDEV_PROJ_TYPE_LAUNCHER, 5
.set CYDEV_PROJ_TYPE_LOADABLE, 2
.set CYDEV_PROJ_TYPE_LOADABLEANDBOOTLOADER, 4
.set CYDEV_PROJ_TYPE_MULTIAPPBOOTLOADER, 3
.set CYDEV_PROJ_TYPE_STANDARD, 0
.set CYDEV_PROTECTION_ENABLE, 0
.set CYDEV_STACK_SIZE, 0x0800
.set CYDEV_USE_BUNDLED_CMSIS, 1
.set CYDEV_VARIABLE_VDDA, 0
.set CYDEV_VDDA_MV, 5000
.set CYDEV_VDDD_MV, 5000
.set CYDEV_VDDIO0_MV, 5000
.set CYDEV_VDDIO1_MV, 5000
.set CYDEV_VDDIO2_MV, 5000
.set CYDEV_VDDIO3_MV, 5000
.set CYDEV_VIO0_MV, 5000
.set CYDEV_VIO1_MV, 5000
.set CYDEV_VIO2_MV, 5000
.set CYDEV_VIO3_MV, 5000
.set CYIPBLOCK_ARM_CM3_VERSION, 0
.set CYIPBLOCK_P3_ANAIF_VERSION, 0
.set CYIPBLOCK_P3_CAN_VERSION, 0
.set CYIPBLOCK_P3_CAPSENSE_VERSION, 0
.set CYIPBLOCK_P3_COMP_VERSION, 0
.set CYIPBLOCK_P3_DECIMATOR_VERSION, 0
.set CYIPBLOCK_P3_DFB_VERSION, 0
.set CYIPBLOCK_P3_DMA_VERSION, 0
.set CYIPBLOCK_P3_DRQ_VERSION, 0
.set CYIPBLOCK_P3_DSM_VERSION, 0
.set CYIPBLOCK_P3_EMIF_VERSION, 0
.set CYIPBLOCK_P3_I2C_VERSION, 0
.set CYIPBLOCK_P3_LCD_VERSION, 0
.set CYIPBLOCK_P3_LPF_VERSION, 0
.set CYIPBLOCK_P3_OPAMP_VERSION, 0
.set CYIPBLOCK_P3_PM_VERSION, 0
.set CYIPBLOCK_P3_SCCT_VERSION, 0
.set CYIPBLOCK_P3_TIMER_VERSION, 0
.set CYIPBLOCK_P3_USB_VERSION, 0
.set CYIPBLOCK_P3_VIDAC_VERSION, 0
.set CYIPBLOCK_P3_VREF_VERSION, 0
.set CYIPBLOCK_S8_GPIO_VERSION, 0
.set CYIPBLOCK_S8_IRQ_VERSION, 0
.set CYIPBLOCK_S8_SAR_VERSION, 0
.set CYIPBLOCK_S8_SIO_VERSION, 0
.set CYIPBLOCK_S8_UDB_VERSION, 0
.set DMA_CHANNELS_USED__MASK0, 0x00000003
.set CYDEV_BOOTLOADER_ENABLE, 0
.endif
