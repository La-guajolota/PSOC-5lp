;
; File Name: cyfitteriar.inc
; 
; PSoC Creator  4.4
;
; Description:
; 
;
;-------------------------------------------------------------------------------
; Copyright (c) 2007-2020 Cypress Semiconductor.  All rights reserved.
; You may use this file only in accordance with the license, terms, conditions, 
; disclaimers, and limitations in the end user license agreement accompanying 
; the software package with which this file was provided.
;-------------------------------------------------------------------------------

#ifndef INCLUDED_CYFITTERIAR_INC
#define INCLUDED_CYFITTERIAR_INC
    INCLUDE cydeviceiar.inc
    INCLUDE cydeviceiar_trm.inc

/* Com */
Com__0__INTTYPE EQU CYREG_PICU2_INTTYPE4
Com__0__MASK EQU 0x10
Com__0__PC EQU CYREG_PRT2_PC4
Com__0__PORT EQU 2
Com__0__SHIFT EQU 4
Com__1__INTTYPE EQU CYREG_PICU2_INTTYPE3
Com__1__MASK EQU 0x08
Com__1__PC EQU CYREG_PRT2_PC3
Com__1__PORT EQU 2
Com__1__SHIFT EQU 3
Com__2__INTTYPE EQU CYREG_PICU2_INTTYPE2
Com__2__MASK EQU 0x04
Com__2__PC EQU CYREG_PRT2_PC2
Com__2__PORT EQU 2
Com__2__SHIFT EQU 2
Com__3__INTTYPE EQU CYREG_PICU2_INTTYPE1
Com__3__MASK EQU 0x02
Com__3__PC EQU CYREG_PRT2_PC1
Com__3__PORT EQU 2
Com__3__SHIFT EQU 1
Com__AG EQU CYREG_PRT2_AG
Com__AMUX EQU CYREG_PRT2_AMUX
Com__BIE EQU CYREG_PRT2_BIE
Com__BIT_MASK EQU CYREG_PRT2_BIT_MASK
Com__BYP EQU CYREG_PRT2_BYP
Com__CTL EQU CYREG_PRT2_CTL
Com__DM0 EQU CYREG_PRT2_DM0
Com__DM1 EQU CYREG_PRT2_DM1
Com__DM2 EQU CYREG_PRT2_DM2
Com__DR EQU CYREG_PRT2_DR
Com__INP_DIS EQU CYREG_PRT2_INP_DIS
Com__INTTYPE_BASE EQU CYDEV_PICU_INTTYPE_PICU2_BASE
Com__LCD_COM_SEG EQU CYREG_PRT2_LCD_COM_SEG
Com__LCD_EN EQU CYREG_PRT2_LCD_EN
Com__PORT EQU 2
Com__PRT EQU CYREG_PRT2_PRT
Com__PRTDSI__CAPS_SEL EQU CYREG_PRT2_CAPS_SEL
Com__PRTDSI__DBL_SYNC_IN EQU CYREG_PRT2_DBL_SYNC_IN
Com__PRTDSI__OE_SEL0 EQU CYREG_PRT2_OE_SEL0
Com__PRTDSI__OE_SEL1 EQU CYREG_PRT2_OE_SEL1
Com__PRTDSI__OUT_SEL0 EQU CYREG_PRT2_OUT_SEL0
Com__PRTDSI__OUT_SEL1 EQU CYREG_PRT2_OUT_SEL1
Com__PRTDSI__SYNC_OUT EQU CYREG_PRT2_SYNC_OUT
Com__PS EQU CYREG_PRT2_PS
Com__SLW EQU CYREG_PRT2_SLW

/* Mas */
Mas__0__INTTYPE EQU CYREG_PICU3_INTTYPE0
Mas__0__MASK EQU 0x01
Mas__0__PC EQU CYREG_PRT3_PC0
Mas__0__PORT EQU 3
Mas__0__SHIFT EQU 0
Mas__AG EQU CYREG_PRT3_AG
Mas__AMUX EQU CYREG_PRT3_AMUX
Mas__BIE EQU CYREG_PRT3_BIE
Mas__BIT_MASK EQU CYREG_PRT3_BIT_MASK
Mas__BYP EQU CYREG_PRT3_BYP
Mas__CTL EQU CYREG_PRT3_CTL
Mas__DM0 EQU CYREG_PRT3_DM0
Mas__DM1 EQU CYREG_PRT3_DM1
Mas__DM2 EQU CYREG_PRT3_DM2
Mas__DR EQU CYREG_PRT3_DR
Mas__INP_DIS EQU CYREG_PRT3_INP_DIS
Mas__INTTYPE_BASE EQU CYDEV_PICU_INTTYPE_PICU3_BASE
Mas__LCD_COM_SEG EQU CYREG_PRT3_LCD_COM_SEG
Mas__LCD_EN EQU CYREG_PRT3_LCD_EN
Mas__MASK EQU 0x01
Mas__PORT EQU 3
Mas__PRT EQU CYREG_PRT3_PRT
Mas__PRTDSI__CAPS_SEL EQU CYREG_PRT3_CAPS_SEL
Mas__PRTDSI__DBL_SYNC_IN EQU CYREG_PRT3_DBL_SYNC_IN
Mas__PRTDSI__OE_SEL0 EQU CYREG_PRT3_OE_SEL0
Mas__PRTDSI__OE_SEL1 EQU CYREG_PRT3_OE_SEL1
Mas__PRTDSI__OUT_SEL0 EQU CYREG_PRT3_OUT_SEL0
Mas__PRTDSI__OUT_SEL1 EQU CYREG_PRT3_OUT_SEL1
Mas__PRTDSI__SYNC_OUT EQU CYREG_PRT3_SYNC_OUT
Mas__PS EQU CYREG_PRT3_PS
Mas__SHIFT EQU 0
Mas__SLW EQU CYREG_PRT3_SLW

/* PWM */
PWM_PWMHW__CAP0 EQU CYREG_TMR0_CAP0
PWM_PWMHW__CAP1 EQU CYREG_TMR0_CAP1
PWM_PWMHW__CFG0 EQU CYREG_TMR0_CFG0
PWM_PWMHW__CFG1 EQU CYREG_TMR0_CFG1
PWM_PWMHW__CFG2 EQU CYREG_TMR0_CFG2
PWM_PWMHW__CNT_CMP0 EQU CYREG_TMR0_CNT_CMP0
PWM_PWMHW__CNT_CMP1 EQU CYREG_TMR0_CNT_CMP1
PWM_PWMHW__PER0 EQU CYREG_TMR0_PER0
PWM_PWMHW__PER1 EQU CYREG_TMR0_PER1
PWM_PWMHW__PM_ACT_CFG EQU CYREG_PM_ACT_CFG3
PWM_PWMHW__PM_ACT_MSK EQU 0x01
PWM_PWMHW__PM_STBY_CFG EQU CYREG_PM_STBY_CFG3
PWM_PWMHW__PM_STBY_MSK EQU 0x01
PWM_PWMHW__RT0 EQU CYREG_TMR0_RT0
PWM_PWMHW__RT1 EQU CYREG_TMR0_RT1
PWM_PWMHW__SR0 EQU CYREG_TMR0_SR0

/* Seg */
Seg__0__AG EQU CYREG_PRT2_AG
Seg__0__AMUX EQU CYREG_PRT2_AMUX
Seg__0__BIE EQU CYREG_PRT2_BIE
Seg__0__BIT_MASK EQU CYREG_PRT2_BIT_MASK
Seg__0__BYP EQU CYREG_PRT2_BYP
Seg__0__CTL EQU CYREG_PRT2_CTL
Seg__0__DM0 EQU CYREG_PRT2_DM0
Seg__0__DM1 EQU CYREG_PRT2_DM1
Seg__0__DM2 EQU CYREG_PRT2_DM2
Seg__0__DR EQU CYREG_PRT2_DR
Seg__0__INP_DIS EQU CYREG_PRT2_INP_DIS
Seg__0__INTTYPE EQU CYREG_PICU2_INTTYPE5
Seg__0__LCD_COM_SEG EQU CYREG_PRT2_LCD_COM_SEG
Seg__0__LCD_EN EQU CYREG_PRT2_LCD_EN
Seg__0__MASK EQU 0x20
Seg__0__PC EQU CYREG_PRT2_PC5
Seg__0__PORT EQU 2
Seg__0__PRT EQU CYREG_PRT2_PRT
Seg__0__PRTDSI__CAPS_SEL EQU CYREG_PRT2_CAPS_SEL
Seg__0__PRTDSI__DBL_SYNC_IN EQU CYREG_PRT2_DBL_SYNC_IN
Seg__0__PRTDSI__OE_SEL0 EQU CYREG_PRT2_OE_SEL0
Seg__0__PRTDSI__OE_SEL1 EQU CYREG_PRT2_OE_SEL1
Seg__0__PRTDSI__OUT_SEL0 EQU CYREG_PRT2_OUT_SEL0
Seg__0__PRTDSI__OUT_SEL1 EQU CYREG_PRT2_OUT_SEL1
Seg__0__PRTDSI__SYNC_OUT EQU CYREG_PRT2_SYNC_OUT
Seg__0__PS EQU CYREG_PRT2_PS
Seg__0__SHIFT EQU 5
Seg__0__SLW EQU CYREG_PRT2_SLW
Seg__1__AG EQU CYREG_PRT2_AG
Seg__1__AMUX EQU CYREG_PRT2_AMUX
Seg__1__BIE EQU CYREG_PRT2_BIE
Seg__1__BIT_MASK EQU CYREG_PRT2_BIT_MASK
Seg__1__BYP EQU CYREG_PRT2_BYP
Seg__1__CTL EQU CYREG_PRT2_CTL
Seg__1__DM0 EQU CYREG_PRT2_DM0
Seg__1__DM1 EQU CYREG_PRT2_DM1
Seg__1__DM2 EQU CYREG_PRT2_DM2
Seg__1__DR EQU CYREG_PRT2_DR
Seg__1__INP_DIS EQU CYREG_PRT2_INP_DIS
Seg__1__INTTYPE EQU CYREG_PICU2_INTTYPE6
Seg__1__LCD_COM_SEG EQU CYREG_PRT2_LCD_COM_SEG
Seg__1__LCD_EN EQU CYREG_PRT2_LCD_EN
Seg__1__MASK EQU 0x40
Seg__1__PC EQU CYREG_PRT2_PC6
Seg__1__PORT EQU 2
Seg__1__PRT EQU CYREG_PRT2_PRT
Seg__1__PRTDSI__CAPS_SEL EQU CYREG_PRT2_CAPS_SEL
Seg__1__PRTDSI__DBL_SYNC_IN EQU CYREG_PRT2_DBL_SYNC_IN
Seg__1__PRTDSI__OE_SEL0 EQU CYREG_PRT2_OE_SEL0
Seg__1__PRTDSI__OE_SEL1 EQU CYREG_PRT2_OE_SEL1
Seg__1__PRTDSI__OUT_SEL0 EQU CYREG_PRT2_OUT_SEL0
Seg__1__PRTDSI__OUT_SEL1 EQU CYREG_PRT2_OUT_SEL1
Seg__1__PRTDSI__SYNC_OUT EQU CYREG_PRT2_SYNC_OUT
Seg__1__PS EQU CYREG_PRT2_PS
Seg__1__SHIFT EQU 6
Seg__1__SLW EQU CYREG_PRT2_SLW
Seg__2__AG EQU CYREG_PRT2_AG
Seg__2__AMUX EQU CYREG_PRT2_AMUX
Seg__2__BIE EQU CYREG_PRT2_BIE
Seg__2__BIT_MASK EQU CYREG_PRT2_BIT_MASK
Seg__2__BYP EQU CYREG_PRT2_BYP
Seg__2__CTL EQU CYREG_PRT2_CTL
Seg__2__DM0 EQU CYREG_PRT2_DM0
Seg__2__DM1 EQU CYREG_PRT2_DM1
Seg__2__DM2 EQU CYREG_PRT2_DM2
Seg__2__DR EQU CYREG_PRT2_DR
Seg__2__INP_DIS EQU CYREG_PRT2_INP_DIS
Seg__2__INTTYPE EQU CYREG_PICU2_INTTYPE7
Seg__2__LCD_COM_SEG EQU CYREG_PRT2_LCD_COM_SEG
Seg__2__LCD_EN EQU CYREG_PRT2_LCD_EN
Seg__2__MASK EQU 0x80
Seg__2__PC EQU CYREG_PRT2_PC7
Seg__2__PORT EQU 2
Seg__2__PRT EQU CYREG_PRT2_PRT
Seg__2__PRTDSI__CAPS_SEL EQU CYREG_PRT2_CAPS_SEL
Seg__2__PRTDSI__DBL_SYNC_IN EQU CYREG_PRT2_DBL_SYNC_IN
Seg__2__PRTDSI__OE_SEL0 EQU CYREG_PRT2_OE_SEL0
Seg__2__PRTDSI__OE_SEL1 EQU CYREG_PRT2_OE_SEL1
Seg__2__PRTDSI__OUT_SEL0 EQU CYREG_PRT2_OUT_SEL0
Seg__2__PRTDSI__OUT_SEL1 EQU CYREG_PRT2_OUT_SEL1
Seg__2__PRTDSI__SYNC_OUT EQU CYREG_PRT2_SYNC_OUT
Seg__2__PS EQU CYREG_PRT2_PS
Seg__2__SHIFT EQU 7
Seg__2__SLW EQU CYREG_PRT2_SLW
Seg__3__AG EQU CYREG_PRT1_AG
Seg__3__AMUX EQU CYREG_PRT1_AMUX
Seg__3__BIE EQU CYREG_PRT1_BIE
Seg__3__BIT_MASK EQU CYREG_PRT1_BIT_MASK
Seg__3__BYP EQU CYREG_PRT1_BYP
Seg__3__CTL EQU CYREG_PRT1_CTL
Seg__3__DM0 EQU CYREG_PRT1_DM0
Seg__3__DM1 EQU CYREG_PRT1_DM1
Seg__3__DM2 EQU CYREG_PRT1_DM2
Seg__3__DR EQU CYREG_PRT1_DR
Seg__3__INP_DIS EQU CYREG_PRT1_INP_DIS
Seg__3__INTTYPE EQU CYREG_PICU1_INTTYPE2
Seg__3__LCD_COM_SEG EQU CYREG_PRT1_LCD_COM_SEG
Seg__3__LCD_EN EQU CYREG_PRT1_LCD_EN
Seg__3__MASK EQU 0x04
Seg__3__PC EQU CYREG_PRT1_PC2
Seg__3__PORT EQU 1
Seg__3__PRT EQU CYREG_PRT1_PRT
Seg__3__PRTDSI__CAPS_SEL EQU CYREG_PRT1_CAPS_SEL
Seg__3__PRTDSI__DBL_SYNC_IN EQU CYREG_PRT1_DBL_SYNC_IN
Seg__3__PRTDSI__OE_SEL0 EQU CYREG_PRT1_OE_SEL0
Seg__3__PRTDSI__OE_SEL1 EQU CYREG_PRT1_OE_SEL1
Seg__3__PRTDSI__OUT_SEL0 EQU CYREG_PRT1_OUT_SEL0
Seg__3__PRTDSI__OUT_SEL1 EQU CYREG_PRT1_OUT_SEL1
Seg__3__PRTDSI__SYNC_OUT EQU CYREG_PRT1_SYNC_OUT
Seg__3__PS EQU CYREG_PRT1_PS
Seg__3__SHIFT EQU 2
Seg__3__SLW EQU CYREG_PRT1_SLW
Seg__4__AG EQU CYREG_PRT1_AG
Seg__4__AMUX EQU CYREG_PRT1_AMUX
Seg__4__BIE EQU CYREG_PRT1_BIE
Seg__4__BIT_MASK EQU CYREG_PRT1_BIT_MASK
Seg__4__BYP EQU CYREG_PRT1_BYP
Seg__4__CTL EQU CYREG_PRT1_CTL
Seg__4__DM0 EQU CYREG_PRT1_DM0
Seg__4__DM1 EQU CYREG_PRT1_DM1
Seg__4__DM2 EQU CYREG_PRT1_DM2
Seg__4__DR EQU CYREG_PRT1_DR
Seg__4__INP_DIS EQU CYREG_PRT1_INP_DIS
Seg__4__INTTYPE EQU CYREG_PICU1_INTTYPE4
Seg__4__LCD_COM_SEG EQU CYREG_PRT1_LCD_COM_SEG
Seg__4__LCD_EN EQU CYREG_PRT1_LCD_EN
Seg__4__MASK EQU 0x10
Seg__4__PC EQU CYREG_PRT1_PC4
Seg__4__PORT EQU 1
Seg__4__PRT EQU CYREG_PRT1_PRT
Seg__4__PRTDSI__CAPS_SEL EQU CYREG_PRT1_CAPS_SEL
Seg__4__PRTDSI__DBL_SYNC_IN EQU CYREG_PRT1_DBL_SYNC_IN
Seg__4__PRTDSI__OE_SEL0 EQU CYREG_PRT1_OE_SEL0
Seg__4__PRTDSI__OE_SEL1 EQU CYREG_PRT1_OE_SEL1
Seg__4__PRTDSI__OUT_SEL0 EQU CYREG_PRT1_OUT_SEL0
Seg__4__PRTDSI__OUT_SEL1 EQU CYREG_PRT1_OUT_SEL1
Seg__4__PRTDSI__SYNC_OUT EQU CYREG_PRT1_SYNC_OUT
Seg__4__PS EQU CYREG_PRT1_PS
Seg__4__SHIFT EQU 4
Seg__4__SLW EQU CYREG_PRT1_SLW
Seg__5__AG EQU CYREG_PRT1_AG
Seg__5__AMUX EQU CYREG_PRT1_AMUX
Seg__5__BIE EQU CYREG_PRT1_BIE
Seg__5__BIT_MASK EQU CYREG_PRT1_BIT_MASK
Seg__5__BYP EQU CYREG_PRT1_BYP
Seg__5__CTL EQU CYREG_PRT1_CTL
Seg__5__DM0 EQU CYREG_PRT1_DM0
Seg__5__DM1 EQU CYREG_PRT1_DM1
Seg__5__DM2 EQU CYREG_PRT1_DM2
Seg__5__DR EQU CYREG_PRT1_DR
Seg__5__INP_DIS EQU CYREG_PRT1_INP_DIS
Seg__5__INTTYPE EQU CYREG_PICU1_INTTYPE5
Seg__5__LCD_COM_SEG EQU CYREG_PRT1_LCD_COM_SEG
Seg__5__LCD_EN EQU CYREG_PRT1_LCD_EN
Seg__5__MASK EQU 0x20
Seg__5__PC EQU CYREG_PRT1_PC5
Seg__5__PORT EQU 1
Seg__5__PRT EQU CYREG_PRT1_PRT
Seg__5__PRTDSI__CAPS_SEL EQU CYREG_PRT1_CAPS_SEL
Seg__5__PRTDSI__DBL_SYNC_IN EQU CYREG_PRT1_DBL_SYNC_IN
Seg__5__PRTDSI__OE_SEL0 EQU CYREG_PRT1_OE_SEL0
Seg__5__PRTDSI__OE_SEL1 EQU CYREG_PRT1_OE_SEL1
Seg__5__PRTDSI__OUT_SEL0 EQU CYREG_PRT1_OUT_SEL0
Seg__5__PRTDSI__OUT_SEL1 EQU CYREG_PRT1_OUT_SEL1
Seg__5__PRTDSI__SYNC_OUT EQU CYREG_PRT1_SYNC_OUT
Seg__5__PS EQU CYREG_PRT1_PS
Seg__5__SHIFT EQU 5
Seg__5__SLW EQU CYREG_PRT1_SLW
Seg__6__AG EQU CYREG_PRT1_AG
Seg__6__AMUX EQU CYREG_PRT1_AMUX
Seg__6__BIE EQU CYREG_PRT1_BIE
Seg__6__BIT_MASK EQU CYREG_PRT1_BIT_MASK
Seg__6__BYP EQU CYREG_PRT1_BYP
Seg__6__CTL EQU CYREG_PRT1_CTL
Seg__6__DM0 EQU CYREG_PRT1_DM0
Seg__6__DM1 EQU CYREG_PRT1_DM1
Seg__6__DM2 EQU CYREG_PRT1_DM2
Seg__6__DR EQU CYREG_PRT1_DR
Seg__6__INP_DIS EQU CYREG_PRT1_INP_DIS
Seg__6__INTTYPE EQU CYREG_PICU1_INTTYPE6
Seg__6__LCD_COM_SEG EQU CYREG_PRT1_LCD_COM_SEG
Seg__6__LCD_EN EQU CYREG_PRT1_LCD_EN
Seg__6__MASK EQU 0x40
Seg__6__PC EQU CYREG_PRT1_PC6
Seg__6__PORT EQU 1
Seg__6__PRT EQU CYREG_PRT1_PRT
Seg__6__PRTDSI__CAPS_SEL EQU CYREG_PRT1_CAPS_SEL
Seg__6__PRTDSI__DBL_SYNC_IN EQU CYREG_PRT1_DBL_SYNC_IN
Seg__6__PRTDSI__OE_SEL0 EQU CYREG_PRT1_OE_SEL0
Seg__6__PRTDSI__OE_SEL1 EQU CYREG_PRT1_OE_SEL1
Seg__6__PRTDSI__OUT_SEL0 EQU CYREG_PRT1_OUT_SEL0
Seg__6__PRTDSI__OUT_SEL1 EQU CYREG_PRT1_OUT_SEL1
Seg__6__PRTDSI__SYNC_OUT EQU CYREG_PRT1_SYNC_OUT
Seg__6__PS EQU CYREG_PRT1_PS
Seg__6__SHIFT EQU 6
Seg__6__SLW EQU CYREG_PRT1_SLW
Seg__7__AG EQU CYREG_PRT1_AG
Seg__7__AMUX EQU CYREG_PRT1_AMUX
Seg__7__BIE EQU CYREG_PRT1_BIE
Seg__7__BIT_MASK EQU CYREG_PRT1_BIT_MASK
Seg__7__BYP EQU CYREG_PRT1_BYP
Seg__7__CTL EQU CYREG_PRT1_CTL
Seg__7__DM0 EQU CYREG_PRT1_DM0
Seg__7__DM1 EQU CYREG_PRT1_DM1
Seg__7__DM2 EQU CYREG_PRT1_DM2
Seg__7__DR EQU CYREG_PRT1_DR
Seg__7__INP_DIS EQU CYREG_PRT1_INP_DIS
Seg__7__INTTYPE EQU CYREG_PICU1_INTTYPE7
Seg__7__LCD_COM_SEG EQU CYREG_PRT1_LCD_COM_SEG
Seg__7__LCD_EN EQU CYREG_PRT1_LCD_EN
Seg__7__MASK EQU 0x80
Seg__7__PC EQU CYREG_PRT1_PC7
Seg__7__PORT EQU 1
Seg__7__PRT EQU CYREG_PRT1_PRT
Seg__7__PRTDSI__CAPS_SEL EQU CYREG_PRT1_CAPS_SEL
Seg__7__PRTDSI__DBL_SYNC_IN EQU CYREG_PRT1_DBL_SYNC_IN
Seg__7__PRTDSI__OE_SEL0 EQU CYREG_PRT1_OE_SEL0
Seg__7__PRTDSI__OE_SEL1 EQU CYREG_PRT1_OE_SEL1
Seg__7__PRTDSI__OUT_SEL0 EQU CYREG_PRT1_OUT_SEL0
Seg__7__PRTDSI__OUT_SEL1 EQU CYREG_PRT1_OUT_SEL1
Seg__7__PRTDSI__SYNC_OUT EQU CYREG_PRT1_SYNC_OUT
Seg__7__PS EQU CYREG_PRT1_PS
Seg__7__SHIFT EQU 7
Seg__7__SLW EQU CYREG_PRT1_SLW

/* Menos */
Menos__0__INTTYPE EQU CYREG_PICU3_INTTYPE1
Menos__0__MASK EQU 0x02
Menos__0__PC EQU CYREG_PRT3_PC1
Menos__0__PORT EQU 3
Menos__0__SHIFT EQU 1
Menos__AG EQU CYREG_PRT3_AG
Menos__AMUX EQU CYREG_PRT3_AMUX
Menos__BIE EQU CYREG_PRT3_BIE
Menos__BIT_MASK EQU CYREG_PRT3_BIT_MASK
Menos__BYP EQU CYREG_PRT3_BYP
Menos__CTL EQU CYREG_PRT3_CTL
Menos__DM0 EQU CYREG_PRT3_DM0
Menos__DM1 EQU CYREG_PRT3_DM1
Menos__DM2 EQU CYREG_PRT3_DM2
Menos__DR EQU CYREG_PRT3_DR
Menos__INP_DIS EQU CYREG_PRT3_INP_DIS
Menos__INTTYPE_BASE EQU CYDEV_PICU_INTTYPE_PICU3_BASE
Menos__LCD_COM_SEG EQU CYREG_PRT3_LCD_COM_SEG
Menos__LCD_EN EQU CYREG_PRT3_LCD_EN
Menos__MASK EQU 0x02
Menos__PORT EQU 3
Menos__PRT EQU CYREG_PRT3_PRT
Menos__PRTDSI__CAPS_SEL EQU CYREG_PRT3_CAPS_SEL
Menos__PRTDSI__DBL_SYNC_IN EQU CYREG_PRT3_DBL_SYNC_IN
Menos__PRTDSI__OE_SEL0 EQU CYREG_PRT3_OE_SEL0
Menos__PRTDSI__OE_SEL1 EQU CYREG_PRT3_OE_SEL1
Menos__PRTDSI__OUT_SEL0 EQU CYREG_PRT3_OUT_SEL0
Menos__PRTDSI__OUT_SEL1 EQU CYREG_PRT3_OUT_SEL1
Menos__PRTDSI__SYNC_OUT EQU CYREG_PRT3_SYNC_OUT
Menos__PS EQU CYREG_PRT3_PS
Menos__SHIFT EQU 1
Menos__SLW EQU CYREG_PRT3_SLW

/* Botones */
Botones_sts_sts_reg__0__MASK EQU 0x01
Botones_sts_sts_reg__0__POS EQU 0
Botones_sts_sts_reg__1__MASK EQU 0x02
Botones_sts_sts_reg__1__POS EQU 1
Botones_sts_sts_reg__16BIT_STATUS_AUX_CTL_REG EQU CYREG_B1_UDB08_09_ACTL
Botones_sts_sts_reg__16BIT_STATUS_REG EQU CYREG_B1_UDB08_09_ST
Botones_sts_sts_reg__MASK EQU 0x03
Botones_sts_sts_reg__MASK_REG EQU CYREG_B1_UDB08_MSK
Botones_sts_sts_reg__MASK_ST_AUX_CTL_REG EQU CYREG_B1_UDB08_MSK_ACTL
Botones_sts_sts_reg__PER_ST_AUX_CTL_REG EQU CYREG_B1_UDB08_MSK_ACTL
Botones_sts_sts_reg__STATUS_AUX_CTL_REG EQU CYREG_B1_UDB08_ACTL
Botones_sts_sts_reg__STATUS_CNT_REG EQU CYREG_B1_UDB08_ST_CTL
Botones_sts_sts_reg__STATUS_CONTROL_REG EQU CYREG_B1_UDB08_ST_CTL
Botones_sts_sts_reg__STATUS_REG EQU CYREG_B1_UDB08_ST

/* Clock_1 */
Clock_1__CFG0 EQU CYREG_CLKDIST_DCFG1_CFG0
Clock_1__CFG1 EQU CYREG_CLKDIST_DCFG1_CFG1
Clock_1__CFG2 EQU CYREG_CLKDIST_DCFG1_CFG2
Clock_1__CFG2_SRC_SEL_MASK EQU 0x07
Clock_1__INDEX EQU 0x01
Clock_1__PM_ACT_CFG EQU CYREG_PM_ACT_CFG2
Clock_1__PM_ACT_MSK EQU 0x02
Clock_1__PM_STBY_CFG EQU CYREG_PM_STBY_CFG2
Clock_1__PM_STBY_MSK EQU 0x02

/* LED_Drive */
LED_Drive_ClkInternal__CFG0 EQU CYREG_CLKDIST_DCFG0_CFG0
LED_Drive_ClkInternal__CFG1 EQU CYREG_CLKDIST_DCFG0_CFG1
LED_Drive_ClkInternal__CFG2 EQU CYREG_CLKDIST_DCFG0_CFG2
LED_Drive_ClkInternal__CFG2_SRC_SEL_MASK EQU 0x07
LED_Drive_ClkInternal__INDEX EQU 0x00
LED_Drive_ClkInternal__PM_ACT_CFG EQU CYREG_PM_ACT_CFG2
LED_Drive_ClkInternal__PM_ACT_MSK EQU 0x01
LED_Drive_ClkInternal__PM_STBY_CFG EQU CYREG_PM_STBY_CFG2
LED_Drive_ClkInternal__PM_STBY_MSK EQU 0x01
LED_Drive_Com_Driver_Sync_ctrl_reg__0__MASK EQU 0x01
LED_Drive_Com_Driver_Sync_ctrl_reg__0__POS EQU 0
LED_Drive_Com_Driver_Sync_ctrl_reg__1__MASK EQU 0x02
LED_Drive_Com_Driver_Sync_ctrl_reg__1__POS EQU 1
LED_Drive_Com_Driver_Sync_ctrl_reg__16BIT_CONTROL_AUX_CTL_REG EQU CYREG_B1_UDB08_09_ACTL
LED_Drive_Com_Driver_Sync_ctrl_reg__16BIT_CONTROL_CONTROL_REG EQU CYREG_B1_UDB08_09_CTL
LED_Drive_Com_Driver_Sync_ctrl_reg__16BIT_CONTROL_COUNT_REG EQU CYREG_B1_UDB08_09_CTL
LED_Drive_Com_Driver_Sync_ctrl_reg__16BIT_COUNT_CONTROL_REG EQU CYREG_B1_UDB08_09_CTL
LED_Drive_Com_Driver_Sync_ctrl_reg__16BIT_COUNT_COUNT_REG EQU CYREG_B1_UDB08_09_CTL
LED_Drive_Com_Driver_Sync_ctrl_reg__16BIT_MASK_MASK_REG EQU CYREG_B1_UDB08_09_MSK
LED_Drive_Com_Driver_Sync_ctrl_reg__16BIT_MASK_PERIOD_REG EQU CYREG_B1_UDB08_09_MSK
LED_Drive_Com_Driver_Sync_ctrl_reg__16BIT_PERIOD_MASK_REG EQU CYREG_B1_UDB08_09_MSK
LED_Drive_Com_Driver_Sync_ctrl_reg__16BIT_PERIOD_PERIOD_REG EQU CYREG_B1_UDB08_09_MSK
LED_Drive_Com_Driver_Sync_ctrl_reg__2__MASK EQU 0x04
LED_Drive_Com_Driver_Sync_ctrl_reg__2__POS EQU 2
LED_Drive_Com_Driver_Sync_ctrl_reg__3__MASK EQU 0x08
LED_Drive_Com_Driver_Sync_ctrl_reg__3__POS EQU 3
LED_Drive_Com_Driver_Sync_ctrl_reg__CONTROL_AUX_CTL_REG EQU CYREG_B1_UDB08_ACTL
LED_Drive_Com_Driver_Sync_ctrl_reg__CONTROL_REG EQU CYREG_B1_UDB08_CTL
LED_Drive_Com_Driver_Sync_ctrl_reg__CONTROL_ST_REG EQU CYREG_B1_UDB08_ST_CTL
LED_Drive_Com_Driver_Sync_ctrl_reg__COUNT_REG EQU CYREG_B1_UDB08_CTL
LED_Drive_Com_Driver_Sync_ctrl_reg__COUNT_ST_REG EQU CYREG_B1_UDB08_ST_CTL
LED_Drive_Com_Driver_Sync_ctrl_reg__MASK EQU 0x0F
LED_Drive_Com_Driver_Sync_ctrl_reg__MASK_CTL_AUX_CTL_REG EQU CYREG_B1_UDB08_MSK_ACTL
LED_Drive_Com_Driver_Sync_ctrl_reg__PER_CTL_AUX_CTL_REG EQU CYREG_B1_UDB08_MSK_ACTL
LED_Drive_Com_Driver_Sync_ctrl_reg__PERIOD_REG EQU CYREG_B1_UDB08_MSK
LED_Drive_DMA_Com__DRQ_CTL EQU CYREG_IDMUX_DRQ_CTL0
LED_Drive_DMA_Com__DRQ_NUMBER EQU 0
LED_Drive_DMA_Com__NUMBEROF_TDS EQU 0
LED_Drive_DMA_Com__PRIORITY EQU 2
LED_Drive_DMA_Com__TERMIN_EN EQU 0
LED_Drive_DMA_Com__TERMIN_SEL EQU 0
LED_Drive_DMA_Com__TERMOUT0_EN EQU 1
LED_Drive_DMA_Com__TERMOUT0_SEL EQU 0
LED_Drive_DMA_Com__TERMOUT1_EN EQU 0
LED_Drive_DMA_Com__TERMOUT1_SEL EQU 0
LED_Drive_DMA_Seg__DRQ_CTL EQU CYREG_IDMUX_DRQ_CTL0
LED_Drive_DMA_Seg__DRQ_NUMBER EQU 1
LED_Drive_DMA_Seg__NUMBEROF_TDS EQU 0
LED_Drive_DMA_Seg__PRIORITY EQU 2
LED_Drive_DMA_Seg__TERMIN_EN EQU 0
LED_Drive_DMA_Seg__TERMIN_SEL EQU 0
LED_Drive_DMA_Seg__TERMOUT0_EN EQU 1
LED_Drive_DMA_Seg__TERMOUT0_SEL EQU 1
LED_Drive_DMA_Seg__TERMOUT1_EN EQU 0
LED_Drive_DMA_Seg__TERMOUT1_SEL EQU 0
LED_Drive_Seg_Driver_L_Sync_ctrl_reg__0__MASK EQU 0x01
LED_Drive_Seg_Driver_L_Sync_ctrl_reg__0__POS EQU 0
LED_Drive_Seg_Driver_L_Sync_ctrl_reg__1__MASK EQU 0x02
LED_Drive_Seg_Driver_L_Sync_ctrl_reg__1__POS EQU 1
LED_Drive_Seg_Driver_L_Sync_ctrl_reg__16BIT_CONTROL_AUX_CTL_REG EQU CYREG_B1_UDB09_10_ACTL
LED_Drive_Seg_Driver_L_Sync_ctrl_reg__16BIT_CONTROL_CONTROL_REG EQU CYREG_B1_UDB09_10_CTL
LED_Drive_Seg_Driver_L_Sync_ctrl_reg__16BIT_CONTROL_COUNT_REG EQU CYREG_B1_UDB09_10_CTL
LED_Drive_Seg_Driver_L_Sync_ctrl_reg__16BIT_COUNT_CONTROL_REG EQU CYREG_B1_UDB09_10_CTL
LED_Drive_Seg_Driver_L_Sync_ctrl_reg__16BIT_COUNT_COUNT_REG EQU CYREG_B1_UDB09_10_CTL
LED_Drive_Seg_Driver_L_Sync_ctrl_reg__16BIT_MASK_MASK_REG EQU CYREG_B1_UDB09_10_MSK
LED_Drive_Seg_Driver_L_Sync_ctrl_reg__16BIT_MASK_PERIOD_REG EQU CYREG_B1_UDB09_10_MSK
LED_Drive_Seg_Driver_L_Sync_ctrl_reg__16BIT_PERIOD_MASK_REG EQU CYREG_B1_UDB09_10_MSK
LED_Drive_Seg_Driver_L_Sync_ctrl_reg__16BIT_PERIOD_PERIOD_REG EQU CYREG_B1_UDB09_10_MSK
LED_Drive_Seg_Driver_L_Sync_ctrl_reg__2__MASK EQU 0x04
LED_Drive_Seg_Driver_L_Sync_ctrl_reg__2__POS EQU 2
LED_Drive_Seg_Driver_L_Sync_ctrl_reg__3__MASK EQU 0x08
LED_Drive_Seg_Driver_L_Sync_ctrl_reg__3__POS EQU 3
LED_Drive_Seg_Driver_L_Sync_ctrl_reg__4__MASK EQU 0x10
LED_Drive_Seg_Driver_L_Sync_ctrl_reg__4__POS EQU 4
LED_Drive_Seg_Driver_L_Sync_ctrl_reg__5__MASK EQU 0x20
LED_Drive_Seg_Driver_L_Sync_ctrl_reg__5__POS EQU 5
LED_Drive_Seg_Driver_L_Sync_ctrl_reg__6__MASK EQU 0x40
LED_Drive_Seg_Driver_L_Sync_ctrl_reg__6__POS EQU 6
LED_Drive_Seg_Driver_L_Sync_ctrl_reg__7__MASK EQU 0x80
LED_Drive_Seg_Driver_L_Sync_ctrl_reg__7__POS EQU 7
LED_Drive_Seg_Driver_L_Sync_ctrl_reg__CONTROL_AUX_CTL_REG EQU CYREG_B1_UDB09_ACTL
LED_Drive_Seg_Driver_L_Sync_ctrl_reg__CONTROL_REG EQU CYREG_B1_UDB09_CTL
LED_Drive_Seg_Driver_L_Sync_ctrl_reg__CONTROL_ST_REG EQU CYREG_B1_UDB09_ST_CTL
LED_Drive_Seg_Driver_L_Sync_ctrl_reg__COUNT_REG EQU CYREG_B1_UDB09_CTL
LED_Drive_Seg_Driver_L_Sync_ctrl_reg__COUNT_ST_REG EQU CYREG_B1_UDB09_ST_CTL
LED_Drive_Seg_Driver_L_Sync_ctrl_reg__MASK EQU 0xFF
LED_Drive_Seg_Driver_L_Sync_ctrl_reg__MASK_CTL_AUX_CTL_REG EQU CYREG_B1_UDB09_MSK_ACTL
LED_Drive_Seg_Driver_L_Sync_ctrl_reg__PER_CTL_AUX_CTL_REG EQU CYREG_B1_UDB09_MSK_ACTL
LED_Drive_Seg_Driver_L_Sync_ctrl_reg__PERIOD_REG EQU CYREG_B1_UDB09_MSK

/* Driver_motor */
Driver_motor__0__INTTYPE EQU CYREG_PICU0_INTTYPE7
Driver_motor__0__MASK EQU 0x80
Driver_motor__0__PC EQU CYREG_PRT0_PC7
Driver_motor__0__PORT EQU 0
Driver_motor__0__SHIFT EQU 7
Driver_motor__AG EQU CYREG_PRT0_AG
Driver_motor__AMUX EQU CYREG_PRT0_AMUX
Driver_motor__BIE EQU CYREG_PRT0_BIE
Driver_motor__BIT_MASK EQU CYREG_PRT0_BIT_MASK
Driver_motor__BYP EQU CYREG_PRT0_BYP
Driver_motor__CTL EQU CYREG_PRT0_CTL
Driver_motor__DM0 EQU CYREG_PRT0_DM0
Driver_motor__DM1 EQU CYREG_PRT0_DM1
Driver_motor__DM2 EQU CYREG_PRT0_DM2
Driver_motor__DR EQU CYREG_PRT0_DR
Driver_motor__INP_DIS EQU CYREG_PRT0_INP_DIS
Driver_motor__INTTYPE_BASE EQU CYDEV_PICU_INTTYPE_PICU0_BASE
Driver_motor__LCD_COM_SEG EQU CYREG_PRT0_LCD_COM_SEG
Driver_motor__LCD_EN EQU CYREG_PRT0_LCD_EN
Driver_motor__MASK EQU 0x80
Driver_motor__PORT EQU 0
Driver_motor__PRT EQU CYREG_PRT0_PRT
Driver_motor__PRTDSI__CAPS_SEL EQU CYREG_PRT0_CAPS_SEL
Driver_motor__PRTDSI__DBL_SYNC_IN EQU CYREG_PRT0_DBL_SYNC_IN
Driver_motor__PRTDSI__OE_SEL0 EQU CYREG_PRT0_OE_SEL0
Driver_motor__PRTDSI__OE_SEL1 EQU CYREG_PRT0_OE_SEL1
Driver_motor__PRTDSI__OUT_SEL0 EQU CYREG_PRT0_OUT_SEL0
Driver_motor__PRTDSI__OUT_SEL1 EQU CYREG_PRT0_OUT_SEL1
Driver_motor__PRTDSI__SYNC_OUT EQU CYREG_PRT0_SYNC_OUT
Driver_motor__PS EQU CYREG_PRT0_PS
Driver_motor__SHIFT EQU 7
Driver_motor__SLW EQU CYREG_PRT0_SLW

/* Miscellaneous */
BCLK__BUS_CLK__HZ EQU 24000000
BCLK__BUS_CLK__KHZ EQU 24000
BCLK__BUS_CLK__MHZ EQU 24
CYDEV_CHIP_DIE_LEOPARD EQU 1
CYDEV_CHIP_DIE_PSOC4A EQU 26
CYDEV_CHIP_DIE_PSOC5LP EQU 2
CYDEV_CHIP_DIE_PSOC5TM EQU 3
CYDEV_CHIP_DIE_TMA4 EQU 4
CYDEV_CHIP_DIE_UNKNOWN EQU 0
CYDEV_CHIP_FAMILY_FM0P EQU 5
CYDEV_CHIP_FAMILY_FM3 EQU 6
CYDEV_CHIP_FAMILY_FM4 EQU 7
CYDEV_CHIP_FAMILY_PSOC3 EQU 1
CYDEV_CHIP_FAMILY_PSOC4 EQU 2
CYDEV_CHIP_FAMILY_PSOC5 EQU 3
CYDEV_CHIP_FAMILY_PSOC6 EQU 4
CYDEV_CHIP_FAMILY_UNKNOWN EQU 0
CYDEV_CHIP_FAMILY_USED EQU CYDEV_CHIP_FAMILY_PSOC5
CYDEV_CHIP_JTAG_ID EQU 0x2E161069
CYDEV_CHIP_MEMBER_3A EQU 1
CYDEV_CHIP_MEMBER_4A EQU 26
CYDEV_CHIP_MEMBER_4AA EQU 25
CYDEV_CHIP_MEMBER_4AB EQU 30
CYDEV_CHIP_MEMBER_4AC EQU 14
CYDEV_CHIP_MEMBER_4AD EQU 15
CYDEV_CHIP_MEMBER_4AE EQU 16
CYDEV_CHIP_MEMBER_4D EQU 20
CYDEV_CHIP_MEMBER_4E EQU 6
CYDEV_CHIP_MEMBER_4F EQU 27
CYDEV_CHIP_MEMBER_4G EQU 4
CYDEV_CHIP_MEMBER_4H EQU 24
CYDEV_CHIP_MEMBER_4I EQU 32
CYDEV_CHIP_MEMBER_4J EQU 21
CYDEV_CHIP_MEMBER_4K EQU 22
CYDEV_CHIP_MEMBER_4L EQU 31
CYDEV_CHIP_MEMBER_4M EQU 29
CYDEV_CHIP_MEMBER_4N EQU 11
CYDEV_CHIP_MEMBER_4O EQU 8
CYDEV_CHIP_MEMBER_4P EQU 28
CYDEV_CHIP_MEMBER_4Q EQU 17
CYDEV_CHIP_MEMBER_4R EQU 9
CYDEV_CHIP_MEMBER_4S EQU 12
CYDEV_CHIP_MEMBER_4T EQU 10
CYDEV_CHIP_MEMBER_4U EQU 5
CYDEV_CHIP_MEMBER_4V EQU 23
CYDEV_CHIP_MEMBER_4W EQU 13
CYDEV_CHIP_MEMBER_4X EQU 7
CYDEV_CHIP_MEMBER_4Y EQU 18
CYDEV_CHIP_MEMBER_4Z EQU 19
CYDEV_CHIP_MEMBER_5A EQU 3
CYDEV_CHIP_MEMBER_5B EQU 2
CYDEV_CHIP_MEMBER_6A EQU 33
CYDEV_CHIP_MEMBER_FM3 EQU 37
CYDEV_CHIP_MEMBER_FM4 EQU 38
CYDEV_CHIP_MEMBER_PDL_FM0P_TYPE1 EQU 34
CYDEV_CHIP_MEMBER_PDL_FM0P_TYPE2 EQU 35
CYDEV_CHIP_MEMBER_PDL_FM0P_TYPE3 EQU 36
CYDEV_CHIP_MEMBER_UNKNOWN EQU 0
CYDEV_CHIP_MEMBER_USED EQU CYDEV_CHIP_MEMBER_5B
CYDEV_CHIP_DIE_EXPECT EQU CYDEV_CHIP_MEMBER_USED
CYDEV_CHIP_DIE_ACTUAL EQU CYDEV_CHIP_DIE_EXPECT
CYDEV_CHIP_REV_LEOPARD_ES1 EQU 0
CYDEV_CHIP_REV_LEOPARD_ES2 EQU 1
CYDEV_CHIP_REV_LEOPARD_ES3 EQU 3
CYDEV_CHIP_REV_LEOPARD_PRODUCTION EQU 3
CYDEV_CHIP_REV_PSOC4A_ES0 EQU 17
CYDEV_CHIP_REV_PSOC4A_PRODUCTION EQU 17
CYDEV_CHIP_REV_PSOC5LP_ES0 EQU 0
CYDEV_CHIP_REV_PSOC5LP_PRODUCTION EQU 0
CYDEV_CHIP_REV_PSOC5TM_ES0 EQU 0
CYDEV_CHIP_REV_PSOC5TM_ES1 EQU 1
CYDEV_CHIP_REV_PSOC5TM_PRODUCTION EQU 1
CYDEV_CHIP_REV_TMA4_ES EQU 17
CYDEV_CHIP_REV_TMA4_ES2 EQU 33
CYDEV_CHIP_REV_TMA4_PRODUCTION EQU 17
CYDEV_CHIP_REVISION_3A_ES1 EQU 0
CYDEV_CHIP_REVISION_3A_ES2 EQU 1
CYDEV_CHIP_REVISION_3A_ES3 EQU 3
CYDEV_CHIP_REVISION_3A_PRODUCTION EQU 3
CYDEV_CHIP_REVISION_4A_ES0 EQU 17
CYDEV_CHIP_REVISION_4A_PRODUCTION EQU 17
CYDEV_CHIP_REVISION_4AA_PRODUCTION EQU 0
CYDEV_CHIP_REVISION_4AB_PRODUCTION EQU 0
CYDEV_CHIP_REVISION_4AC_PRODUCTION EQU 0
CYDEV_CHIP_REVISION_4AD_PRODUCTION EQU 0
CYDEV_CHIP_REVISION_4AE_PRODUCTION EQU 0
CYDEV_CHIP_REVISION_4D_PRODUCTION EQU 0
CYDEV_CHIP_REVISION_4E_CCG2_NO_USBPD EQU 0
CYDEV_CHIP_REVISION_4E_PRODUCTION EQU 0
CYDEV_CHIP_REVISION_4F_PRODUCTION EQU 0
CYDEV_CHIP_REVISION_4F_PRODUCTION_256DMA EQU 0
CYDEV_CHIP_REVISION_4F_PRODUCTION_256K EQU 0
CYDEV_CHIP_REVISION_4G_ES EQU 17
CYDEV_CHIP_REVISION_4G_ES2 EQU 33
CYDEV_CHIP_REVISION_4G_PRODUCTION EQU 17
CYDEV_CHIP_REVISION_4H_PRODUCTION EQU 0
CYDEV_CHIP_REVISION_4I_PRODUCTION EQU 0
CYDEV_CHIP_REVISION_4J_PRODUCTION EQU 0
CYDEV_CHIP_REVISION_4K_PRODUCTION EQU 0
CYDEV_CHIP_REVISION_4L_PRODUCTION EQU 0
CYDEV_CHIP_REVISION_4M_PRODUCTION EQU 0
CYDEV_CHIP_REVISION_4N_PRODUCTION EQU 0
CYDEV_CHIP_REVISION_4O_PRODUCTION EQU 0
CYDEV_CHIP_REVISION_4P_PRODUCTION EQU 0
CYDEV_CHIP_REVISION_4Q_PRODUCTION EQU 0
CYDEV_CHIP_REVISION_4R_PRODUCTION EQU 0
CYDEV_CHIP_REVISION_4S_PRODUCTION EQU 0
CYDEV_CHIP_REVISION_4T_PRODUCTION EQU 0
CYDEV_CHIP_REVISION_4U_PRODUCTION EQU 0
CYDEV_CHIP_REVISION_4V_PRODUCTION EQU 0
CYDEV_CHIP_REVISION_4W_PRODUCTION EQU 0
CYDEV_CHIP_REVISION_4X_PRODUCTION EQU 0
CYDEV_CHIP_REVISION_4Y_PRODUCTION EQU 0
CYDEV_CHIP_REVISION_4Z_PRODUCTION EQU 0
CYDEV_CHIP_REVISION_5A_ES0 EQU 0
CYDEV_CHIP_REVISION_5A_ES1 EQU 1
CYDEV_CHIP_REVISION_5A_PRODUCTION EQU 1
CYDEV_CHIP_REVISION_5B_ES0 EQU 0
CYDEV_CHIP_REVISION_5B_PRODUCTION EQU 0
CYDEV_CHIP_REVISION_6A_ES EQU 17
CYDEV_CHIP_REVISION_6A_NO_UDB EQU 33
CYDEV_CHIP_REVISION_6A_PRODUCTION EQU 33
CYDEV_CHIP_REVISION_FM3_PRODUCTION EQU 0
CYDEV_CHIP_REVISION_FM4_PRODUCTION EQU 0
CYDEV_CHIP_REVISION_PDL_FM0P_TYPE1_PRODUCTION EQU 0
CYDEV_CHIP_REVISION_PDL_FM0P_TYPE2_PRODUCTION EQU 0
CYDEV_CHIP_REVISION_PDL_FM0P_TYPE3_PRODUCTION EQU 0
CYDEV_CHIP_REVISION_USED EQU CYDEV_CHIP_REVISION_5B_PRODUCTION
CYDEV_CHIP_REV_EXPECT EQU CYDEV_CHIP_REVISION_USED
CYDEV_CONFIG_FASTBOOT_ENABLED EQU 1
CYDEV_CONFIG_UNUSED_IO_AllowButWarn EQU 0
CYDEV_CONFIG_UNUSED_IO EQU CYDEV_CONFIG_UNUSED_IO_AllowButWarn
CYDEV_CONFIG_UNUSED_IO_AllowWithInfo EQU 1
CYDEV_CONFIG_UNUSED_IO_Disallowed EQU 2
CYDEV_CONFIGURATION_COMPRESSED EQU 1
CYDEV_CONFIGURATION_DMA EQU 0
CYDEV_CONFIGURATION_ECC EQU 1
CYDEV_CONFIGURATION_IMOENABLED EQU CYDEV_CONFIG_FASTBOOT_ENABLED
CYDEV_CONFIGURATION_MODE_COMPRESSED EQU 0
CYDEV_CONFIGURATION_MODE EQU CYDEV_CONFIGURATION_MODE_COMPRESSED
CYDEV_CONFIGURATION_MODE_DMA EQU 2
CYDEV_CONFIGURATION_MODE_UNCOMPRESSED EQU 1
CYDEV_DEBUG_ENABLE_MASK EQU 0x20
CYDEV_DEBUG_ENABLE_REGISTER EQU CYREG_MLOGIC_DEBUG
CYDEV_DEBUGGING_DPS_Disable EQU 3
CYDEV_DEBUGGING_DPS_JTAG_4 EQU 1
CYDEV_DEBUGGING_DPS_JTAG_5 EQU 0
CYDEV_DEBUGGING_DPS_SWD EQU 2
CYDEV_DEBUGGING_DPS_SWD_SWV EQU 6
CYDEV_DEBUGGING_DPS EQU CYDEV_DEBUGGING_DPS_SWD_SWV
CYDEV_DEBUGGING_ENABLE EQU 1
CYDEV_DEBUGGING_XRES EQU 0
CYDEV_DMA_CHANNELS_AVAILABLE EQU 24
CYDEV_ECC_ENABLE EQU 0
CYDEV_HEAP_SIZE EQU 0x80
CYDEV_INSTRUCT_CACHE_ENABLED EQU 1
CYDEV_INTR_RISING EQU 0x00000000
CYDEV_IS_EXPORTING_CODE EQU 0
CYDEV_IS_IMPORTING_CODE EQU 0
CYDEV_PROJ_TYPE EQU 0
CYDEV_PROJ_TYPE_BOOTLOADER EQU 1
CYDEV_PROJ_TYPE_LAUNCHER EQU 5
CYDEV_PROJ_TYPE_LOADABLE EQU 2
CYDEV_PROJ_TYPE_LOADABLEANDBOOTLOADER EQU 4
CYDEV_PROJ_TYPE_MULTIAPPBOOTLOADER EQU 3
CYDEV_PROJ_TYPE_STANDARD EQU 0
CYDEV_PROTECTION_ENABLE EQU 0
CYDEV_STACK_SIZE EQU 0x0800
CYDEV_USE_BUNDLED_CMSIS EQU 1
CYDEV_VARIABLE_VDDA EQU 0
CYDEV_VDDA_MV EQU 5000
CYDEV_VDDD_MV EQU 5000
CYDEV_VDDIO0_MV EQU 5000
CYDEV_VDDIO1_MV EQU 5000
CYDEV_VDDIO2_MV EQU 5000
CYDEV_VDDIO3_MV EQU 5000
CYDEV_VIO0_MV EQU 5000
CYDEV_VIO1_MV EQU 5000
CYDEV_VIO2_MV EQU 5000
CYDEV_VIO3_MV EQU 5000
CYIPBLOCK_ARM_CM3_VERSION EQU 0
CYIPBLOCK_P3_ANAIF_VERSION EQU 0
CYIPBLOCK_P3_CAN_VERSION EQU 0
CYIPBLOCK_P3_CAPSENSE_VERSION EQU 0
CYIPBLOCK_P3_COMP_VERSION EQU 0
CYIPBLOCK_P3_DECIMATOR_VERSION EQU 0
CYIPBLOCK_P3_DFB_VERSION EQU 0
CYIPBLOCK_P3_DMA_VERSION EQU 0
CYIPBLOCK_P3_DRQ_VERSION EQU 0
CYIPBLOCK_P3_DSM_VERSION EQU 0
CYIPBLOCK_P3_EMIF_VERSION EQU 0
CYIPBLOCK_P3_I2C_VERSION EQU 0
CYIPBLOCK_P3_LCD_VERSION EQU 0
CYIPBLOCK_P3_LPF_VERSION EQU 0
CYIPBLOCK_P3_OPAMP_VERSION EQU 0
CYIPBLOCK_P3_PM_VERSION EQU 0
CYIPBLOCK_P3_SCCT_VERSION EQU 0
CYIPBLOCK_P3_TIMER_VERSION EQU 0
CYIPBLOCK_P3_USB_VERSION EQU 0
CYIPBLOCK_P3_VIDAC_VERSION EQU 0
CYIPBLOCK_P3_VREF_VERSION EQU 0
CYIPBLOCK_S8_GPIO_VERSION EQU 0
CYIPBLOCK_S8_IRQ_VERSION EQU 0
CYIPBLOCK_S8_SAR_VERSION EQU 0
CYIPBLOCK_S8_SIO_VERSION EQU 0
CYIPBLOCK_S8_UDB_VERSION EQU 0
DMA_CHANNELS_USED__MASK0 EQU 0x00000003
CYDEV_BOOTLOADER_ENABLE EQU 0

#endif /* INCLUDED_CYFITTERIAR_INC */
