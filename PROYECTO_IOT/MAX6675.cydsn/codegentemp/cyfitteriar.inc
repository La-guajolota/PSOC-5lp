;
; File Name: cyfitteriar.inc
; 
; PSoC Creator  4.4
;
; Description:
; 
;
;-------------------------------------------------------------------------------
; Copyright (c) 2007-2020 Cypress Semiconductor.  All rights reserved.
; You may use this file only in accordance with the license, terms, conditions, 
; disclaimers, and limitations in the end user license agreement accompanying 
; the software package with which this file was provided.
;-------------------------------------------------------------------------------

#ifndef INCLUDED_CYFITTERIAR_INC
#define INCLUDED_CYFITTERIAR_INC
    INCLUDE cydeviceiar.inc
    INCLUDE cydeviceiar_trm.inc

/* E */
E__0__INTTYPE EQU CYREG_PICU3_INTTYPE3
E__0__MASK EQU 0x08
E__0__PC EQU CYREG_PRT3_PC3
E__0__PORT EQU 3
E__0__SHIFT EQU 3
E__AG EQU CYREG_PRT3_AG
E__AMUX EQU CYREG_PRT3_AMUX
E__BIE EQU CYREG_PRT3_BIE
E__BIT_MASK EQU CYREG_PRT3_BIT_MASK
E__BYP EQU CYREG_PRT3_BYP
E__CTL EQU CYREG_PRT3_CTL
E__DM0 EQU CYREG_PRT3_DM0
E__DM1 EQU CYREG_PRT3_DM1
E__DM2 EQU CYREG_PRT3_DM2
E__DR EQU CYREG_PRT3_DR
E__INP_DIS EQU CYREG_PRT3_INP_DIS
E__INTTYPE_BASE EQU CYDEV_PICU_INTTYPE_PICU3_BASE
E__LCD_COM_SEG EQU CYREG_PRT3_LCD_COM_SEG
E__LCD_EN EQU CYREG_PRT3_LCD_EN
E__MASK EQU 0x08
E__PORT EQU 3
E__PRT EQU CYREG_PRT3_PRT
E__PRTDSI__CAPS_SEL EQU CYREG_PRT3_CAPS_SEL
E__PRTDSI__DBL_SYNC_IN EQU CYREG_PRT3_DBL_SYNC_IN
E__PRTDSI__OE_SEL0 EQU CYREG_PRT3_OE_SEL0
E__PRTDSI__OE_SEL1 EQU CYREG_PRT3_OE_SEL1
E__PRTDSI__OUT_SEL0 EQU CYREG_PRT3_OUT_SEL0
E__PRTDSI__OUT_SEL1 EQU CYREG_PRT3_OUT_SEL1
E__PRTDSI__SYNC_OUT EQU CYREG_PRT3_SYNC_OUT
E__PS EQU CYREG_PRT3_PS
E__SHIFT EQU 3
E__SLW EQU CYREG_PRT3_SLW

/* D4 */
D4__0__INTTYPE EQU CYREG_PICU3_INTTYPE4
D4__0__MASK EQU 0x10
D4__0__PC EQU CYREG_PRT3_PC4
D4__0__PORT EQU 3
D4__0__SHIFT EQU 4
D4__AG EQU CYREG_PRT3_AG
D4__AMUX EQU CYREG_PRT3_AMUX
D4__BIE EQU CYREG_PRT3_BIE
D4__BIT_MASK EQU CYREG_PRT3_BIT_MASK
D4__BYP EQU CYREG_PRT3_BYP
D4__CTL EQU CYREG_PRT3_CTL
D4__DM0 EQU CYREG_PRT3_DM0
D4__DM1 EQU CYREG_PRT3_DM1
D4__DM2 EQU CYREG_PRT3_DM2
D4__DR EQU CYREG_PRT3_DR
D4__INP_DIS EQU CYREG_PRT3_INP_DIS
D4__INTTYPE_BASE EQU CYDEV_PICU_INTTYPE_PICU3_BASE
D4__LCD_COM_SEG EQU CYREG_PRT3_LCD_COM_SEG
D4__LCD_EN EQU CYREG_PRT3_LCD_EN
D4__MASK EQU 0x10
D4__PORT EQU 3
D4__PRT EQU CYREG_PRT3_PRT
D4__PRTDSI__CAPS_SEL EQU CYREG_PRT3_CAPS_SEL
D4__PRTDSI__DBL_SYNC_IN EQU CYREG_PRT3_DBL_SYNC_IN
D4__PRTDSI__OE_SEL0 EQU CYREG_PRT3_OE_SEL0
D4__PRTDSI__OE_SEL1 EQU CYREG_PRT3_OE_SEL1
D4__PRTDSI__OUT_SEL0 EQU CYREG_PRT3_OUT_SEL0
D4__PRTDSI__OUT_SEL1 EQU CYREG_PRT3_OUT_SEL1
D4__PRTDSI__SYNC_OUT EQU CYREG_PRT3_SYNC_OUT
D4__PS EQU CYREG_PRT3_PS
D4__SHIFT EQU 4
D4__SLW EQU CYREG_PRT3_SLW

/* D5 */
D5__0__INTTYPE EQU CYREG_PICU3_INTTYPE5
D5__0__MASK EQU 0x20
D5__0__PC EQU CYREG_PRT3_PC5
D5__0__PORT EQU 3
D5__0__SHIFT EQU 5
D5__AG EQU CYREG_PRT3_AG
D5__AMUX EQU CYREG_PRT3_AMUX
D5__BIE EQU CYREG_PRT3_BIE
D5__BIT_MASK EQU CYREG_PRT3_BIT_MASK
D5__BYP EQU CYREG_PRT3_BYP
D5__CTL EQU CYREG_PRT3_CTL
D5__DM0 EQU CYREG_PRT3_DM0
D5__DM1 EQU CYREG_PRT3_DM1
D5__DM2 EQU CYREG_PRT3_DM2
D5__DR EQU CYREG_PRT3_DR
D5__INP_DIS EQU CYREG_PRT3_INP_DIS
D5__INTTYPE_BASE EQU CYDEV_PICU_INTTYPE_PICU3_BASE
D5__LCD_COM_SEG EQU CYREG_PRT3_LCD_COM_SEG
D5__LCD_EN EQU CYREG_PRT3_LCD_EN
D5__MASK EQU 0x20
D5__PORT EQU 3
D5__PRT EQU CYREG_PRT3_PRT
D5__PRTDSI__CAPS_SEL EQU CYREG_PRT3_CAPS_SEL
D5__PRTDSI__DBL_SYNC_IN EQU CYREG_PRT3_DBL_SYNC_IN
D5__PRTDSI__OE_SEL0 EQU CYREG_PRT3_OE_SEL0
D5__PRTDSI__OE_SEL1 EQU CYREG_PRT3_OE_SEL1
D5__PRTDSI__OUT_SEL0 EQU CYREG_PRT3_OUT_SEL0
D5__PRTDSI__OUT_SEL1 EQU CYREG_PRT3_OUT_SEL1
D5__PRTDSI__SYNC_OUT EQU CYREG_PRT3_SYNC_OUT
D5__PS EQU CYREG_PRT3_PS
D5__SHIFT EQU 5
D5__SLW EQU CYREG_PRT3_SLW

/* D6 */
D6__0__INTTYPE EQU CYREG_PICU3_INTTYPE6
D6__0__MASK EQU 0x40
D6__0__PC EQU CYREG_PRT3_PC6
D6__0__PORT EQU 3
D6__0__SHIFT EQU 6
D6__AG EQU CYREG_PRT3_AG
D6__AMUX EQU CYREG_PRT3_AMUX
D6__BIE EQU CYREG_PRT3_BIE
D6__BIT_MASK EQU CYREG_PRT3_BIT_MASK
D6__BYP EQU CYREG_PRT3_BYP
D6__CTL EQU CYREG_PRT3_CTL
D6__DM0 EQU CYREG_PRT3_DM0
D6__DM1 EQU CYREG_PRT3_DM1
D6__DM2 EQU CYREG_PRT3_DM2
D6__DR EQU CYREG_PRT3_DR
D6__INP_DIS EQU CYREG_PRT3_INP_DIS
D6__INTTYPE_BASE EQU CYDEV_PICU_INTTYPE_PICU3_BASE
D6__LCD_COM_SEG EQU CYREG_PRT3_LCD_COM_SEG
D6__LCD_EN EQU CYREG_PRT3_LCD_EN
D6__MASK EQU 0x40
D6__PORT EQU 3
D6__PRT EQU CYREG_PRT3_PRT
D6__PRTDSI__CAPS_SEL EQU CYREG_PRT3_CAPS_SEL
D6__PRTDSI__DBL_SYNC_IN EQU CYREG_PRT3_DBL_SYNC_IN
D6__PRTDSI__OE_SEL0 EQU CYREG_PRT3_OE_SEL0
D6__PRTDSI__OE_SEL1 EQU CYREG_PRT3_OE_SEL1
D6__PRTDSI__OUT_SEL0 EQU CYREG_PRT3_OUT_SEL0
D6__PRTDSI__OUT_SEL1 EQU CYREG_PRT3_OUT_SEL1
D6__PRTDSI__SYNC_OUT EQU CYREG_PRT3_SYNC_OUT
D6__PS EQU CYREG_PRT3_PS
D6__SHIFT EQU 6
D6__SLW EQU CYREG_PRT3_SLW

/* D7 */
D7__0__INTTYPE EQU CYREG_PICU3_INTTYPE7
D7__0__MASK EQU 0x80
D7__0__PC EQU CYREG_PRT3_PC7
D7__0__PORT EQU 3
D7__0__SHIFT EQU 7
D7__AG EQU CYREG_PRT3_AG
D7__AMUX EQU CYREG_PRT3_AMUX
D7__BIE EQU CYREG_PRT3_BIE
D7__BIT_MASK EQU CYREG_PRT3_BIT_MASK
D7__BYP EQU CYREG_PRT3_BYP
D7__CTL EQU CYREG_PRT3_CTL
D7__DM0 EQU CYREG_PRT3_DM0
D7__DM1 EQU CYREG_PRT3_DM1
D7__DM2 EQU CYREG_PRT3_DM2
D7__DR EQU CYREG_PRT3_DR
D7__INP_DIS EQU CYREG_PRT3_INP_DIS
D7__INTTYPE_BASE EQU CYDEV_PICU_INTTYPE_PICU3_BASE
D7__LCD_COM_SEG EQU CYREG_PRT3_LCD_COM_SEG
D7__LCD_EN EQU CYREG_PRT3_LCD_EN
D7__MASK EQU 0x80
D7__PORT EQU 3
D7__PRT EQU CYREG_PRT3_PRT
D7__PRTDSI__CAPS_SEL EQU CYREG_PRT3_CAPS_SEL
D7__PRTDSI__DBL_SYNC_IN EQU CYREG_PRT3_DBL_SYNC_IN
D7__PRTDSI__OE_SEL0 EQU CYREG_PRT3_OE_SEL0
D7__PRTDSI__OE_SEL1 EQU CYREG_PRT3_OE_SEL1
D7__PRTDSI__OUT_SEL0 EQU CYREG_PRT3_OUT_SEL0
D7__PRTDSI__OUT_SEL1 EQU CYREG_PRT3_OUT_SEL1
D7__PRTDSI__SYNC_OUT EQU CYREG_PRT3_SYNC_OUT
D7__PS EQU CYREG_PRT3_PS
D7__SHIFT EQU 7
D7__SLW EQU CYREG_PRT3_SLW

/* RS */
RS__0__INTTYPE EQU CYREG_PICU3_INTTYPE2
RS__0__MASK EQU 0x04
RS__0__PC EQU CYREG_PRT3_PC2
RS__0__PORT EQU 3
RS__0__SHIFT EQU 2
RS__AG EQU CYREG_PRT3_AG
RS__AMUX EQU CYREG_PRT3_AMUX
RS__BIE EQU CYREG_PRT3_BIE
RS__BIT_MASK EQU CYREG_PRT3_BIT_MASK
RS__BYP EQU CYREG_PRT3_BYP
RS__CTL EQU CYREG_PRT3_CTL
RS__DM0 EQU CYREG_PRT3_DM0
RS__DM1 EQU CYREG_PRT3_DM1
RS__DM2 EQU CYREG_PRT3_DM2
RS__DR EQU CYREG_PRT3_DR
RS__INP_DIS EQU CYREG_PRT3_INP_DIS
RS__INTTYPE_BASE EQU CYDEV_PICU_INTTYPE_PICU3_BASE
RS__LCD_COM_SEG EQU CYREG_PRT3_LCD_COM_SEG
RS__LCD_EN EQU CYREG_PRT3_LCD_EN
RS__MASK EQU 0x04
RS__PORT EQU 3
RS__PRT EQU CYREG_PRT3_PRT
RS__PRTDSI__CAPS_SEL EQU CYREG_PRT3_CAPS_SEL
RS__PRTDSI__DBL_SYNC_IN EQU CYREG_PRT3_DBL_SYNC_IN
RS__PRTDSI__OE_SEL0 EQU CYREG_PRT3_OE_SEL0
RS__PRTDSI__OE_SEL1 EQU CYREG_PRT3_OE_SEL1
RS__PRTDSI__OUT_SEL0 EQU CYREG_PRT3_OUT_SEL0
RS__PRTDSI__OUT_SEL1 EQU CYREG_PRT3_OUT_SEL1
RS__PRTDSI__SYNC_OUT EQU CYREG_PRT3_SYNC_OUT
RS__PS EQU CYREG_PRT3_PS
RS__SHIFT EQU 2
RS__SLW EQU CYREG_PRT3_SLW

/* LCD */
LCD_Sync_ctrl_reg__0__MASK EQU 0x01
LCD_Sync_ctrl_reg__0__POS EQU 0
LCD_Sync_ctrl_reg__1__MASK EQU 0x02
LCD_Sync_ctrl_reg__1__POS EQU 1
LCD_Sync_ctrl_reg__16BIT_CONTROL_AUX_CTL_REG EQU CYREG_B1_UDB05_06_ACTL
LCD_Sync_ctrl_reg__16BIT_CONTROL_CONTROL_REG EQU CYREG_B1_UDB05_06_CTL
LCD_Sync_ctrl_reg__16BIT_CONTROL_COUNT_REG EQU CYREG_B1_UDB05_06_CTL
LCD_Sync_ctrl_reg__16BIT_COUNT_CONTROL_REG EQU CYREG_B1_UDB05_06_CTL
LCD_Sync_ctrl_reg__16BIT_COUNT_COUNT_REG EQU CYREG_B1_UDB05_06_CTL
LCD_Sync_ctrl_reg__16BIT_MASK_MASK_REG EQU CYREG_B1_UDB05_06_MSK
LCD_Sync_ctrl_reg__16BIT_MASK_PERIOD_REG EQU CYREG_B1_UDB05_06_MSK
LCD_Sync_ctrl_reg__16BIT_PERIOD_MASK_REG EQU CYREG_B1_UDB05_06_MSK
LCD_Sync_ctrl_reg__16BIT_PERIOD_PERIOD_REG EQU CYREG_B1_UDB05_06_MSK
LCD_Sync_ctrl_reg__2__MASK EQU 0x04
LCD_Sync_ctrl_reg__2__POS EQU 2
LCD_Sync_ctrl_reg__3__MASK EQU 0x08
LCD_Sync_ctrl_reg__3__POS EQU 3
LCD_Sync_ctrl_reg__4__MASK EQU 0x10
LCD_Sync_ctrl_reg__4__POS EQU 4
LCD_Sync_ctrl_reg__5__MASK EQU 0x20
LCD_Sync_ctrl_reg__5__POS EQU 5
LCD_Sync_ctrl_reg__CONTROL_AUX_CTL_REG EQU CYREG_B1_UDB05_ACTL
LCD_Sync_ctrl_reg__CONTROL_REG EQU CYREG_B1_UDB05_CTL
LCD_Sync_ctrl_reg__CONTROL_ST_REG EQU CYREG_B1_UDB05_ST_CTL
LCD_Sync_ctrl_reg__COUNT_REG EQU CYREG_B1_UDB05_CTL
LCD_Sync_ctrl_reg__COUNT_ST_REG EQU CYREG_B1_UDB05_ST_CTL
LCD_Sync_ctrl_reg__MASK EQU 0x3F
LCD_Sync_ctrl_reg__MASK_CTL_AUX_CTL_REG EQU CYREG_B1_UDB05_MSK_ACTL
LCD_Sync_ctrl_reg__PER_CTL_AUX_CTL_REG EQU CYREG_B1_UDB05_MSK_ACTL
LCD_Sync_ctrl_reg__PERIOD_REG EQU CYREG_B1_UDB05_MSK

/* MISO */
MISO__0__INTTYPE EQU CYREG_PICU15_INTTYPE3
MISO__0__MASK EQU 0x08
MISO__0__PC EQU CYREG_IO_PC_PRT15_PC3
MISO__0__PORT EQU 15
MISO__0__SHIFT EQU 3
MISO__AG EQU CYREG_PRT15_AG
MISO__AMUX EQU CYREG_PRT15_AMUX
MISO__BIE EQU CYREG_PRT15_BIE
MISO__BIT_MASK EQU CYREG_PRT15_BIT_MASK
MISO__BYP EQU CYREG_PRT15_BYP
MISO__CTL EQU CYREG_PRT15_CTL
MISO__DM0 EQU CYREG_PRT15_DM0
MISO__DM1 EQU CYREG_PRT15_DM1
MISO__DM2 EQU CYREG_PRT15_DM2
MISO__DR EQU CYREG_PRT15_DR
MISO__INP_DIS EQU CYREG_PRT15_INP_DIS
MISO__INTTYPE_BASE EQU CYDEV_PICU_INTTYPE_PICU15_BASE
MISO__LCD_COM_SEG EQU CYREG_PRT15_LCD_COM_SEG
MISO__LCD_EN EQU CYREG_PRT15_LCD_EN
MISO__MASK EQU 0x08
MISO__PORT EQU 15
MISO__PRT EQU CYREG_PRT15_PRT
MISO__PRTDSI__CAPS_SEL EQU CYREG_PRT15_CAPS_SEL
MISO__PRTDSI__DBL_SYNC_IN EQU CYREG_PRT15_DBL_SYNC_IN
MISO__PRTDSI__OE_SEL0 EQU CYREG_PRT15_OE_SEL0
MISO__PRTDSI__OE_SEL1 EQU CYREG_PRT15_OE_SEL1
MISO__PRTDSI__OUT_SEL0 EQU CYREG_PRT15_OUT_SEL0
MISO__PRTDSI__OUT_SEL1 EQU CYREG_PRT15_OUT_SEL1
MISO__PRTDSI__SYNC_OUT EQU CYREG_PRT15_SYNC_OUT
MISO__PS EQU CYREG_PRT15_PS
MISO__SHIFT EQU 3
MISO__SLW EQU CYREG_PRT15_SLW

/* Rx_1 */
Rx_1__0__INTTYPE EQU CYREG_PICU12_INTTYPE6
Rx_1__0__MASK EQU 0x40
Rx_1__0__PC EQU CYREG_PRT12_PC6
Rx_1__0__PORT EQU 12
Rx_1__0__SHIFT EQU 6
Rx_1__AG EQU CYREG_PRT12_AG
Rx_1__BIE EQU CYREG_PRT12_BIE
Rx_1__BIT_MASK EQU CYREG_PRT12_BIT_MASK
Rx_1__BYP EQU CYREG_PRT12_BYP
Rx_1__DM0 EQU CYREG_PRT12_DM0
Rx_1__DM1 EQU CYREG_PRT12_DM1
Rx_1__DM2 EQU CYREG_PRT12_DM2
Rx_1__DR EQU CYREG_PRT12_DR
Rx_1__INP_DIS EQU CYREG_PRT12_INP_DIS
Rx_1__INTTYPE_BASE EQU CYDEV_PICU_INTTYPE_PICU12_BASE
Rx_1__MASK EQU 0x40
Rx_1__PORT EQU 12
Rx_1__PRT EQU CYREG_PRT12_PRT
Rx_1__PRTDSI__DBL_SYNC_IN EQU CYREG_PRT12_DBL_SYNC_IN
Rx_1__PRTDSI__OE_SEL0 EQU CYREG_PRT12_OE_SEL0
Rx_1__PRTDSI__OE_SEL1 EQU CYREG_PRT12_OE_SEL1
Rx_1__PRTDSI__OUT_SEL0 EQU CYREG_PRT12_OUT_SEL0
Rx_1__PRTDSI__OUT_SEL1 EQU CYREG_PRT12_OUT_SEL1
Rx_1__PRTDSI__SYNC_OUT EQU CYREG_PRT12_SYNC_OUT
Rx_1__PS EQU CYREG_PRT12_PS
Rx_1__SHIFT EQU 6
Rx_1__SIO_CFG EQU CYREG_PRT12_SIO_CFG
Rx_1__SIO_DIFF EQU CYREG_PRT12_SIO_DIFF
Rx_1__SIO_HYST_EN EQU CYREG_PRT12_SIO_HYST_EN
Rx_1__SIO_REG_HIFREQ EQU CYREG_PRT12_SIO_REG_HIFREQ
Rx_1__SLW EQU CYREG_PRT12_SLW

/* SPIM */
SPIM_BSPIM_BitCounter__16BIT_CONTROL_AUX_CTL_REG EQU CYREG_B1_UDB08_09_ACTL
SPIM_BSPIM_BitCounter__16BIT_CONTROL_CONTROL_REG EQU CYREG_B1_UDB08_09_CTL
SPIM_BSPIM_BitCounter__16BIT_CONTROL_COUNT_REG EQU CYREG_B1_UDB08_09_CTL
SPIM_BSPIM_BitCounter__16BIT_COUNT_CONTROL_REG EQU CYREG_B1_UDB08_09_CTL
SPIM_BSPIM_BitCounter__16BIT_COUNT_COUNT_REG EQU CYREG_B1_UDB08_09_CTL
SPIM_BSPIM_BitCounter__16BIT_MASK_MASK_REG EQU CYREG_B1_UDB08_09_MSK
SPIM_BSPIM_BitCounter__16BIT_MASK_PERIOD_REG EQU CYREG_B1_UDB08_09_MSK
SPIM_BSPIM_BitCounter__16BIT_PERIOD_MASK_REG EQU CYREG_B1_UDB08_09_MSK
SPIM_BSPIM_BitCounter__16BIT_PERIOD_PERIOD_REG EQU CYREG_B1_UDB08_09_MSK
SPIM_BSPIM_BitCounter__CONTROL_AUX_CTL_REG EQU CYREG_B1_UDB08_ACTL
SPIM_BSPIM_BitCounter__CONTROL_REG EQU CYREG_B1_UDB08_CTL
SPIM_BSPIM_BitCounter__CONTROL_ST_REG EQU CYREG_B1_UDB08_ST_CTL
SPIM_BSPIM_BitCounter__COUNT_REG EQU CYREG_B1_UDB08_CTL
SPIM_BSPIM_BitCounter__COUNT_ST_REG EQU CYREG_B1_UDB08_ST_CTL
SPIM_BSPIM_BitCounter__MASK_CTL_AUX_CTL_REG EQU CYREG_B1_UDB08_MSK_ACTL
SPIM_BSPIM_BitCounter__PER_CTL_AUX_CTL_REG EQU CYREG_B1_UDB08_MSK_ACTL
SPIM_BSPIM_BitCounter__PERIOD_REG EQU CYREG_B1_UDB08_MSK
SPIM_BSPIM_BitCounter_ST__16BIT_STATUS_AUX_CTL_REG EQU CYREG_B1_UDB08_09_ACTL
SPIM_BSPIM_BitCounter_ST__16BIT_STATUS_REG EQU CYREG_B1_UDB08_09_ST
SPIM_BSPIM_BitCounter_ST__MASK_REG EQU CYREG_B1_UDB08_MSK
SPIM_BSPIM_BitCounter_ST__MASK_ST_AUX_CTL_REG EQU CYREG_B1_UDB08_MSK_ACTL
SPIM_BSPIM_BitCounter_ST__PER_ST_AUX_CTL_REG EQU CYREG_B1_UDB08_MSK_ACTL
SPIM_BSPIM_BitCounter_ST__STATUS_AUX_CTL_REG EQU CYREG_B1_UDB08_ACTL
SPIM_BSPIM_BitCounter_ST__STATUS_CNT_REG EQU CYREG_B1_UDB08_ST_CTL
SPIM_BSPIM_BitCounter_ST__STATUS_CONTROL_REG EQU CYREG_B1_UDB08_ST_CTL
SPIM_BSPIM_BitCounter_ST__STATUS_REG EQU CYREG_B1_UDB08_ST
SPIM_BSPIM_RxStsReg__16BIT_STATUS_AUX_CTL_REG EQU CYREG_B1_UDB05_06_ACTL
SPIM_BSPIM_RxStsReg__16BIT_STATUS_REG EQU CYREG_B1_UDB05_06_ST
SPIM_BSPIM_RxStsReg__4__MASK EQU 0x10
SPIM_BSPIM_RxStsReg__4__POS EQU 4
SPIM_BSPIM_RxStsReg__5__MASK EQU 0x20
SPIM_BSPIM_RxStsReg__5__POS EQU 5
SPIM_BSPIM_RxStsReg__6__MASK EQU 0x40
SPIM_BSPIM_RxStsReg__6__POS EQU 6
SPIM_BSPIM_RxStsReg__MASK EQU 0x70
SPIM_BSPIM_RxStsReg__MASK_REG EQU CYREG_B1_UDB05_MSK
SPIM_BSPIM_RxStsReg__MASK_ST_AUX_CTL_REG EQU CYREG_B1_UDB05_MSK_ACTL
SPIM_BSPIM_RxStsReg__PER_ST_AUX_CTL_REG EQU CYREG_B1_UDB05_MSK_ACTL
SPIM_BSPIM_RxStsReg__STATUS_AUX_CTL_REG EQU CYREG_B1_UDB05_ACTL
SPIM_BSPIM_RxStsReg__STATUS_CNT_REG EQU CYREG_B1_UDB05_ST_CTL
SPIM_BSPIM_RxStsReg__STATUS_CONTROL_REG EQU CYREG_B1_UDB05_ST_CTL
SPIM_BSPIM_RxStsReg__STATUS_REG EQU CYREG_B1_UDB05_ST
SPIM_BSPIM_sR16_Dp_u0__16BIT_A0_REG EQU CYREG_B1_UDB04_05_A0
SPIM_BSPIM_sR16_Dp_u0__16BIT_A1_REG EQU CYREG_B1_UDB04_05_A1
SPIM_BSPIM_sR16_Dp_u0__16BIT_D0_REG EQU CYREG_B1_UDB04_05_D0
SPIM_BSPIM_sR16_Dp_u0__16BIT_D1_REG EQU CYREG_B1_UDB04_05_D1
SPIM_BSPIM_sR16_Dp_u0__16BIT_DP_AUX_CTL_REG EQU CYREG_B1_UDB04_05_ACTL
SPIM_BSPIM_sR16_Dp_u0__16BIT_F0_REG EQU CYREG_B1_UDB04_05_F0
SPIM_BSPIM_sR16_Dp_u0__16BIT_F1_REG EQU CYREG_B1_UDB04_05_F1
SPIM_BSPIM_sR16_Dp_u0__A0_A1_REG EQU CYREG_B1_UDB04_A0_A1
SPIM_BSPIM_sR16_Dp_u0__A0_REG EQU CYREG_B1_UDB04_A0
SPIM_BSPIM_sR16_Dp_u0__A1_REG EQU CYREG_B1_UDB04_A1
SPIM_BSPIM_sR16_Dp_u0__D0_D1_REG EQU CYREG_B1_UDB04_D0_D1
SPIM_BSPIM_sR16_Dp_u0__D0_REG EQU CYREG_B1_UDB04_D0
SPIM_BSPIM_sR16_Dp_u0__D1_REG EQU CYREG_B1_UDB04_D1
SPIM_BSPIM_sR16_Dp_u0__DP_AUX_CTL_REG EQU CYREG_B1_UDB04_ACTL
SPIM_BSPIM_sR16_Dp_u0__F0_F1_REG EQU CYREG_B1_UDB04_F0_F1
SPIM_BSPIM_sR16_Dp_u0__F0_REG EQU CYREG_B1_UDB04_F0
SPIM_BSPIM_sR16_Dp_u0__F1_REG EQU CYREG_B1_UDB04_F1
SPIM_BSPIM_sR16_Dp_u1__16BIT_A0_REG EQU CYREG_B1_UDB05_06_A0
SPIM_BSPIM_sR16_Dp_u1__16BIT_A1_REG EQU CYREG_B1_UDB05_06_A1
SPIM_BSPIM_sR16_Dp_u1__16BIT_D0_REG EQU CYREG_B1_UDB05_06_D0
SPIM_BSPIM_sR16_Dp_u1__16BIT_D1_REG EQU CYREG_B1_UDB05_06_D1
SPIM_BSPIM_sR16_Dp_u1__16BIT_DP_AUX_CTL_REG EQU CYREG_B1_UDB05_06_ACTL
SPIM_BSPIM_sR16_Dp_u1__16BIT_F0_REG EQU CYREG_B1_UDB05_06_F0
SPIM_BSPIM_sR16_Dp_u1__16BIT_F1_REG EQU CYREG_B1_UDB05_06_F1
SPIM_BSPIM_sR16_Dp_u1__A0_A1_REG EQU CYREG_B1_UDB05_A0_A1
SPIM_BSPIM_sR16_Dp_u1__A0_REG EQU CYREG_B1_UDB05_A0
SPIM_BSPIM_sR16_Dp_u1__A1_REG EQU CYREG_B1_UDB05_A1
SPIM_BSPIM_sR16_Dp_u1__D0_D1_REG EQU CYREG_B1_UDB05_D0_D1
SPIM_BSPIM_sR16_Dp_u1__D0_REG EQU CYREG_B1_UDB05_D0
SPIM_BSPIM_sR16_Dp_u1__D1_REG EQU CYREG_B1_UDB05_D1
SPIM_BSPIM_sR16_Dp_u1__DP_AUX_CTL_REG EQU CYREG_B1_UDB05_ACTL
SPIM_BSPIM_sR16_Dp_u1__F0_F1_REG EQU CYREG_B1_UDB05_F0_F1
SPIM_BSPIM_sR16_Dp_u1__F0_REG EQU CYREG_B1_UDB05_F0
SPIM_BSPIM_sR16_Dp_u1__F1_REG EQU CYREG_B1_UDB05_F1
SPIM_BSPIM_sR16_Dp_u1__MSK_DP_AUX_CTL_REG EQU CYREG_B1_UDB05_MSK_ACTL
SPIM_BSPIM_sR16_Dp_u1__PER_DP_AUX_CTL_REG EQU CYREG_B1_UDB05_MSK_ACTL
SPIM_BSPIM_TxStsReg__0__MASK EQU 0x01
SPIM_BSPIM_TxStsReg__0__POS EQU 0
SPIM_BSPIM_TxStsReg__1__MASK EQU 0x02
SPIM_BSPIM_TxStsReg__1__POS EQU 1
SPIM_BSPIM_TxStsReg__2__MASK EQU 0x04
SPIM_BSPIM_TxStsReg__2__POS EQU 2
SPIM_BSPIM_TxStsReg__3__MASK EQU 0x08
SPIM_BSPIM_TxStsReg__3__POS EQU 3
SPIM_BSPIM_TxStsReg__4__MASK EQU 0x10
SPIM_BSPIM_TxStsReg__4__POS EQU 4
SPIM_BSPIM_TxStsReg__MASK EQU 0x1F
SPIM_BSPIM_TxStsReg__MASK_REG EQU CYREG_B1_UDB11_MSK
SPIM_BSPIM_TxStsReg__STATUS_AUX_CTL_REG EQU CYREG_B1_UDB11_ACTL
SPIM_BSPIM_TxStsReg__STATUS_REG EQU CYREG_B1_UDB11_ST
SPIM_IntClock__CFG0 EQU CYREG_CLKDIST_DCFG0_CFG0
SPIM_IntClock__CFG1 EQU CYREG_CLKDIST_DCFG0_CFG1
SPIM_IntClock__CFG2 EQU CYREG_CLKDIST_DCFG0_CFG2
SPIM_IntClock__CFG2_SRC_SEL_MASK EQU 0x07
SPIM_IntClock__INDEX EQU 0x00
SPIM_IntClock__PM_ACT_CFG EQU CYREG_PM_ACT_CFG2
SPIM_IntClock__PM_ACT_MSK EQU 0x01
SPIM_IntClock__PM_STBY_CFG EQU CYREG_PM_STBY_CFG2
SPIM_IntClock__PM_STBY_MSK EQU 0x01

/* Tx_1 */
Tx_1__0__INTTYPE EQU CYREG_PICU12_INTTYPE7
Tx_1__0__MASK EQU 0x80
Tx_1__0__PC EQU CYREG_PRT12_PC7
Tx_1__0__PORT EQU 12
Tx_1__0__SHIFT EQU 7
Tx_1__AG EQU CYREG_PRT12_AG
Tx_1__BIE EQU CYREG_PRT12_BIE
Tx_1__BIT_MASK EQU CYREG_PRT12_BIT_MASK
Tx_1__BYP EQU CYREG_PRT12_BYP
Tx_1__DM0 EQU CYREG_PRT12_DM0
Tx_1__DM1 EQU CYREG_PRT12_DM1
Tx_1__DM2 EQU CYREG_PRT12_DM2
Tx_1__DR EQU CYREG_PRT12_DR
Tx_1__INP_DIS EQU CYREG_PRT12_INP_DIS
Tx_1__INTTYPE_BASE EQU CYDEV_PICU_INTTYPE_PICU12_BASE
Tx_1__MASK EQU 0x80
Tx_1__PORT EQU 12
Tx_1__PRT EQU CYREG_PRT12_PRT
Tx_1__PRTDSI__DBL_SYNC_IN EQU CYREG_PRT12_DBL_SYNC_IN
Tx_1__PRTDSI__OE_SEL0 EQU CYREG_PRT12_OE_SEL0
Tx_1__PRTDSI__OE_SEL1 EQU CYREG_PRT12_OE_SEL1
Tx_1__PRTDSI__OUT_SEL0 EQU CYREG_PRT12_OUT_SEL0
Tx_1__PRTDSI__OUT_SEL1 EQU CYREG_PRT12_OUT_SEL1
Tx_1__PRTDSI__SYNC_OUT EQU CYREG_PRT12_SYNC_OUT
Tx_1__PS EQU CYREG_PRT12_PS
Tx_1__SHIFT EQU 7
Tx_1__SIO_CFG EQU CYREG_PRT12_SIO_CFG
Tx_1__SIO_DIFF EQU CYREG_PRT12_SIO_DIFF
Tx_1__SIO_HYST_EN EQU CYREG_PRT12_SIO_HYST_EN
Tx_1__SIO_REG_HIFREQ EQU CYREG_PRT12_SIO_REG_HIFREQ
Tx_1__SLW EQU CYREG_PRT12_SLW

/* UART */
UART_BUART_sRX_RxBitCounter__16BIT_CONTROL_AUX_CTL_REG EQU CYREG_B1_UDB09_10_ACTL
UART_BUART_sRX_RxBitCounter__16BIT_CONTROL_CONTROL_REG EQU CYREG_B1_UDB09_10_CTL
UART_BUART_sRX_RxBitCounter__16BIT_CONTROL_COUNT_REG EQU CYREG_B1_UDB09_10_CTL
UART_BUART_sRX_RxBitCounter__16BIT_COUNT_CONTROL_REG EQU CYREG_B1_UDB09_10_CTL
UART_BUART_sRX_RxBitCounter__16BIT_COUNT_COUNT_REG EQU CYREG_B1_UDB09_10_CTL
UART_BUART_sRX_RxBitCounter__16BIT_MASK_MASK_REG EQU CYREG_B1_UDB09_10_MSK
UART_BUART_sRX_RxBitCounter__16BIT_MASK_PERIOD_REG EQU CYREG_B1_UDB09_10_MSK
UART_BUART_sRX_RxBitCounter__16BIT_PERIOD_MASK_REG EQU CYREG_B1_UDB09_10_MSK
UART_BUART_sRX_RxBitCounter__16BIT_PERIOD_PERIOD_REG EQU CYREG_B1_UDB09_10_MSK
UART_BUART_sRX_RxBitCounter__CONTROL_AUX_CTL_REG EQU CYREG_B1_UDB09_ACTL
UART_BUART_sRX_RxBitCounter__CONTROL_REG EQU CYREG_B1_UDB09_CTL
UART_BUART_sRX_RxBitCounter__CONTROL_ST_REG EQU CYREG_B1_UDB09_ST_CTL
UART_BUART_sRX_RxBitCounter__COUNT_REG EQU CYREG_B1_UDB09_CTL
UART_BUART_sRX_RxBitCounter__COUNT_ST_REG EQU CYREG_B1_UDB09_ST_CTL
UART_BUART_sRX_RxBitCounter__MASK_CTL_AUX_CTL_REG EQU CYREG_B1_UDB09_MSK_ACTL
UART_BUART_sRX_RxBitCounter__PER_CTL_AUX_CTL_REG EQU CYREG_B1_UDB09_MSK_ACTL
UART_BUART_sRX_RxBitCounter__PERIOD_REG EQU CYREG_B1_UDB09_MSK
UART_BUART_sRX_RxBitCounter_ST__16BIT_STATUS_AUX_CTL_REG EQU CYREG_B1_UDB09_10_ACTL
UART_BUART_sRX_RxBitCounter_ST__16BIT_STATUS_REG EQU CYREG_B1_UDB09_10_ST
UART_BUART_sRX_RxBitCounter_ST__MASK_REG EQU CYREG_B1_UDB09_MSK
UART_BUART_sRX_RxBitCounter_ST__MASK_ST_AUX_CTL_REG EQU CYREG_B1_UDB09_MSK_ACTL
UART_BUART_sRX_RxBitCounter_ST__PER_ST_AUX_CTL_REG EQU CYREG_B1_UDB09_MSK_ACTL
UART_BUART_sRX_RxBitCounter_ST__STATUS_AUX_CTL_REG EQU CYREG_B1_UDB09_ACTL
UART_BUART_sRX_RxBitCounter_ST__STATUS_CNT_REG EQU CYREG_B1_UDB09_ST_CTL
UART_BUART_sRX_RxBitCounter_ST__STATUS_CONTROL_REG EQU CYREG_B1_UDB09_ST_CTL
UART_BUART_sRX_RxBitCounter_ST__STATUS_REG EQU CYREG_B1_UDB09_ST
UART_BUART_sRX_RxShifter_u0__16BIT_A0_REG EQU CYREG_B1_UDB09_10_A0
UART_BUART_sRX_RxShifter_u0__16BIT_A1_REG EQU CYREG_B1_UDB09_10_A1
UART_BUART_sRX_RxShifter_u0__16BIT_D0_REG EQU CYREG_B1_UDB09_10_D0
UART_BUART_sRX_RxShifter_u0__16BIT_D1_REG EQU CYREG_B1_UDB09_10_D1
UART_BUART_sRX_RxShifter_u0__16BIT_DP_AUX_CTL_REG EQU CYREG_B1_UDB09_10_ACTL
UART_BUART_sRX_RxShifter_u0__16BIT_F0_REG EQU CYREG_B1_UDB09_10_F0
UART_BUART_sRX_RxShifter_u0__16BIT_F1_REG EQU CYREG_B1_UDB09_10_F1
UART_BUART_sRX_RxShifter_u0__A0_A1_REG EQU CYREG_B1_UDB09_A0_A1
UART_BUART_sRX_RxShifter_u0__A0_REG EQU CYREG_B1_UDB09_A0
UART_BUART_sRX_RxShifter_u0__A1_REG EQU CYREG_B1_UDB09_A1
UART_BUART_sRX_RxShifter_u0__D0_D1_REG EQU CYREG_B1_UDB09_D0_D1
UART_BUART_sRX_RxShifter_u0__D0_REG EQU CYREG_B1_UDB09_D0
UART_BUART_sRX_RxShifter_u0__D1_REG EQU CYREG_B1_UDB09_D1
UART_BUART_sRX_RxShifter_u0__DP_AUX_CTL_REG EQU CYREG_B1_UDB09_ACTL
UART_BUART_sRX_RxShifter_u0__F0_F1_REG EQU CYREG_B1_UDB09_F0_F1
UART_BUART_sRX_RxShifter_u0__F0_REG EQU CYREG_B1_UDB09_F0
UART_BUART_sRX_RxShifter_u0__F1_REG EQU CYREG_B1_UDB09_F1
UART_BUART_sRX_RxShifter_u0__MSK_DP_AUX_CTL_REG EQU CYREG_B1_UDB09_MSK_ACTL
UART_BUART_sRX_RxShifter_u0__PER_DP_AUX_CTL_REG EQU CYREG_B1_UDB09_MSK_ACTL
UART_BUART_sRX_RxSts__16BIT_STATUS_AUX_CTL_REG EQU CYREG_B0_UDB09_10_ACTL
UART_BUART_sRX_RxSts__16BIT_STATUS_REG EQU CYREG_B0_UDB09_10_ST
UART_BUART_sRX_RxSts__3__MASK EQU 0x08
UART_BUART_sRX_RxSts__3__POS EQU 3
UART_BUART_sRX_RxSts__4__MASK EQU 0x10
UART_BUART_sRX_RxSts__4__POS EQU 4
UART_BUART_sRX_RxSts__5__MASK EQU 0x20
UART_BUART_sRX_RxSts__5__POS EQU 5
UART_BUART_sRX_RxSts__MASK EQU 0x38
UART_BUART_sRX_RxSts__MASK_REG EQU CYREG_B0_UDB09_MSK
UART_BUART_sRX_RxSts__STATUS_AUX_CTL_REG EQU CYREG_B0_UDB09_ACTL
UART_BUART_sRX_RxSts__STATUS_REG EQU CYREG_B0_UDB09_ST
UART_BUART_sTX_sCLOCK_TxBitClkGen__16BIT_A0_REG EQU CYREG_B1_UDB08_09_A0
UART_BUART_sTX_sCLOCK_TxBitClkGen__16BIT_A1_REG EQU CYREG_B1_UDB08_09_A1
UART_BUART_sTX_sCLOCK_TxBitClkGen__16BIT_D0_REG EQU CYREG_B1_UDB08_09_D0
UART_BUART_sTX_sCLOCK_TxBitClkGen__16BIT_D1_REG EQU CYREG_B1_UDB08_09_D1
UART_BUART_sTX_sCLOCK_TxBitClkGen__16BIT_DP_AUX_CTL_REG EQU CYREG_B1_UDB08_09_ACTL
UART_BUART_sTX_sCLOCK_TxBitClkGen__16BIT_F0_REG EQU CYREG_B1_UDB08_09_F0
UART_BUART_sTX_sCLOCK_TxBitClkGen__16BIT_F1_REG EQU CYREG_B1_UDB08_09_F1
UART_BUART_sTX_sCLOCK_TxBitClkGen__A0_A1_REG EQU CYREG_B1_UDB08_A0_A1
UART_BUART_sTX_sCLOCK_TxBitClkGen__A0_REG EQU CYREG_B1_UDB08_A0
UART_BUART_sTX_sCLOCK_TxBitClkGen__A1_REG EQU CYREG_B1_UDB08_A1
UART_BUART_sTX_sCLOCK_TxBitClkGen__D0_D1_REG EQU CYREG_B1_UDB08_D0_D1
UART_BUART_sTX_sCLOCK_TxBitClkGen__D0_REG EQU CYREG_B1_UDB08_D0
UART_BUART_sTX_sCLOCK_TxBitClkGen__D1_REG EQU CYREG_B1_UDB08_D1
UART_BUART_sTX_sCLOCK_TxBitClkGen__DP_AUX_CTL_REG EQU CYREG_B1_UDB08_ACTL
UART_BUART_sTX_sCLOCK_TxBitClkGen__F0_F1_REG EQU CYREG_B1_UDB08_F0_F1
UART_BUART_sTX_sCLOCK_TxBitClkGen__F0_REG EQU CYREG_B1_UDB08_F0
UART_BUART_sTX_sCLOCK_TxBitClkGen__F1_REG EQU CYREG_B1_UDB08_F1
UART_BUART_sTX_sCLOCK_TxBitClkGen__MSK_DP_AUX_CTL_REG EQU CYREG_B1_UDB08_MSK_ACTL
UART_BUART_sTX_sCLOCK_TxBitClkGen__PER_DP_AUX_CTL_REG EQU CYREG_B1_UDB08_MSK_ACTL
UART_BUART_sTX_TxShifter_u0__16BIT_A0_REG EQU CYREG_B0_UDB08_09_A0
UART_BUART_sTX_TxShifter_u0__16BIT_A1_REG EQU CYREG_B0_UDB08_09_A1
UART_BUART_sTX_TxShifter_u0__16BIT_D0_REG EQU CYREG_B0_UDB08_09_D0
UART_BUART_sTX_TxShifter_u0__16BIT_D1_REG EQU CYREG_B0_UDB08_09_D1
UART_BUART_sTX_TxShifter_u0__16BIT_DP_AUX_CTL_REG EQU CYREG_B0_UDB08_09_ACTL
UART_BUART_sTX_TxShifter_u0__16BIT_F0_REG EQU CYREG_B0_UDB08_09_F0
UART_BUART_sTX_TxShifter_u0__16BIT_F1_REG EQU CYREG_B0_UDB08_09_F1
UART_BUART_sTX_TxShifter_u0__A0_A1_REG EQU CYREG_B0_UDB08_A0_A1
UART_BUART_sTX_TxShifter_u0__A0_REG EQU CYREG_B0_UDB08_A0
UART_BUART_sTX_TxShifter_u0__A1_REG EQU CYREG_B0_UDB08_A1
UART_BUART_sTX_TxShifter_u0__D0_D1_REG EQU CYREG_B0_UDB08_D0_D1
UART_BUART_sTX_TxShifter_u0__D0_REG EQU CYREG_B0_UDB08_D0
UART_BUART_sTX_TxShifter_u0__D1_REG EQU CYREG_B0_UDB08_D1
UART_BUART_sTX_TxShifter_u0__DP_AUX_CTL_REG EQU CYREG_B0_UDB08_ACTL
UART_BUART_sTX_TxShifter_u0__F0_F1_REG EQU CYREG_B0_UDB08_F0_F1
UART_BUART_sTX_TxShifter_u0__F0_REG EQU CYREG_B0_UDB08_F0
UART_BUART_sTX_TxShifter_u0__F1_REG EQU CYREG_B0_UDB08_F1
UART_BUART_sTX_TxSts__0__MASK EQU 0x01
UART_BUART_sTX_TxSts__0__POS EQU 0
UART_BUART_sTX_TxSts__1__MASK EQU 0x02
UART_BUART_sTX_TxSts__1__POS EQU 1
UART_BUART_sTX_TxSts__16BIT_STATUS_AUX_CTL_REG EQU CYREG_B0_UDB08_09_ACTL
UART_BUART_sTX_TxSts__16BIT_STATUS_REG EQU CYREG_B0_UDB08_09_ST
UART_BUART_sTX_TxSts__2__MASK EQU 0x04
UART_BUART_sTX_TxSts__2__POS EQU 2
UART_BUART_sTX_TxSts__3__MASK EQU 0x08
UART_BUART_sTX_TxSts__3__POS EQU 3
UART_BUART_sTX_TxSts__MASK EQU 0x0F
UART_BUART_sTX_TxSts__MASK_REG EQU CYREG_B0_UDB08_MSK
UART_BUART_sTX_TxSts__STATUS_AUX_CTL_REG EQU CYREG_B0_UDB08_ACTL
UART_BUART_sTX_TxSts__STATUS_REG EQU CYREG_B0_UDB08_ST
UART_IntClock__CFG0 EQU CYREG_CLKDIST_DCFG1_CFG0
UART_IntClock__CFG1 EQU CYREG_CLKDIST_DCFG1_CFG1
UART_IntClock__CFG2 EQU CYREG_CLKDIST_DCFG1_CFG2
UART_IntClock__CFG2_SRC_SEL_MASK EQU 0x07
UART_IntClock__INDEX EQU 0x01
UART_IntClock__PM_ACT_CFG EQU CYREG_PM_ACT_CFG2
UART_IntClock__PM_ACT_MSK EQU 0x02
UART_IntClock__PM_STBY_CFG EQU CYREG_PM_STBY_CFG2
UART_IntClock__PM_STBY_MSK EQU 0x02
UART_RXInternalInterrupt__INTC_CLR_EN_REG EQU CYREG_NVIC_CLRENA0
UART_RXInternalInterrupt__INTC_CLR_PD_REG EQU CYREG_NVIC_CLRPEND0
UART_RXInternalInterrupt__INTC_MASK EQU 0x01
UART_RXInternalInterrupt__INTC_NUMBER EQU 0
UART_RXInternalInterrupt__INTC_PRIOR_NUM EQU 7
UART_RXInternalInterrupt__INTC_PRIOR_REG EQU CYREG_NVIC_PRI_0
UART_RXInternalInterrupt__INTC_SET_EN_REG EQU CYREG_NVIC_SETENA0
UART_RXInternalInterrupt__INTC_SET_PD_REG EQU CYREG_NVIC_SETPEND0
UART_TXInternalInterrupt__INTC_CLR_EN_REG EQU CYREG_NVIC_CLRENA0
UART_TXInternalInterrupt__INTC_CLR_PD_REG EQU CYREG_NVIC_CLRPEND0
UART_TXInternalInterrupt__INTC_MASK EQU 0x02
UART_TXInternalInterrupt__INTC_NUMBER EQU 1
UART_TXInternalInterrupt__INTC_PRIOR_NUM EQU 7
UART_TXInternalInterrupt__INTC_PRIOR_REG EQU CYREG_NVIC_PRI_1
UART_TXInternalInterrupt__INTC_SET_EN_REG EQU CYREG_NVIC_SETENA0
UART_TXInternalInterrupt__INTC_SET_PD_REG EQU CYREG_NVIC_SETPEND0

/* SCLK_1 */
SCLK_1__0__INTTYPE EQU CYREG_PICU12_INTTYPE1
SCLK_1__0__MASK EQU 0x02
SCLK_1__0__PC EQU CYREG_PRT12_PC1
SCLK_1__0__PORT EQU 12
SCLK_1__0__SHIFT EQU 1
SCLK_1__AG EQU CYREG_PRT12_AG
SCLK_1__BIE EQU CYREG_PRT12_BIE
SCLK_1__BIT_MASK EQU CYREG_PRT12_BIT_MASK
SCLK_1__BYP EQU CYREG_PRT12_BYP
SCLK_1__DM0 EQU CYREG_PRT12_DM0
SCLK_1__DM1 EQU CYREG_PRT12_DM1
SCLK_1__DM2 EQU CYREG_PRT12_DM2
SCLK_1__DR EQU CYREG_PRT12_DR
SCLK_1__INP_DIS EQU CYREG_PRT12_INP_DIS
SCLK_1__INTTYPE_BASE EQU CYDEV_PICU_INTTYPE_PICU12_BASE
SCLK_1__MASK EQU 0x02
SCLK_1__PORT EQU 12
SCLK_1__PRT EQU CYREG_PRT12_PRT
SCLK_1__PRTDSI__DBL_SYNC_IN EQU CYREG_PRT12_DBL_SYNC_IN
SCLK_1__PRTDSI__OE_SEL0 EQU CYREG_PRT12_OE_SEL0
SCLK_1__PRTDSI__OE_SEL1 EQU CYREG_PRT12_OE_SEL1
SCLK_1__PRTDSI__OUT_SEL0 EQU CYREG_PRT12_OUT_SEL0
SCLK_1__PRTDSI__OUT_SEL1 EQU CYREG_PRT12_OUT_SEL1
SCLK_1__PRTDSI__SYNC_OUT EQU CYREG_PRT12_SYNC_OUT
SCLK_1__PS EQU CYREG_PRT12_PS
SCLK_1__SHIFT EQU 1
SCLK_1__SIO_CFG EQU CYREG_PRT12_SIO_CFG
SCLK_1__SIO_DIFF EQU CYREG_PRT12_SIO_DIFF
SCLK_1__SIO_HYST_EN EQU CYREG_PRT12_SIO_HYST_EN
SCLK_1__SIO_REG_HIFREQ EQU CYREG_PRT12_SIO_REG_HIFREQ
SCLK_1__SLW EQU CYREG_PRT12_SLW

/* Chipselect */
Chipselect__0__INTTYPE EQU CYREG_PICU15_INTTYPE2
Chipselect__0__MASK EQU 0x04
Chipselect__0__PC EQU CYREG_IO_PC_PRT15_PC2
Chipselect__0__PORT EQU 15
Chipselect__0__SHIFT EQU 2
Chipselect__AG EQU CYREG_PRT15_AG
Chipselect__AMUX EQU CYREG_PRT15_AMUX
Chipselect__BIE EQU CYREG_PRT15_BIE
Chipselect__BIT_MASK EQU CYREG_PRT15_BIT_MASK
Chipselect__BYP EQU CYREG_PRT15_BYP
Chipselect__CTL EQU CYREG_PRT15_CTL
Chipselect__DM0 EQU CYREG_PRT15_DM0
Chipselect__DM1 EQU CYREG_PRT15_DM1
Chipselect__DM2 EQU CYREG_PRT15_DM2
Chipselect__DR EQU CYREG_PRT15_DR
Chipselect__INP_DIS EQU CYREG_PRT15_INP_DIS
Chipselect__INTTYPE_BASE EQU CYDEV_PICU_INTTYPE_PICU15_BASE
Chipselect__LCD_COM_SEG EQU CYREG_PRT15_LCD_COM_SEG
Chipselect__LCD_EN EQU CYREG_PRT15_LCD_EN
Chipselect__MASK EQU 0x04
Chipselect__PORT EQU 15
Chipselect__PRT EQU CYREG_PRT15_PRT
Chipselect__PRTDSI__CAPS_SEL EQU CYREG_PRT15_CAPS_SEL
Chipselect__PRTDSI__DBL_SYNC_IN EQU CYREG_PRT15_DBL_SYNC_IN
Chipselect__PRTDSI__OE_SEL0 EQU CYREG_PRT15_OE_SEL0
Chipselect__PRTDSI__OE_SEL1 EQU CYREG_PRT15_OE_SEL1
Chipselect__PRTDSI__OUT_SEL0 EQU CYREG_PRT15_OUT_SEL0
Chipselect__PRTDSI__OUT_SEL1 EQU CYREG_PRT15_OUT_SEL1
Chipselect__PRTDSI__SYNC_OUT EQU CYREG_PRT15_SYNC_OUT
Chipselect__PS EQU CYREG_PRT15_PS
Chipselect__SHIFT EQU 2
Chipselect__SLW EQU CYREG_PRT15_SLW

/* isr_setpoint */
isr_setpoint__INTC_CLR_EN_REG EQU CYREG_NVIC_CLRENA0
isr_setpoint__INTC_CLR_PD_REG EQU CYREG_NVIC_CLRPEND0
isr_setpoint__INTC_MASK EQU 0x04
isr_setpoint__INTC_NUMBER EQU 2
isr_setpoint__INTC_PRIOR_NUM EQU 7
isr_setpoint__INTC_PRIOR_REG EQU CYREG_NVIC_PRI_2
isr_setpoint__INTC_SET_EN_REG EQU CYREG_NVIC_SETENA0
isr_setpoint__INTC_SET_PD_REG EQU CYREG_NVIC_SETPEND0

/* Miscellaneous */
BCLK__BUS_CLK__HZ EQU 24000000
BCLK__BUS_CLK__KHZ EQU 24000
BCLK__BUS_CLK__MHZ EQU 24
CYDEV_CHIP_DIE_LEOPARD EQU 1
CYDEV_CHIP_DIE_PSOC4A EQU 26
CYDEV_CHIP_DIE_PSOC5LP EQU 2
CYDEV_CHIP_DIE_PSOC5TM EQU 3
CYDEV_CHIP_DIE_TMA4 EQU 4
CYDEV_CHIP_DIE_UNKNOWN EQU 0
CYDEV_CHIP_FAMILY_FM0P EQU 5
CYDEV_CHIP_FAMILY_FM3 EQU 6
CYDEV_CHIP_FAMILY_FM4 EQU 7
CYDEV_CHIP_FAMILY_PSOC3 EQU 1
CYDEV_CHIP_FAMILY_PSOC4 EQU 2
CYDEV_CHIP_FAMILY_PSOC5 EQU 3
CYDEV_CHIP_FAMILY_PSOC6 EQU 4
CYDEV_CHIP_FAMILY_UNKNOWN EQU 0
CYDEV_CHIP_FAMILY_USED EQU CYDEV_CHIP_FAMILY_PSOC5
CYDEV_CHIP_JTAG_ID EQU 0x2E161069
CYDEV_CHIP_MEMBER_3A EQU 1
CYDEV_CHIP_MEMBER_4A EQU 26
CYDEV_CHIP_MEMBER_4AA EQU 25
CYDEV_CHIP_MEMBER_4AB EQU 30
CYDEV_CHIP_MEMBER_4AC EQU 14
CYDEV_CHIP_MEMBER_4AD EQU 15
CYDEV_CHIP_MEMBER_4AE EQU 16
CYDEV_CHIP_MEMBER_4D EQU 20
CYDEV_CHIP_MEMBER_4E EQU 6
CYDEV_CHIP_MEMBER_4F EQU 27
CYDEV_CHIP_MEMBER_4G EQU 4
CYDEV_CHIP_MEMBER_4H EQU 24
CYDEV_CHIP_MEMBER_4I EQU 32
CYDEV_CHIP_MEMBER_4J EQU 21
CYDEV_CHIP_MEMBER_4K EQU 22
CYDEV_CHIP_MEMBER_4L EQU 31
CYDEV_CHIP_MEMBER_4M EQU 29
CYDEV_CHIP_MEMBER_4N EQU 11
CYDEV_CHIP_MEMBER_4O EQU 8
CYDEV_CHIP_MEMBER_4P EQU 28
CYDEV_CHIP_MEMBER_4Q EQU 17
CYDEV_CHIP_MEMBER_4R EQU 9
CYDEV_CHIP_MEMBER_4S EQU 12
CYDEV_CHIP_MEMBER_4T EQU 10
CYDEV_CHIP_MEMBER_4U EQU 5
CYDEV_CHIP_MEMBER_4V EQU 23
CYDEV_CHIP_MEMBER_4W EQU 13
CYDEV_CHIP_MEMBER_4X EQU 7
CYDEV_CHIP_MEMBER_4Y EQU 18
CYDEV_CHIP_MEMBER_4Z EQU 19
CYDEV_CHIP_MEMBER_5A EQU 3
CYDEV_CHIP_MEMBER_5B EQU 2
CYDEV_CHIP_MEMBER_6A EQU 33
CYDEV_CHIP_MEMBER_FM3 EQU 37
CYDEV_CHIP_MEMBER_FM4 EQU 38
CYDEV_CHIP_MEMBER_PDL_FM0P_TYPE1 EQU 34
CYDEV_CHIP_MEMBER_PDL_FM0P_TYPE2 EQU 35
CYDEV_CHIP_MEMBER_PDL_FM0P_TYPE3 EQU 36
CYDEV_CHIP_MEMBER_UNKNOWN EQU 0
CYDEV_CHIP_MEMBER_USED EQU CYDEV_CHIP_MEMBER_5B
CYDEV_CHIP_DIE_EXPECT EQU CYDEV_CHIP_MEMBER_USED
CYDEV_CHIP_DIE_ACTUAL EQU CYDEV_CHIP_DIE_EXPECT
CYDEV_CHIP_REV_LEOPARD_ES1 EQU 0
CYDEV_CHIP_REV_LEOPARD_ES2 EQU 1
CYDEV_CHIP_REV_LEOPARD_ES3 EQU 3
CYDEV_CHIP_REV_LEOPARD_PRODUCTION EQU 3
CYDEV_CHIP_REV_PSOC4A_ES0 EQU 17
CYDEV_CHIP_REV_PSOC4A_PRODUCTION EQU 17
CYDEV_CHIP_REV_PSOC5LP_ES0 EQU 0
CYDEV_CHIP_REV_PSOC5LP_PRODUCTION EQU 0
CYDEV_CHIP_REV_PSOC5TM_ES0 EQU 0
CYDEV_CHIP_REV_PSOC5TM_ES1 EQU 1
CYDEV_CHIP_REV_PSOC5TM_PRODUCTION EQU 1
CYDEV_CHIP_REV_TMA4_ES EQU 17
CYDEV_CHIP_REV_TMA4_ES2 EQU 33
CYDEV_CHIP_REV_TMA4_PRODUCTION EQU 17
CYDEV_CHIP_REVISION_3A_ES1 EQU 0
CYDEV_CHIP_REVISION_3A_ES2 EQU 1
CYDEV_CHIP_REVISION_3A_ES3 EQU 3
CYDEV_CHIP_REVISION_3A_PRODUCTION EQU 3
CYDEV_CHIP_REVISION_4A_ES0 EQU 17
CYDEV_CHIP_REVISION_4A_PRODUCTION EQU 17
CYDEV_CHIP_REVISION_4AA_PRODUCTION EQU 0
CYDEV_CHIP_REVISION_4AB_PRODUCTION EQU 0
CYDEV_CHIP_REVISION_4AC_PRODUCTION EQU 0
CYDEV_CHIP_REVISION_4AD_PRODUCTION EQU 0
CYDEV_CHIP_REVISION_4AE_PRODUCTION EQU 0
CYDEV_CHIP_REVISION_4D_PRODUCTION EQU 0
CYDEV_CHIP_REVISION_4E_CCG2_NO_USBPD EQU 0
CYDEV_CHIP_REVISION_4E_PRODUCTION EQU 0
CYDEV_CHIP_REVISION_4F_PRODUCTION EQU 0
CYDEV_CHIP_REVISION_4F_PRODUCTION_256DMA EQU 0
CYDEV_CHIP_REVISION_4F_PRODUCTION_256K EQU 0
CYDEV_CHIP_REVISION_4G_ES EQU 17
CYDEV_CHIP_REVISION_4G_ES2 EQU 33
CYDEV_CHIP_REVISION_4G_PRODUCTION EQU 17
CYDEV_CHIP_REVISION_4H_PRODUCTION EQU 0
CYDEV_CHIP_REVISION_4I_PRODUCTION EQU 0
CYDEV_CHIP_REVISION_4J_PRODUCTION EQU 0
CYDEV_CHIP_REVISION_4K_PRODUCTION EQU 0
CYDEV_CHIP_REVISION_4L_PRODUCTION EQU 0
CYDEV_CHIP_REVISION_4M_PRODUCTION EQU 0
CYDEV_CHIP_REVISION_4N_PRODUCTION EQU 0
CYDEV_CHIP_REVISION_4O_PRODUCTION EQU 0
CYDEV_CHIP_REVISION_4P_PRODUCTION EQU 0
CYDEV_CHIP_REVISION_4Q_PRODUCTION EQU 0
CYDEV_CHIP_REVISION_4R_PRODUCTION EQU 0
CYDEV_CHIP_REVISION_4S_PRODUCTION EQU 0
CYDEV_CHIP_REVISION_4T_PRODUCTION EQU 0
CYDEV_CHIP_REVISION_4U_PRODUCTION EQU 0
CYDEV_CHIP_REVISION_4V_PRODUCTION EQU 0
CYDEV_CHIP_REVISION_4W_PRODUCTION EQU 0
CYDEV_CHIP_REVISION_4X_PRODUCTION EQU 0
CYDEV_CHIP_REVISION_4Y_PRODUCTION EQU 0
CYDEV_CHIP_REVISION_4Z_PRODUCTION EQU 0
CYDEV_CHIP_REVISION_5A_ES0 EQU 0
CYDEV_CHIP_REVISION_5A_ES1 EQU 1
CYDEV_CHIP_REVISION_5A_PRODUCTION EQU 1
CYDEV_CHIP_REVISION_5B_ES0 EQU 0
CYDEV_CHIP_REVISION_5B_PRODUCTION EQU 0
CYDEV_CHIP_REVISION_6A_ES EQU 17
CYDEV_CHIP_REVISION_6A_NO_UDB EQU 33
CYDEV_CHIP_REVISION_6A_PRODUCTION EQU 33
CYDEV_CHIP_REVISION_FM3_PRODUCTION EQU 0
CYDEV_CHIP_REVISION_FM4_PRODUCTION EQU 0
CYDEV_CHIP_REVISION_PDL_FM0P_TYPE1_PRODUCTION EQU 0
CYDEV_CHIP_REVISION_PDL_FM0P_TYPE2_PRODUCTION EQU 0
CYDEV_CHIP_REVISION_PDL_FM0P_TYPE3_PRODUCTION EQU 0
CYDEV_CHIP_REVISION_USED EQU CYDEV_CHIP_REVISION_5B_PRODUCTION
CYDEV_CHIP_REV_EXPECT EQU CYDEV_CHIP_REVISION_USED
CYDEV_CONFIG_FASTBOOT_ENABLED EQU 1
CYDEV_CONFIG_UNUSED_IO_AllowButWarn EQU 0
CYDEV_CONFIG_UNUSED_IO EQU CYDEV_CONFIG_UNUSED_IO_AllowButWarn
CYDEV_CONFIG_UNUSED_IO_AllowWithInfo EQU 1
CYDEV_CONFIG_UNUSED_IO_Disallowed EQU 2
CYDEV_CONFIGURATION_COMPRESSED EQU 1
CYDEV_CONFIGURATION_DMA EQU 0
CYDEV_CONFIGURATION_ECC EQU 1
CYDEV_CONFIGURATION_IMOENABLED EQU CYDEV_CONFIG_FASTBOOT_ENABLED
CYDEV_CONFIGURATION_MODE_COMPRESSED EQU 0
CYDEV_CONFIGURATION_MODE EQU CYDEV_CONFIGURATION_MODE_COMPRESSED
CYDEV_CONFIGURATION_MODE_DMA EQU 2
CYDEV_CONFIGURATION_MODE_UNCOMPRESSED EQU 1
CYDEV_DEBUG_ENABLE_MASK EQU 0x20
CYDEV_DEBUG_ENABLE_REGISTER EQU CYREG_MLOGIC_DEBUG
CYDEV_DEBUGGING_DPS_Disable EQU 3
CYDEV_DEBUGGING_DPS_JTAG_4 EQU 1
CYDEV_DEBUGGING_DPS_JTAG_5 EQU 0
CYDEV_DEBUGGING_DPS_SWD EQU 2
CYDEV_DEBUGGING_DPS_SWD_SWV EQU 6
CYDEV_DEBUGGING_DPS EQU CYDEV_DEBUGGING_DPS_SWD_SWV
CYDEV_DEBUGGING_ENABLE EQU 1
CYDEV_DEBUGGING_XRES EQU 0
CYDEV_DMA_CHANNELS_AVAILABLE EQU 24
CYDEV_ECC_ENABLE EQU 0
CYDEV_HEAP_SIZE EQU 0x80
CYDEV_INSTRUCT_CACHE_ENABLED EQU 1
CYDEV_INTR_RISING EQU 0x00000007
CYDEV_IS_EXPORTING_CODE EQU 0
CYDEV_IS_IMPORTING_CODE EQU 0
CYDEV_PROJ_TYPE EQU 0
CYDEV_PROJ_TYPE_BOOTLOADER EQU 1
CYDEV_PROJ_TYPE_LAUNCHER EQU 5
CYDEV_PROJ_TYPE_LOADABLE EQU 2
CYDEV_PROJ_TYPE_LOADABLEANDBOOTLOADER EQU 4
CYDEV_PROJ_TYPE_MULTIAPPBOOTLOADER EQU 3
CYDEV_PROJ_TYPE_STANDARD EQU 0
CYDEV_PROTECTION_ENABLE EQU 0
CYDEV_STACK_SIZE EQU 0x0800
CYDEV_USE_BUNDLED_CMSIS EQU 1
CYDEV_VARIABLE_VDDA EQU 0
CYDEV_VDDA_MV EQU 5000
CYDEV_VDDD_MV EQU 5000
CYDEV_VDDIO0_MV EQU 5000
CYDEV_VDDIO1_MV EQU 5000
CYDEV_VDDIO2_MV EQU 5000
CYDEV_VDDIO3_MV EQU 5000
CYDEV_VIO0_MV EQU 5000
CYDEV_VIO1_MV EQU 5000
CYDEV_VIO2_MV EQU 5000
CYDEV_VIO3_MV EQU 5000
CYIPBLOCK_ARM_CM3_VERSION EQU 0
CYIPBLOCK_P3_ANAIF_VERSION EQU 0
CYIPBLOCK_P3_CAN_VERSION EQU 0
CYIPBLOCK_P3_CAPSENSE_VERSION EQU 0
CYIPBLOCK_P3_COMP_VERSION EQU 0
CYIPBLOCK_P3_DECIMATOR_VERSION EQU 0
CYIPBLOCK_P3_DFB_VERSION EQU 0
CYIPBLOCK_P3_DMA_VERSION EQU 0
CYIPBLOCK_P3_DRQ_VERSION EQU 0
CYIPBLOCK_P3_DSM_VERSION EQU 0
CYIPBLOCK_P3_EMIF_VERSION EQU 0
CYIPBLOCK_P3_I2C_VERSION EQU 0
CYIPBLOCK_P3_LCD_VERSION EQU 0
CYIPBLOCK_P3_LPF_VERSION EQU 0
CYIPBLOCK_P3_OPAMP_VERSION EQU 0
CYIPBLOCK_P3_PM_VERSION EQU 0
CYIPBLOCK_P3_SCCT_VERSION EQU 0
CYIPBLOCK_P3_TIMER_VERSION EQU 0
CYIPBLOCK_P3_USB_VERSION EQU 0
CYIPBLOCK_P3_VIDAC_VERSION EQU 0
CYIPBLOCK_P3_VREF_VERSION EQU 0
CYIPBLOCK_S8_GPIO_VERSION EQU 0
CYIPBLOCK_S8_IRQ_VERSION EQU 0
CYIPBLOCK_S8_SAR_VERSION EQU 0
CYIPBLOCK_S8_SIO_VERSION EQU 0
CYIPBLOCK_S8_UDB_VERSION EQU 0
DMA_CHANNELS_USED__MASK0 EQU 0x00000000
CYDEV_BOOTLOADER_ENABLE EQU 0

#endif /* INCLUDED_CYFITTERIAR_INC */
