/*******************************************************************************
* File Name: cyfittergnu.inc
* 
* PSoC Creator  4.4
*
* Description:
* 
* This file is automatically generated by PSoC Creator.
*
********************************************************************************
* Copyright (c) 2007-2020 Cypress Semiconductor.  All rights reserved.
* You may use this file only in accordance with the license, terms, conditions, 
* disclaimers, and limitations in the end user license agreement accompanying 
* the software package with which this file was provided.
********************************************************************************/

.ifndef INCLUDED_CYFITTERGNU_INC
.set INCLUDED_CYFITTERGNU_INC, 1
.include "cydevicegnu.inc"
.include "cydevicegnu_trm.inc"

/* E */
.set E__0__INTTYPE, CYREG_PICU3_INTTYPE3
.set E__0__MASK, 0x08
.set E__0__PC, CYREG_PRT3_PC3
.set E__0__PORT, 3
.set E__0__SHIFT, 3
.set E__AG, CYREG_PRT3_AG
.set E__AMUX, CYREG_PRT3_AMUX
.set E__BIE, CYREG_PRT3_BIE
.set E__BIT_MASK, CYREG_PRT3_BIT_MASK
.set E__BYP, CYREG_PRT3_BYP
.set E__CTL, CYREG_PRT3_CTL
.set E__DM0, CYREG_PRT3_DM0
.set E__DM1, CYREG_PRT3_DM1
.set E__DM2, CYREG_PRT3_DM2
.set E__DR, CYREG_PRT3_DR
.set E__INP_DIS, CYREG_PRT3_INP_DIS
.set E__INTTYPE_BASE, CYDEV_PICU_INTTYPE_PICU3_BASE
.set E__LCD_COM_SEG, CYREG_PRT3_LCD_COM_SEG
.set E__LCD_EN, CYREG_PRT3_LCD_EN
.set E__MASK, 0x08
.set E__PORT, 3
.set E__PRT, CYREG_PRT3_PRT
.set E__PRTDSI__CAPS_SEL, CYREG_PRT3_CAPS_SEL
.set E__PRTDSI__DBL_SYNC_IN, CYREG_PRT3_DBL_SYNC_IN
.set E__PRTDSI__OE_SEL0, CYREG_PRT3_OE_SEL0
.set E__PRTDSI__OE_SEL1, CYREG_PRT3_OE_SEL1
.set E__PRTDSI__OUT_SEL0, CYREG_PRT3_OUT_SEL0
.set E__PRTDSI__OUT_SEL1, CYREG_PRT3_OUT_SEL1
.set E__PRTDSI__SYNC_OUT, CYREG_PRT3_SYNC_OUT
.set E__PS, CYREG_PRT3_PS
.set E__SHIFT, 3
.set E__SLW, CYREG_PRT3_SLW

/* D4 */
.set D4__0__INTTYPE, CYREG_PICU3_INTTYPE4
.set D4__0__MASK, 0x10
.set D4__0__PC, CYREG_PRT3_PC4
.set D4__0__PORT, 3
.set D4__0__SHIFT, 4
.set D4__AG, CYREG_PRT3_AG
.set D4__AMUX, CYREG_PRT3_AMUX
.set D4__BIE, CYREG_PRT3_BIE
.set D4__BIT_MASK, CYREG_PRT3_BIT_MASK
.set D4__BYP, CYREG_PRT3_BYP
.set D4__CTL, CYREG_PRT3_CTL
.set D4__DM0, CYREG_PRT3_DM0
.set D4__DM1, CYREG_PRT3_DM1
.set D4__DM2, CYREG_PRT3_DM2
.set D4__DR, CYREG_PRT3_DR
.set D4__INP_DIS, CYREG_PRT3_INP_DIS
.set D4__INTTYPE_BASE, CYDEV_PICU_INTTYPE_PICU3_BASE
.set D4__LCD_COM_SEG, CYREG_PRT3_LCD_COM_SEG
.set D4__LCD_EN, CYREG_PRT3_LCD_EN
.set D4__MASK, 0x10
.set D4__PORT, 3
.set D4__PRT, CYREG_PRT3_PRT
.set D4__PRTDSI__CAPS_SEL, CYREG_PRT3_CAPS_SEL
.set D4__PRTDSI__DBL_SYNC_IN, CYREG_PRT3_DBL_SYNC_IN
.set D4__PRTDSI__OE_SEL0, CYREG_PRT3_OE_SEL0
.set D4__PRTDSI__OE_SEL1, CYREG_PRT3_OE_SEL1
.set D4__PRTDSI__OUT_SEL0, CYREG_PRT3_OUT_SEL0
.set D4__PRTDSI__OUT_SEL1, CYREG_PRT3_OUT_SEL1
.set D4__PRTDSI__SYNC_OUT, CYREG_PRT3_SYNC_OUT
.set D4__PS, CYREG_PRT3_PS
.set D4__SHIFT, 4
.set D4__SLW, CYREG_PRT3_SLW

/* D5 */
.set D5__0__INTTYPE, CYREG_PICU3_INTTYPE5
.set D5__0__MASK, 0x20
.set D5__0__PC, CYREG_PRT3_PC5
.set D5__0__PORT, 3
.set D5__0__SHIFT, 5
.set D5__AG, CYREG_PRT3_AG
.set D5__AMUX, CYREG_PRT3_AMUX
.set D5__BIE, CYREG_PRT3_BIE
.set D5__BIT_MASK, CYREG_PRT3_BIT_MASK
.set D5__BYP, CYREG_PRT3_BYP
.set D5__CTL, CYREG_PRT3_CTL
.set D5__DM0, CYREG_PRT3_DM0
.set D5__DM1, CYREG_PRT3_DM1
.set D5__DM2, CYREG_PRT3_DM2
.set D5__DR, CYREG_PRT3_DR
.set D5__INP_DIS, CYREG_PRT3_INP_DIS
.set D5__INTTYPE_BASE, CYDEV_PICU_INTTYPE_PICU3_BASE
.set D5__LCD_COM_SEG, CYREG_PRT3_LCD_COM_SEG
.set D5__LCD_EN, CYREG_PRT3_LCD_EN
.set D5__MASK, 0x20
.set D5__PORT, 3
.set D5__PRT, CYREG_PRT3_PRT
.set D5__PRTDSI__CAPS_SEL, CYREG_PRT3_CAPS_SEL
.set D5__PRTDSI__DBL_SYNC_IN, CYREG_PRT3_DBL_SYNC_IN
.set D5__PRTDSI__OE_SEL0, CYREG_PRT3_OE_SEL0
.set D5__PRTDSI__OE_SEL1, CYREG_PRT3_OE_SEL1
.set D5__PRTDSI__OUT_SEL0, CYREG_PRT3_OUT_SEL0
.set D5__PRTDSI__OUT_SEL1, CYREG_PRT3_OUT_SEL1
.set D5__PRTDSI__SYNC_OUT, CYREG_PRT3_SYNC_OUT
.set D5__PS, CYREG_PRT3_PS
.set D5__SHIFT, 5
.set D5__SLW, CYREG_PRT3_SLW

/* D6 */
.set D6__0__INTTYPE, CYREG_PICU3_INTTYPE6
.set D6__0__MASK, 0x40
.set D6__0__PC, CYREG_PRT3_PC6
.set D6__0__PORT, 3
.set D6__0__SHIFT, 6
.set D6__AG, CYREG_PRT3_AG
.set D6__AMUX, CYREG_PRT3_AMUX
.set D6__BIE, CYREG_PRT3_BIE
.set D6__BIT_MASK, CYREG_PRT3_BIT_MASK
.set D6__BYP, CYREG_PRT3_BYP
.set D6__CTL, CYREG_PRT3_CTL
.set D6__DM0, CYREG_PRT3_DM0
.set D6__DM1, CYREG_PRT3_DM1
.set D6__DM2, CYREG_PRT3_DM2
.set D6__DR, CYREG_PRT3_DR
.set D6__INP_DIS, CYREG_PRT3_INP_DIS
.set D6__INTTYPE_BASE, CYDEV_PICU_INTTYPE_PICU3_BASE
.set D6__LCD_COM_SEG, CYREG_PRT3_LCD_COM_SEG
.set D6__LCD_EN, CYREG_PRT3_LCD_EN
.set D6__MASK, 0x40
.set D6__PORT, 3
.set D6__PRT, CYREG_PRT3_PRT
.set D6__PRTDSI__CAPS_SEL, CYREG_PRT3_CAPS_SEL
.set D6__PRTDSI__DBL_SYNC_IN, CYREG_PRT3_DBL_SYNC_IN
.set D6__PRTDSI__OE_SEL0, CYREG_PRT3_OE_SEL0
.set D6__PRTDSI__OE_SEL1, CYREG_PRT3_OE_SEL1
.set D6__PRTDSI__OUT_SEL0, CYREG_PRT3_OUT_SEL0
.set D6__PRTDSI__OUT_SEL1, CYREG_PRT3_OUT_SEL1
.set D6__PRTDSI__SYNC_OUT, CYREG_PRT3_SYNC_OUT
.set D6__PS, CYREG_PRT3_PS
.set D6__SHIFT, 6
.set D6__SLW, CYREG_PRT3_SLW

/* D7 */
.set D7__0__INTTYPE, CYREG_PICU3_INTTYPE7
.set D7__0__MASK, 0x80
.set D7__0__PC, CYREG_PRT3_PC7
.set D7__0__PORT, 3
.set D7__0__SHIFT, 7
.set D7__AG, CYREG_PRT3_AG
.set D7__AMUX, CYREG_PRT3_AMUX
.set D7__BIE, CYREG_PRT3_BIE
.set D7__BIT_MASK, CYREG_PRT3_BIT_MASK
.set D7__BYP, CYREG_PRT3_BYP
.set D7__CTL, CYREG_PRT3_CTL
.set D7__DM0, CYREG_PRT3_DM0
.set D7__DM1, CYREG_PRT3_DM1
.set D7__DM2, CYREG_PRT3_DM2
.set D7__DR, CYREG_PRT3_DR
.set D7__INP_DIS, CYREG_PRT3_INP_DIS
.set D7__INTTYPE_BASE, CYDEV_PICU_INTTYPE_PICU3_BASE
.set D7__LCD_COM_SEG, CYREG_PRT3_LCD_COM_SEG
.set D7__LCD_EN, CYREG_PRT3_LCD_EN
.set D7__MASK, 0x80
.set D7__PORT, 3
.set D7__PRT, CYREG_PRT3_PRT
.set D7__PRTDSI__CAPS_SEL, CYREG_PRT3_CAPS_SEL
.set D7__PRTDSI__DBL_SYNC_IN, CYREG_PRT3_DBL_SYNC_IN
.set D7__PRTDSI__OE_SEL0, CYREG_PRT3_OE_SEL0
.set D7__PRTDSI__OE_SEL1, CYREG_PRT3_OE_SEL1
.set D7__PRTDSI__OUT_SEL0, CYREG_PRT3_OUT_SEL0
.set D7__PRTDSI__OUT_SEL1, CYREG_PRT3_OUT_SEL1
.set D7__PRTDSI__SYNC_OUT, CYREG_PRT3_SYNC_OUT
.set D7__PS, CYREG_PRT3_PS
.set D7__SHIFT, 7
.set D7__SLW, CYREG_PRT3_SLW

/* RS */
.set RS__0__INTTYPE, CYREG_PICU3_INTTYPE2
.set RS__0__MASK, 0x04
.set RS__0__PC, CYREG_PRT3_PC2
.set RS__0__PORT, 3
.set RS__0__SHIFT, 2
.set RS__AG, CYREG_PRT3_AG
.set RS__AMUX, CYREG_PRT3_AMUX
.set RS__BIE, CYREG_PRT3_BIE
.set RS__BIT_MASK, CYREG_PRT3_BIT_MASK
.set RS__BYP, CYREG_PRT3_BYP
.set RS__CTL, CYREG_PRT3_CTL
.set RS__DM0, CYREG_PRT3_DM0
.set RS__DM1, CYREG_PRT3_DM1
.set RS__DM2, CYREG_PRT3_DM2
.set RS__DR, CYREG_PRT3_DR
.set RS__INP_DIS, CYREG_PRT3_INP_DIS
.set RS__INTTYPE_BASE, CYDEV_PICU_INTTYPE_PICU3_BASE
.set RS__LCD_COM_SEG, CYREG_PRT3_LCD_COM_SEG
.set RS__LCD_EN, CYREG_PRT3_LCD_EN
.set RS__MASK, 0x04
.set RS__PORT, 3
.set RS__PRT, CYREG_PRT3_PRT
.set RS__PRTDSI__CAPS_SEL, CYREG_PRT3_CAPS_SEL
.set RS__PRTDSI__DBL_SYNC_IN, CYREG_PRT3_DBL_SYNC_IN
.set RS__PRTDSI__OE_SEL0, CYREG_PRT3_OE_SEL0
.set RS__PRTDSI__OE_SEL1, CYREG_PRT3_OE_SEL1
.set RS__PRTDSI__OUT_SEL0, CYREG_PRT3_OUT_SEL0
.set RS__PRTDSI__OUT_SEL1, CYREG_PRT3_OUT_SEL1
.set RS__PRTDSI__SYNC_OUT, CYREG_PRT3_SYNC_OUT
.set RS__PS, CYREG_PRT3_PS
.set RS__SHIFT, 2
.set RS__SLW, CYREG_PRT3_SLW

/* ZC */
.set ZC_genblk2_Counter0_DP_u0__16BIT_A0_REG, CYREG_B1_UDB07_08_A0
.set ZC_genblk2_Counter0_DP_u0__16BIT_A1_REG, CYREG_B1_UDB07_08_A1
.set ZC_genblk2_Counter0_DP_u0__16BIT_D0_REG, CYREG_B1_UDB07_08_D0
.set ZC_genblk2_Counter0_DP_u0__16BIT_D1_REG, CYREG_B1_UDB07_08_D1
.set ZC_genblk2_Counter0_DP_u0__16BIT_DP_AUX_CTL_REG, CYREG_B1_UDB07_08_ACTL
.set ZC_genblk2_Counter0_DP_u0__16BIT_F0_REG, CYREG_B1_UDB07_08_F0
.set ZC_genblk2_Counter0_DP_u0__16BIT_F1_REG, CYREG_B1_UDB07_08_F1
.set ZC_genblk2_Counter0_DP_u0__A0_A1_REG, CYREG_B1_UDB07_A0_A1
.set ZC_genblk2_Counter0_DP_u0__A0_REG, CYREG_B1_UDB07_A0
.set ZC_genblk2_Counter0_DP_u0__A1_REG, CYREG_B1_UDB07_A1
.set ZC_genblk2_Counter0_DP_u0__D0_D1_REG, CYREG_B1_UDB07_D0_D1
.set ZC_genblk2_Counter0_DP_u0__D0_REG, CYREG_B1_UDB07_D0
.set ZC_genblk2_Counter0_DP_u0__D1_REG, CYREG_B1_UDB07_D1
.set ZC_genblk2_Counter0_DP_u0__DP_AUX_CTL_REG, CYREG_B1_UDB07_ACTL
.set ZC_genblk2_Counter0_DP_u0__F0_F1_REG, CYREG_B1_UDB07_F0_F1
.set ZC_genblk2_Counter0_DP_u0__F0_REG, CYREG_B1_UDB07_F0
.set ZC_genblk2_Counter0_DP_u0__F1_REG, CYREG_B1_UDB07_F1
.set ZC_genblk2_Counter0_DP_u0__MSK_DP_AUX_CTL_REG, CYREG_B1_UDB07_MSK_ACTL
.set ZC_genblk2_Counter0_DP_u0__PER_DP_AUX_CTL_REG, CYREG_B1_UDB07_MSK_ACTL

/* LCD */
.set LCD_Sync_ctrl_reg__0__MASK, 0x01
.set LCD_Sync_ctrl_reg__0__POS, 0
.set LCD_Sync_ctrl_reg__1__MASK, 0x02
.set LCD_Sync_ctrl_reg__1__POS, 1
.set LCD_Sync_ctrl_reg__16BIT_CONTROL_AUX_CTL_REG, CYREG_B1_UDB07_08_ACTL
.set LCD_Sync_ctrl_reg__16BIT_CONTROL_CONTROL_REG, CYREG_B1_UDB07_08_CTL
.set LCD_Sync_ctrl_reg__16BIT_CONTROL_COUNT_REG, CYREG_B1_UDB07_08_CTL
.set LCD_Sync_ctrl_reg__16BIT_COUNT_CONTROL_REG, CYREG_B1_UDB07_08_CTL
.set LCD_Sync_ctrl_reg__16BIT_COUNT_COUNT_REG, CYREG_B1_UDB07_08_CTL
.set LCD_Sync_ctrl_reg__16BIT_MASK_MASK_REG, CYREG_B1_UDB07_08_MSK
.set LCD_Sync_ctrl_reg__16BIT_MASK_PERIOD_REG, CYREG_B1_UDB07_08_MSK
.set LCD_Sync_ctrl_reg__16BIT_PERIOD_MASK_REG, CYREG_B1_UDB07_08_MSK
.set LCD_Sync_ctrl_reg__16BIT_PERIOD_PERIOD_REG, CYREG_B1_UDB07_08_MSK
.set LCD_Sync_ctrl_reg__2__MASK, 0x04
.set LCD_Sync_ctrl_reg__2__POS, 2
.set LCD_Sync_ctrl_reg__3__MASK, 0x08
.set LCD_Sync_ctrl_reg__3__POS, 3
.set LCD_Sync_ctrl_reg__4__MASK, 0x10
.set LCD_Sync_ctrl_reg__4__POS, 4
.set LCD_Sync_ctrl_reg__5__MASK, 0x20
.set LCD_Sync_ctrl_reg__5__POS, 5
.set LCD_Sync_ctrl_reg__CONTROL_AUX_CTL_REG, CYREG_B1_UDB07_ACTL
.set LCD_Sync_ctrl_reg__CONTROL_REG, CYREG_B1_UDB07_CTL
.set LCD_Sync_ctrl_reg__CONTROL_ST_REG, CYREG_B1_UDB07_ST_CTL
.set LCD_Sync_ctrl_reg__COUNT_REG, CYREG_B1_UDB07_CTL
.set LCD_Sync_ctrl_reg__COUNT_ST_REG, CYREG_B1_UDB07_ST_CTL
.set LCD_Sync_ctrl_reg__MASK, 0x3F
.set LCD_Sync_ctrl_reg__MASK_CTL_AUX_CTL_REG, CYREG_B1_UDB07_MSK_ACTL
.set LCD_Sync_ctrl_reg__PER_CTL_AUX_CTL_REG, CYREG_B1_UDB07_MSK_ACTL
.set LCD_Sync_ctrl_reg__PERIOD_REG, CYREG_B1_UDB07_MSK

/* CERO */
.set CERO__0__INTTYPE, CYREG_PICU0_INTTYPE1
.set CERO__0__MASK, 0x02
.set CERO__0__PC, CYREG_PRT0_PC1
.set CERO__0__PORT, 0
.set CERO__0__SHIFT, 1
.set CERO__AG, CYREG_PRT0_AG
.set CERO__AMUX, CYREG_PRT0_AMUX
.set CERO__BIE, CYREG_PRT0_BIE
.set CERO__BIT_MASK, CYREG_PRT0_BIT_MASK
.set CERO__BYP, CYREG_PRT0_BYP
.set CERO__CTL, CYREG_PRT0_CTL
.set CERO__DM0, CYREG_PRT0_DM0
.set CERO__DM1, CYREG_PRT0_DM1
.set CERO__DM2, CYREG_PRT0_DM2
.set CERO__DR, CYREG_PRT0_DR
.set CERO__INP_DIS, CYREG_PRT0_INP_DIS
.set CERO__INTTYPE_BASE, CYDEV_PICU_INTTYPE_PICU0_BASE
.set CERO__LCD_COM_SEG, CYREG_PRT0_LCD_COM_SEG
.set CERO__LCD_EN, CYREG_PRT0_LCD_EN
.set CERO__MASK, 0x02
.set CERO__PORT, 0
.set CERO__PRT, CYREG_PRT0_PRT
.set CERO__PRTDSI__CAPS_SEL, CYREG_PRT0_CAPS_SEL
.set CERO__PRTDSI__DBL_SYNC_IN, CYREG_PRT0_DBL_SYNC_IN
.set CERO__PRTDSI__OE_SEL0, CYREG_PRT0_OE_SEL0
.set CERO__PRTDSI__OE_SEL1, CYREG_PRT0_OE_SEL1
.set CERO__PRTDSI__OUT_SEL0, CYREG_PRT0_OUT_SEL0
.set CERO__PRTDSI__OUT_SEL1, CYREG_PRT0_OUT_SEL1
.set CERO__PRTDSI__SYNC_OUT, CYREG_PRT0_SYNC_OUT
.set CERO__PS, CYREG_PRT0_PS
.set CERO__SHIFT, 1
.set CERO__SLW, CYREG_PRT0_SLW

/* btns */
.set btns_sts_intr_sts_reg__0__MASK, 0x01
.set btns_sts_intr_sts_reg__0__POS, 0
.set btns_sts_intr_sts_reg__1__MASK, 0x02
.set btns_sts_intr_sts_reg__1__POS, 1
.set btns_sts_intr_sts_reg__16BIT_STATUS_AUX_CTL_REG, CYREG_B1_UDB07_08_ACTL
.set btns_sts_intr_sts_reg__16BIT_STATUS_REG, CYREG_B1_UDB07_08_ST
.set btns_sts_intr_sts_reg__2__MASK, 0x04
.set btns_sts_intr_sts_reg__2__POS, 2
.set btns_sts_intr_sts_reg__MASK, 0x07
.set btns_sts_intr_sts_reg__MASK_REG, CYREG_B1_UDB07_MSK
.set btns_sts_intr_sts_reg__MASK_ST_AUX_CTL_REG, CYREG_B1_UDB07_MSK_ACTL
.set btns_sts_intr_sts_reg__PER_ST_AUX_CTL_REG, CYREG_B1_UDB07_MSK_ACTL
.set btns_sts_intr_sts_reg__STATUS_AUX_CTL_REG, CYREG_B1_UDB07_ACTL
.set btns_sts_intr_sts_reg__STATUS_CNT_REG, CYREG_B1_UDB07_ST_CTL
.set btns_sts_intr_sts_reg__STATUS_CONTROL_REG, CYREG_B1_UDB07_ST_CTL
.set btns_sts_intr_sts_reg__STATUS_REG, CYREG_B1_UDB07_ST

/* clock */
.set clock__CFG0, CYREG_CLKDIST_DCFG0_CFG0
.set clock__CFG1, CYREG_CLKDIST_DCFG0_CFG1
.set clock__CFG2, CYREG_CLKDIST_DCFG0_CFG2
.set clock__CFG2_SRC_SEL_MASK, 0x07
.set clock__INDEX, 0x00
.set clock__PM_ACT_CFG, CYREG_PM_ACT_CFG2
.set clock__PM_ACT_MSK, 0x01
.set clock__PM_STBY_CFG, CYREG_PM_STBY_CFG2
.set clock__PM_STBY_MSK, 0x01

/* Clock_1 */
.set Clock_1__CFG0, CYREG_CLKDIST_DCFG1_CFG0
.set Clock_1__CFG1, CYREG_CLKDIST_DCFG1_CFG1
.set Clock_1__CFG2, CYREG_CLKDIST_DCFG1_CFG2
.set Clock_1__CFG2_SRC_SEL_MASK, 0x07
.set Clock_1__INDEX, 0x01
.set Clock_1__PM_ACT_CFG, CYREG_PM_ACT_CFG2
.set Clock_1__PM_ACT_MSK, 0x02
.set Clock_1__PM_STBY_CFG, CYREG_PM_STBY_CFG2
.set Clock_1__PM_STBY_MSK, 0x02

/* botones */
.set botones__0__AG, CYREG_PRT3_AG
.set botones__0__AMUX, CYREG_PRT3_AMUX
.set botones__0__BIE, CYREG_PRT3_BIE
.set botones__0__BIT_MASK, CYREG_PRT3_BIT_MASK
.set botones__0__BYP, CYREG_PRT3_BYP
.set botones__0__CTL, CYREG_PRT3_CTL
.set botones__0__DM0, CYREG_PRT3_DM0
.set botones__0__DM1, CYREG_PRT3_DM1
.set botones__0__DM2, CYREG_PRT3_DM2
.set botones__0__DR, CYREG_PRT3_DR
.set botones__0__INP_DIS, CYREG_PRT3_INP_DIS
.set botones__0__INTTYPE, CYREG_PICU3_INTTYPE0
.set botones__0__LCD_COM_SEG, CYREG_PRT3_LCD_COM_SEG
.set botones__0__LCD_EN, CYREG_PRT3_LCD_EN
.set botones__0__MASK, 0x01
.set botones__0__PC, CYREG_PRT3_PC0
.set botones__0__PORT, 3
.set botones__0__PRT, CYREG_PRT3_PRT
.set botones__0__PRTDSI__CAPS_SEL, CYREG_PRT3_CAPS_SEL
.set botones__0__PRTDSI__DBL_SYNC_IN, CYREG_PRT3_DBL_SYNC_IN
.set botones__0__PRTDSI__OE_SEL0, CYREG_PRT3_OE_SEL0
.set botones__0__PRTDSI__OE_SEL1, CYREG_PRT3_OE_SEL1
.set botones__0__PRTDSI__OUT_SEL0, CYREG_PRT3_OUT_SEL0
.set botones__0__PRTDSI__OUT_SEL1, CYREG_PRT3_OUT_SEL1
.set botones__0__PRTDSI__SYNC_OUT, CYREG_PRT3_SYNC_OUT
.set botones__0__PS, CYREG_PRT3_PS
.set botones__0__SHIFT, 0
.set botones__0__SLW, CYREG_PRT3_SLW
.set botones__1__AG, CYREG_PRT3_AG
.set botones__1__AMUX, CYREG_PRT3_AMUX
.set botones__1__BIE, CYREG_PRT3_BIE
.set botones__1__BIT_MASK, CYREG_PRT3_BIT_MASK
.set botones__1__BYP, CYREG_PRT3_BYP
.set botones__1__CTL, CYREG_PRT3_CTL
.set botones__1__DM0, CYREG_PRT3_DM0
.set botones__1__DM1, CYREG_PRT3_DM1
.set botones__1__DM2, CYREG_PRT3_DM2
.set botones__1__DR, CYREG_PRT3_DR
.set botones__1__INP_DIS, CYREG_PRT3_INP_DIS
.set botones__1__INTTYPE, CYREG_PICU3_INTTYPE1
.set botones__1__LCD_COM_SEG, CYREG_PRT3_LCD_COM_SEG
.set botones__1__LCD_EN, CYREG_PRT3_LCD_EN
.set botones__1__MASK, 0x02
.set botones__1__PC, CYREG_PRT3_PC1
.set botones__1__PORT, 3
.set botones__1__PRT, CYREG_PRT3_PRT
.set botones__1__PRTDSI__CAPS_SEL, CYREG_PRT3_CAPS_SEL
.set botones__1__PRTDSI__DBL_SYNC_IN, CYREG_PRT3_DBL_SYNC_IN
.set botones__1__PRTDSI__OE_SEL0, CYREG_PRT3_OE_SEL0
.set botones__1__PRTDSI__OE_SEL1, CYREG_PRT3_OE_SEL1
.set botones__1__PRTDSI__OUT_SEL0, CYREG_PRT3_OUT_SEL0
.set botones__1__PRTDSI__OUT_SEL1, CYREG_PRT3_OUT_SEL1
.set botones__1__PRTDSI__SYNC_OUT, CYREG_PRT3_SYNC_OUT
.set botones__1__PS, CYREG_PRT3_PS
.set botones__1__SHIFT, 1
.set botones__1__SLW, CYREG_PRT3_SLW
.set botones__2__AG, CYREG_PRT15_AG
.set botones__2__AMUX, CYREG_PRT15_AMUX
.set botones__2__BIE, CYREG_PRT15_BIE
.set botones__2__BIT_MASK, CYREG_PRT15_BIT_MASK
.set botones__2__BYP, CYREG_PRT15_BYP
.set botones__2__CTL, CYREG_PRT15_CTL
.set botones__2__DM0, CYREG_PRT15_DM0
.set botones__2__DM1, CYREG_PRT15_DM1
.set botones__2__DM2, CYREG_PRT15_DM2
.set botones__2__DR, CYREG_PRT15_DR
.set botones__2__INP_DIS, CYREG_PRT15_INP_DIS
.set botones__2__INTTYPE, CYREG_PICU15_INTTYPE0
.set botones__2__LCD_COM_SEG, CYREG_PRT15_LCD_COM_SEG
.set botones__2__LCD_EN, CYREG_PRT15_LCD_EN
.set botones__2__MASK, 0x01
.set botones__2__PC, CYREG_IO_PC_PRT15_PC0
.set botones__2__PORT, 15
.set botones__2__PRT, CYREG_PRT15_PRT
.set botones__2__PRTDSI__CAPS_SEL, CYREG_PRT15_CAPS_SEL
.set botones__2__PRTDSI__DBL_SYNC_IN, CYREG_PRT15_DBL_SYNC_IN
.set botones__2__PRTDSI__OE_SEL0, CYREG_PRT15_OE_SEL0
.set botones__2__PRTDSI__OE_SEL1, CYREG_PRT15_OE_SEL1
.set botones__2__PRTDSI__OUT_SEL0, CYREG_PRT15_OUT_SEL0
.set botones__2__PRTDSI__OUT_SEL1, CYREG_PRT15_OUT_SEL1
.set botones__2__PRTDSI__SYNC_OUT, CYREG_PRT15_SYNC_OUT
.set botones__2__PS, CYREG_PRT15_PS
.set botones__2__SHIFT, 0
.set botones__2__SLW, CYREG_PRT15_SLW

/* contador */
.set contador__INTC_CLR_EN_REG, CYREG_NVIC_CLRENA0
.set contador__INTC_CLR_PD_REG, CYREG_NVIC_CLRPEND0
.set contador__INTC_MASK, 0x02
.set contador__INTC_NUMBER, 1
.set contador__INTC_PRIOR_NUM, 7
.set contador__INTC_PRIOR_REG, CYREG_NVIC_PRI_1
.set contador__INTC_SET_EN_REG, CYREG_NVIC_SETENA0
.set contador__INTC_SET_PD_REG, CYREG_NVIC_SETPEND0

/* Actuador_0 */
.set Actuador_0__0__INTTYPE, CYREG_PICU0_INTTYPE0
.set Actuador_0__0__MASK, 0x01
.set Actuador_0__0__PC, CYREG_PRT0_PC0
.set Actuador_0__0__PORT, 0
.set Actuador_0__0__SHIFT, 0
.set Actuador_0__AG, CYREG_PRT0_AG
.set Actuador_0__AMUX, CYREG_PRT0_AMUX
.set Actuador_0__BIE, CYREG_PRT0_BIE
.set Actuador_0__BIT_MASK, CYREG_PRT0_BIT_MASK
.set Actuador_0__BYP, CYREG_PRT0_BYP
.set Actuador_0__CTL, CYREG_PRT0_CTL
.set Actuador_0__DM0, CYREG_PRT0_DM0
.set Actuador_0__DM1, CYREG_PRT0_DM1
.set Actuador_0__DM2, CYREG_PRT0_DM2
.set Actuador_0__DR, CYREG_PRT0_DR
.set Actuador_0__INP_DIS, CYREG_PRT0_INP_DIS
.set Actuador_0__INTTYPE_BASE, CYDEV_PICU_INTTYPE_PICU0_BASE
.set Actuador_0__LCD_COM_SEG, CYREG_PRT0_LCD_COM_SEG
.set Actuador_0__LCD_EN, CYREG_PRT0_LCD_EN
.set Actuador_0__MASK, 0x01
.set Actuador_0__PORT, 0
.set Actuador_0__PRT, CYREG_PRT0_PRT
.set Actuador_0__PRTDSI__CAPS_SEL, CYREG_PRT0_CAPS_SEL
.set Actuador_0__PRTDSI__DBL_SYNC_IN, CYREG_PRT0_DBL_SYNC_IN
.set Actuador_0__PRTDSI__OE_SEL0, CYREG_PRT0_OE_SEL0
.set Actuador_0__PRTDSI__OE_SEL1, CYREG_PRT0_OE_SEL1
.set Actuador_0__PRTDSI__OUT_SEL0, CYREG_PRT0_OUT_SEL0
.set Actuador_0__PRTDSI__OUT_SEL1, CYREG_PRT0_OUT_SEL1
.set Actuador_0__PRTDSI__SYNC_OUT, CYREG_PRT0_SYNC_OUT
.set Actuador_0__PS, CYREG_PRT0_PS
.set Actuador_0__SHIFT, 0
.set Actuador_0__SLW, CYREG_PRT0_SLW

/* Actuador_1 */
.set Actuador_1__0__INTTYPE, CYREG_PICU0_INTTYPE7
.set Actuador_1__0__MASK, 0x80
.set Actuador_1__0__PC, CYREG_PRT0_PC7
.set Actuador_1__0__PORT, 0
.set Actuador_1__0__SHIFT, 7
.set Actuador_1__AG, CYREG_PRT0_AG
.set Actuador_1__AMUX, CYREG_PRT0_AMUX
.set Actuador_1__BIE, CYREG_PRT0_BIE
.set Actuador_1__BIT_MASK, CYREG_PRT0_BIT_MASK
.set Actuador_1__BYP, CYREG_PRT0_BYP
.set Actuador_1__CTL, CYREG_PRT0_CTL
.set Actuador_1__DM0, CYREG_PRT0_DM0
.set Actuador_1__DM1, CYREG_PRT0_DM1
.set Actuador_1__DM2, CYREG_PRT0_DM2
.set Actuador_1__DR, CYREG_PRT0_DR
.set Actuador_1__INP_DIS, CYREG_PRT0_INP_DIS
.set Actuador_1__INTTYPE_BASE, CYDEV_PICU_INTTYPE_PICU0_BASE
.set Actuador_1__LCD_COM_SEG, CYREG_PRT0_LCD_COM_SEG
.set Actuador_1__LCD_EN, CYREG_PRT0_LCD_EN
.set Actuador_1__MASK, 0x80
.set Actuador_1__PORT, 0
.set Actuador_1__PRT, CYREG_PRT0_PRT
.set Actuador_1__PRTDSI__CAPS_SEL, CYREG_PRT0_CAPS_SEL
.set Actuador_1__PRTDSI__DBL_SYNC_IN, CYREG_PRT0_DBL_SYNC_IN
.set Actuador_1__PRTDSI__OE_SEL0, CYREG_PRT0_OE_SEL0
.set Actuador_1__PRTDSI__OE_SEL1, CYREG_PRT0_OE_SEL1
.set Actuador_1__PRTDSI__OUT_SEL0, CYREG_PRT0_OUT_SEL0
.set Actuador_1__PRTDSI__OUT_SEL1, CYREG_PRT0_OUT_SEL1
.set Actuador_1__PRTDSI__SYNC_OUT, CYREG_PRT0_SYNC_OUT
.set Actuador_1__PS, CYREG_PRT0_PS
.set Actuador_1__SHIFT, 7
.set Actuador_1__SLW, CYREG_PRT0_SLW

/* Actuador_2 */
.set Actuador_2__0__INTTYPE, CYREG_PICU0_INTTYPE3
.set Actuador_2__0__MASK, 0x08
.set Actuador_2__0__PC, CYREG_PRT0_PC3
.set Actuador_2__0__PORT, 0
.set Actuador_2__0__SHIFT, 3
.set Actuador_2__AG, CYREG_PRT0_AG
.set Actuador_2__AMUX, CYREG_PRT0_AMUX
.set Actuador_2__BIE, CYREG_PRT0_BIE
.set Actuador_2__BIT_MASK, CYREG_PRT0_BIT_MASK
.set Actuador_2__BYP, CYREG_PRT0_BYP
.set Actuador_2__CTL, CYREG_PRT0_CTL
.set Actuador_2__DM0, CYREG_PRT0_DM0
.set Actuador_2__DM1, CYREG_PRT0_DM1
.set Actuador_2__DM2, CYREG_PRT0_DM2
.set Actuador_2__DR, CYREG_PRT0_DR
.set Actuador_2__INP_DIS, CYREG_PRT0_INP_DIS
.set Actuador_2__INTTYPE_BASE, CYDEV_PICU_INTTYPE_PICU0_BASE
.set Actuador_2__LCD_COM_SEG, CYREG_PRT0_LCD_COM_SEG
.set Actuador_2__LCD_EN, CYREG_PRT0_LCD_EN
.set Actuador_2__MASK, 0x08
.set Actuador_2__PORT, 0
.set Actuador_2__PRT, CYREG_PRT0_PRT
.set Actuador_2__PRTDSI__CAPS_SEL, CYREG_PRT0_CAPS_SEL
.set Actuador_2__PRTDSI__DBL_SYNC_IN, CYREG_PRT0_DBL_SYNC_IN
.set Actuador_2__PRTDSI__OE_SEL0, CYREG_PRT0_OE_SEL0
.set Actuador_2__PRTDSI__OE_SEL1, CYREG_PRT0_OE_SEL1
.set Actuador_2__PRTDSI__OUT_SEL0, CYREG_PRT0_OUT_SEL0
.set Actuador_2__PRTDSI__OUT_SEL1, CYREG_PRT0_OUT_SEL1
.set Actuador_2__PRTDSI__SYNC_OUT, CYREG_PRT0_SYNC_OUT
.set Actuador_2__PS, CYREG_PRT0_PS
.set Actuador_2__SHIFT, 3
.set Actuador_2__SLW, CYREG_PRT0_SLW

/* Actuador_3 */
.set Actuador_3__0__INTTYPE, CYREG_PICU15_INTTYPE3
.set Actuador_3__0__MASK, 0x08
.set Actuador_3__0__PC, CYREG_IO_PC_PRT15_PC3
.set Actuador_3__0__PORT, 15
.set Actuador_3__0__SHIFT, 3
.set Actuador_3__AG, CYREG_PRT15_AG
.set Actuador_3__AMUX, CYREG_PRT15_AMUX
.set Actuador_3__BIE, CYREG_PRT15_BIE
.set Actuador_3__BIT_MASK, CYREG_PRT15_BIT_MASK
.set Actuador_3__BYP, CYREG_PRT15_BYP
.set Actuador_3__CTL, CYREG_PRT15_CTL
.set Actuador_3__DM0, CYREG_PRT15_DM0
.set Actuador_3__DM1, CYREG_PRT15_DM1
.set Actuador_3__DM2, CYREG_PRT15_DM2
.set Actuador_3__DR, CYREG_PRT15_DR
.set Actuador_3__INP_DIS, CYREG_PRT15_INP_DIS
.set Actuador_3__INTTYPE_BASE, CYDEV_PICU_INTTYPE_PICU15_BASE
.set Actuador_3__LCD_COM_SEG, CYREG_PRT15_LCD_COM_SEG
.set Actuador_3__LCD_EN, CYREG_PRT15_LCD_EN
.set Actuador_3__MASK, 0x08
.set Actuador_3__PORT, 15
.set Actuador_3__PRT, CYREG_PRT15_PRT
.set Actuador_3__PRTDSI__CAPS_SEL, CYREG_PRT15_CAPS_SEL
.set Actuador_3__PRTDSI__DBL_SYNC_IN, CYREG_PRT15_DBL_SYNC_IN
.set Actuador_3__PRTDSI__OE_SEL0, CYREG_PRT15_OE_SEL0
.set Actuador_3__PRTDSI__OE_SEL1, CYREG_PRT15_OE_SEL1
.set Actuador_3__PRTDSI__OUT_SEL0, CYREG_PRT15_OUT_SEL0
.set Actuador_3__PRTDSI__OUT_SEL1, CYREG_PRT15_OUT_SEL1
.set Actuador_3__PRTDSI__SYNC_OUT, CYREG_PRT15_SYNC_OUT
.set Actuador_3__PS, CYREG_PRT15_PS
.set Actuador_3__SHIFT, 3
.set Actuador_3__SLW, CYREG_PRT15_SLW

/* Actuador_4 */
.set Actuador_4__0__INTTYPE, CYREG_PICU12_INTTYPE2
.set Actuador_4__0__MASK, 0x04
.set Actuador_4__0__PC, CYREG_PRT12_PC2
.set Actuador_4__0__PORT, 12
.set Actuador_4__0__SHIFT, 2
.set Actuador_4__AG, CYREG_PRT12_AG
.set Actuador_4__BIE, CYREG_PRT12_BIE
.set Actuador_4__BIT_MASK, CYREG_PRT12_BIT_MASK
.set Actuador_4__BYP, CYREG_PRT12_BYP
.set Actuador_4__DM0, CYREG_PRT12_DM0
.set Actuador_4__DM1, CYREG_PRT12_DM1
.set Actuador_4__DM2, CYREG_PRT12_DM2
.set Actuador_4__DR, CYREG_PRT12_DR
.set Actuador_4__INP_DIS, CYREG_PRT12_INP_DIS
.set Actuador_4__INTTYPE_BASE, CYDEV_PICU_INTTYPE_PICU12_BASE
.set Actuador_4__MASK, 0x04
.set Actuador_4__PORT, 12
.set Actuador_4__PRT, CYREG_PRT12_PRT
.set Actuador_4__PRTDSI__DBL_SYNC_IN, CYREG_PRT12_DBL_SYNC_IN
.set Actuador_4__PRTDSI__OE_SEL0, CYREG_PRT12_OE_SEL0
.set Actuador_4__PRTDSI__OE_SEL1, CYREG_PRT12_OE_SEL1
.set Actuador_4__PRTDSI__OUT_SEL0, CYREG_PRT12_OUT_SEL0
.set Actuador_4__PRTDSI__OUT_SEL1, CYREG_PRT12_OUT_SEL1
.set Actuador_4__PRTDSI__SYNC_OUT, CYREG_PRT12_SYNC_OUT
.set Actuador_4__PS, CYREG_PRT12_PS
.set Actuador_4__SHIFT, 2
.set Actuador_4__SIO_CFG, CYREG_PRT12_SIO_CFG
.set Actuador_4__SIO_DIFF, CYREG_PRT12_SIO_DIFF
.set Actuador_4__SIO_HYST_EN, CYREG_PRT12_SIO_HYST_EN
.set Actuador_4__SIO_REG_HIFREQ, CYREG_PRT12_SIO_REG_HIFREQ
.set Actuador_4__SLW, CYREG_PRT12_SLW

/* Actuador_5 */
.set Actuador_5__0__INTTYPE, CYREG_PICU0_INTTYPE4
.set Actuador_5__0__MASK, 0x10
.set Actuador_5__0__PC, CYREG_PRT0_PC4
.set Actuador_5__0__PORT, 0
.set Actuador_5__0__SHIFT, 4
.set Actuador_5__AG, CYREG_PRT0_AG
.set Actuador_5__AMUX, CYREG_PRT0_AMUX
.set Actuador_5__BIE, CYREG_PRT0_BIE
.set Actuador_5__BIT_MASK, CYREG_PRT0_BIT_MASK
.set Actuador_5__BYP, CYREG_PRT0_BYP
.set Actuador_5__CTL, CYREG_PRT0_CTL
.set Actuador_5__DM0, CYREG_PRT0_DM0
.set Actuador_5__DM1, CYREG_PRT0_DM1
.set Actuador_5__DM2, CYREG_PRT0_DM2
.set Actuador_5__DR, CYREG_PRT0_DR
.set Actuador_5__INP_DIS, CYREG_PRT0_INP_DIS
.set Actuador_5__INTTYPE_BASE, CYDEV_PICU_INTTYPE_PICU0_BASE
.set Actuador_5__LCD_COM_SEG, CYREG_PRT0_LCD_COM_SEG
.set Actuador_5__LCD_EN, CYREG_PRT0_LCD_EN
.set Actuador_5__MASK, 0x10
.set Actuador_5__PORT, 0
.set Actuador_5__PRT, CYREG_PRT0_PRT
.set Actuador_5__PRTDSI__CAPS_SEL, CYREG_PRT0_CAPS_SEL
.set Actuador_5__PRTDSI__DBL_SYNC_IN, CYREG_PRT0_DBL_SYNC_IN
.set Actuador_5__PRTDSI__OE_SEL0, CYREG_PRT0_OE_SEL0
.set Actuador_5__PRTDSI__OE_SEL1, CYREG_PRT0_OE_SEL1
.set Actuador_5__PRTDSI__OUT_SEL0, CYREG_PRT0_OUT_SEL0
.set Actuador_5__PRTDSI__OUT_SEL1, CYREG_PRT0_OUT_SEL1
.set Actuador_5__PRTDSI__SYNC_OUT, CYREG_PRT0_SYNC_OUT
.set Actuador_5__PS, CYREG_PRT0_PS
.set Actuador_5__SHIFT, 4
.set Actuador_5__SLW, CYREG_PRT0_SLW

/* Actuador_6 */
.set Actuador_6__0__INTTYPE, CYREG_PICU12_INTTYPE3
.set Actuador_6__0__MASK, 0x08
.set Actuador_6__0__PC, CYREG_PRT12_PC3
.set Actuador_6__0__PORT, 12
.set Actuador_6__0__SHIFT, 3
.set Actuador_6__AG, CYREG_PRT12_AG
.set Actuador_6__BIE, CYREG_PRT12_BIE
.set Actuador_6__BIT_MASK, CYREG_PRT12_BIT_MASK
.set Actuador_6__BYP, CYREG_PRT12_BYP
.set Actuador_6__DM0, CYREG_PRT12_DM0
.set Actuador_6__DM1, CYREG_PRT12_DM1
.set Actuador_6__DM2, CYREG_PRT12_DM2
.set Actuador_6__DR, CYREG_PRT12_DR
.set Actuador_6__INP_DIS, CYREG_PRT12_INP_DIS
.set Actuador_6__INTTYPE_BASE, CYDEV_PICU_INTTYPE_PICU12_BASE
.set Actuador_6__MASK, 0x08
.set Actuador_6__PORT, 12
.set Actuador_6__PRT, CYREG_PRT12_PRT
.set Actuador_6__PRTDSI__DBL_SYNC_IN, CYREG_PRT12_DBL_SYNC_IN
.set Actuador_6__PRTDSI__OE_SEL0, CYREG_PRT12_OE_SEL0
.set Actuador_6__PRTDSI__OE_SEL1, CYREG_PRT12_OE_SEL1
.set Actuador_6__PRTDSI__OUT_SEL0, CYREG_PRT12_OUT_SEL0
.set Actuador_6__PRTDSI__OUT_SEL1, CYREG_PRT12_OUT_SEL1
.set Actuador_6__PRTDSI__SYNC_OUT, CYREG_PRT12_SYNC_OUT
.set Actuador_6__PS, CYREG_PRT12_PS
.set Actuador_6__SHIFT, 3
.set Actuador_6__SIO_CFG, CYREG_PRT12_SIO_CFG
.set Actuador_6__SIO_DIFF, CYREG_PRT12_SIO_DIFF
.set Actuador_6__SIO_HYST_EN, CYREG_PRT12_SIO_HYST_EN
.set Actuador_6__SIO_REG_HIFREQ, CYREG_PRT12_SIO_REG_HIFREQ
.set Actuador_6__SLW, CYREG_PRT12_SLW

/* Actuador_7 */
.set Actuador_7__0__INTTYPE, CYREG_PICU0_INTTYPE5
.set Actuador_7__0__MASK, 0x20
.set Actuador_7__0__PC, CYREG_PRT0_PC5
.set Actuador_7__0__PORT, 0
.set Actuador_7__0__SHIFT, 5
.set Actuador_7__AG, CYREG_PRT0_AG
.set Actuador_7__AMUX, CYREG_PRT0_AMUX
.set Actuador_7__BIE, CYREG_PRT0_BIE
.set Actuador_7__BIT_MASK, CYREG_PRT0_BIT_MASK
.set Actuador_7__BYP, CYREG_PRT0_BYP
.set Actuador_7__CTL, CYREG_PRT0_CTL
.set Actuador_7__DM0, CYREG_PRT0_DM0
.set Actuador_7__DM1, CYREG_PRT0_DM1
.set Actuador_7__DM2, CYREG_PRT0_DM2
.set Actuador_7__DR, CYREG_PRT0_DR
.set Actuador_7__INP_DIS, CYREG_PRT0_INP_DIS
.set Actuador_7__INTTYPE_BASE, CYDEV_PICU_INTTYPE_PICU0_BASE
.set Actuador_7__LCD_COM_SEG, CYREG_PRT0_LCD_COM_SEG
.set Actuador_7__LCD_EN, CYREG_PRT0_LCD_EN
.set Actuador_7__MASK, 0x20
.set Actuador_7__PORT, 0
.set Actuador_7__PRT, CYREG_PRT0_PRT
.set Actuador_7__PRTDSI__CAPS_SEL, CYREG_PRT0_CAPS_SEL
.set Actuador_7__PRTDSI__DBL_SYNC_IN, CYREG_PRT0_DBL_SYNC_IN
.set Actuador_7__PRTDSI__OE_SEL0, CYREG_PRT0_OE_SEL0
.set Actuador_7__PRTDSI__OE_SEL1, CYREG_PRT0_OE_SEL1
.set Actuador_7__PRTDSI__OUT_SEL0, CYREG_PRT0_OUT_SEL0
.set Actuador_7__PRTDSI__OUT_SEL1, CYREG_PRT0_OUT_SEL1
.set Actuador_7__PRTDSI__SYNC_OUT, CYREG_PRT0_SYNC_OUT
.set Actuador_7__PS, CYREG_PRT0_PS
.set Actuador_7__SHIFT, 5
.set Actuador_7__SLW, CYREG_PRT0_SLW

/* Actuadores */
.set Actuadores_Sync_ctrl_reg__0__MASK, 0x01
.set Actuadores_Sync_ctrl_reg__0__POS, 0
.set Actuadores_Sync_ctrl_reg__1__MASK, 0x02
.set Actuadores_Sync_ctrl_reg__1__POS, 1
.set Actuadores_Sync_ctrl_reg__16BIT_CONTROL_AUX_CTL_REG, CYREG_B1_UDB06_07_ACTL
.set Actuadores_Sync_ctrl_reg__16BIT_CONTROL_CONTROL_REG, CYREG_B1_UDB06_07_CTL
.set Actuadores_Sync_ctrl_reg__16BIT_CONTROL_COUNT_REG, CYREG_B1_UDB06_07_CTL
.set Actuadores_Sync_ctrl_reg__16BIT_COUNT_CONTROL_REG, CYREG_B1_UDB06_07_CTL
.set Actuadores_Sync_ctrl_reg__16BIT_COUNT_COUNT_REG, CYREG_B1_UDB06_07_CTL
.set Actuadores_Sync_ctrl_reg__16BIT_MASK_MASK_REG, CYREG_B1_UDB06_07_MSK
.set Actuadores_Sync_ctrl_reg__16BIT_MASK_PERIOD_REG, CYREG_B1_UDB06_07_MSK
.set Actuadores_Sync_ctrl_reg__16BIT_PERIOD_MASK_REG, CYREG_B1_UDB06_07_MSK
.set Actuadores_Sync_ctrl_reg__16BIT_PERIOD_PERIOD_REG, CYREG_B1_UDB06_07_MSK
.set Actuadores_Sync_ctrl_reg__2__MASK, 0x04
.set Actuadores_Sync_ctrl_reg__2__POS, 2
.set Actuadores_Sync_ctrl_reg__3__MASK, 0x08
.set Actuadores_Sync_ctrl_reg__3__POS, 3
.set Actuadores_Sync_ctrl_reg__4__MASK, 0x10
.set Actuadores_Sync_ctrl_reg__4__POS, 4
.set Actuadores_Sync_ctrl_reg__5__MASK, 0x20
.set Actuadores_Sync_ctrl_reg__5__POS, 5
.set Actuadores_Sync_ctrl_reg__6__MASK, 0x40
.set Actuadores_Sync_ctrl_reg__6__POS, 6
.set Actuadores_Sync_ctrl_reg__7__MASK, 0x80
.set Actuadores_Sync_ctrl_reg__7__POS, 7
.set Actuadores_Sync_ctrl_reg__CONTROL_AUX_CTL_REG, CYREG_B1_UDB06_ACTL
.set Actuadores_Sync_ctrl_reg__CONTROL_REG, CYREG_B1_UDB06_CTL
.set Actuadores_Sync_ctrl_reg__CONTROL_ST_REG, CYREG_B1_UDB06_ST_CTL
.set Actuadores_Sync_ctrl_reg__COUNT_REG, CYREG_B1_UDB06_CTL
.set Actuadores_Sync_ctrl_reg__COUNT_ST_REG, CYREG_B1_UDB06_ST_CTL
.set Actuadores_Sync_ctrl_reg__MASK, 0xFF
.set Actuadores_Sync_ctrl_reg__MASK_CTL_AUX_CTL_REG, CYREG_B1_UDB06_MSK_ACTL
.set Actuadores_Sync_ctrl_reg__PER_CTL_AUX_CTL_REG, CYREG_B1_UDB06_MSK_ACTL
.set Actuadores_Sync_ctrl_reg__PERIOD_REG, CYREG_B1_UDB06_MSK

/* actualizar */
.set actualizar__INTC_CLR_EN_REG, CYREG_NVIC_CLRENA0
.set actualizar__INTC_CLR_PD_REG, CYREG_NVIC_CLRPEND0
.set actualizar__INTC_MASK, 0x01
.set actualizar__INTC_NUMBER, 0
.set actualizar__INTC_PRIOR_NUM, 7
.set actualizar__INTC_PRIOR_REG, CYREG_NVIC_PRI_0
.set actualizar__INTC_SET_EN_REG, CYREG_NVIC_SETENA0
.set actualizar__INTC_SET_PD_REG, CYREG_NVIC_SETPEND0

/* Miscellaneous */
.set BCLK__BUS_CLK__HZ, 24000000
.set BCLK__BUS_CLK__KHZ, 24000
.set BCLK__BUS_CLK__MHZ, 24
.set CYDEV_CHIP_DIE_LEOPARD, 1
.set CYDEV_CHIP_DIE_PSOC4A, 26
.set CYDEV_CHIP_DIE_PSOC5LP, 2
.set CYDEV_CHIP_DIE_PSOC5TM, 3
.set CYDEV_CHIP_DIE_TMA4, 4
.set CYDEV_CHIP_DIE_UNKNOWN, 0
.set CYDEV_CHIP_FAMILY_FM0P, 5
.set CYDEV_CHIP_FAMILY_FM3, 6
.set CYDEV_CHIP_FAMILY_FM4, 7
.set CYDEV_CHIP_FAMILY_PSOC3, 1
.set CYDEV_CHIP_FAMILY_PSOC4, 2
.set CYDEV_CHIP_FAMILY_PSOC5, 3
.set CYDEV_CHIP_FAMILY_PSOC6, 4
.set CYDEV_CHIP_FAMILY_UNKNOWN, 0
.set CYDEV_CHIP_FAMILY_USED, CYDEV_CHIP_FAMILY_PSOC5
.set CYDEV_CHIP_JTAG_ID, 0x2E161069
.set CYDEV_CHIP_MEMBER_3A, 1
.set CYDEV_CHIP_MEMBER_4A, 26
.set CYDEV_CHIP_MEMBER_4AA, 25
.set CYDEV_CHIP_MEMBER_4AB, 30
.set CYDEV_CHIP_MEMBER_4AC, 14
.set CYDEV_CHIP_MEMBER_4AD, 15
.set CYDEV_CHIP_MEMBER_4AE, 16
.set CYDEV_CHIP_MEMBER_4D, 20
.set CYDEV_CHIP_MEMBER_4E, 6
.set CYDEV_CHIP_MEMBER_4F, 27
.set CYDEV_CHIP_MEMBER_4G, 4
.set CYDEV_CHIP_MEMBER_4H, 24
.set CYDEV_CHIP_MEMBER_4I, 32
.set CYDEV_CHIP_MEMBER_4J, 21
.set CYDEV_CHIP_MEMBER_4K, 22
.set CYDEV_CHIP_MEMBER_4L, 31
.set CYDEV_CHIP_MEMBER_4M, 29
.set CYDEV_CHIP_MEMBER_4N, 11
.set CYDEV_CHIP_MEMBER_4O, 8
.set CYDEV_CHIP_MEMBER_4P, 28
.set CYDEV_CHIP_MEMBER_4Q, 17
.set CYDEV_CHIP_MEMBER_4R, 9
.set CYDEV_CHIP_MEMBER_4S, 12
.set CYDEV_CHIP_MEMBER_4T, 10
.set CYDEV_CHIP_MEMBER_4U, 5
.set CYDEV_CHIP_MEMBER_4V, 23
.set CYDEV_CHIP_MEMBER_4W, 13
.set CYDEV_CHIP_MEMBER_4X, 7
.set CYDEV_CHIP_MEMBER_4Y, 18
.set CYDEV_CHIP_MEMBER_4Z, 19
.set CYDEV_CHIP_MEMBER_5A, 3
.set CYDEV_CHIP_MEMBER_5B, 2
.set CYDEV_CHIP_MEMBER_6A, 33
.set CYDEV_CHIP_MEMBER_FM3, 37
.set CYDEV_CHIP_MEMBER_FM4, 38
.set CYDEV_CHIP_MEMBER_PDL_FM0P_TYPE1, 34
.set CYDEV_CHIP_MEMBER_PDL_FM0P_TYPE2, 35
.set CYDEV_CHIP_MEMBER_PDL_FM0P_TYPE3, 36
.set CYDEV_CHIP_MEMBER_UNKNOWN, 0
.set CYDEV_CHIP_MEMBER_USED, CYDEV_CHIP_MEMBER_5B
.set CYDEV_CHIP_DIE_EXPECT, CYDEV_CHIP_MEMBER_USED
.set CYDEV_CHIP_DIE_ACTUAL, CYDEV_CHIP_DIE_EXPECT
.set CYDEV_CHIP_REV_LEOPARD_ES1, 0
.set CYDEV_CHIP_REV_LEOPARD_ES2, 1
.set CYDEV_CHIP_REV_LEOPARD_ES3, 3
.set CYDEV_CHIP_REV_LEOPARD_PRODUCTION, 3
.set CYDEV_CHIP_REV_PSOC4A_ES0, 17
.set CYDEV_CHIP_REV_PSOC4A_PRODUCTION, 17
.set CYDEV_CHIP_REV_PSOC5LP_ES0, 0
.set CYDEV_CHIP_REV_PSOC5LP_PRODUCTION, 0
.set CYDEV_CHIP_REV_PSOC5TM_ES0, 0
.set CYDEV_CHIP_REV_PSOC5TM_ES1, 1
.set CYDEV_CHIP_REV_PSOC5TM_PRODUCTION, 1
.set CYDEV_CHIP_REV_TMA4_ES, 17
.set CYDEV_CHIP_REV_TMA4_ES2, 33
.set CYDEV_CHIP_REV_TMA4_PRODUCTION, 17
.set CYDEV_CHIP_REVISION_3A_ES1, 0
.set CYDEV_CHIP_REVISION_3A_ES2, 1
.set CYDEV_CHIP_REVISION_3A_ES3, 3
.set CYDEV_CHIP_REVISION_3A_PRODUCTION, 3
.set CYDEV_CHIP_REVISION_4A_ES0, 17
.set CYDEV_CHIP_REVISION_4A_PRODUCTION, 17
.set CYDEV_CHIP_REVISION_4AA_PRODUCTION, 0
.set CYDEV_CHIP_REVISION_4AB_PRODUCTION, 0
.set CYDEV_CHIP_REVISION_4AC_PRODUCTION, 0
.set CYDEV_CHIP_REVISION_4AD_PRODUCTION, 0
.set CYDEV_CHIP_REVISION_4AE_PRODUCTION, 0
.set CYDEV_CHIP_REVISION_4D_PRODUCTION, 0
.set CYDEV_CHIP_REVISION_4E_CCG2_NO_USBPD, 0
.set CYDEV_CHIP_REVISION_4E_PRODUCTION, 0
.set CYDEV_CHIP_REVISION_4F_PRODUCTION, 0
.set CYDEV_CHIP_REVISION_4F_PRODUCTION_256DMA, 0
.set CYDEV_CHIP_REVISION_4F_PRODUCTION_256K, 0
.set CYDEV_CHIP_REVISION_4G_ES, 17
.set CYDEV_CHIP_REVISION_4G_ES2, 33
.set CYDEV_CHIP_REVISION_4G_PRODUCTION, 17
.set CYDEV_CHIP_REVISION_4H_PRODUCTION, 0
.set CYDEV_CHIP_REVISION_4I_PRODUCTION, 0
.set CYDEV_CHIP_REVISION_4J_PRODUCTION, 0
.set CYDEV_CHIP_REVISION_4K_PRODUCTION, 0
.set CYDEV_CHIP_REVISION_4L_PRODUCTION, 0
.set CYDEV_CHIP_REVISION_4M_PRODUCTION, 0
.set CYDEV_CHIP_REVISION_4N_PRODUCTION, 0
.set CYDEV_CHIP_REVISION_4O_PRODUCTION, 0
.set CYDEV_CHIP_REVISION_4P_PRODUCTION, 0
.set CYDEV_CHIP_REVISION_4Q_PRODUCTION, 0
.set CYDEV_CHIP_REVISION_4R_PRODUCTION, 0
.set CYDEV_CHIP_REVISION_4S_PRODUCTION, 0
.set CYDEV_CHIP_REVISION_4T_PRODUCTION, 0
.set CYDEV_CHIP_REVISION_4U_PRODUCTION, 0
.set CYDEV_CHIP_REVISION_4V_PRODUCTION, 0
.set CYDEV_CHIP_REVISION_4W_PRODUCTION, 0
.set CYDEV_CHIP_REVISION_4X_PRODUCTION, 0
.set CYDEV_CHIP_REVISION_4Y_PRODUCTION, 0
.set CYDEV_CHIP_REVISION_4Z_PRODUCTION, 0
.set CYDEV_CHIP_REVISION_5A_ES0, 0
.set CYDEV_CHIP_REVISION_5A_ES1, 1
.set CYDEV_CHIP_REVISION_5A_PRODUCTION, 1
.set CYDEV_CHIP_REVISION_5B_ES0, 0
.set CYDEV_CHIP_REVISION_5B_PRODUCTION, 0
.set CYDEV_CHIP_REVISION_6A_ES, 17
.set CYDEV_CHIP_REVISION_6A_NO_UDB, 33
.set CYDEV_CHIP_REVISION_6A_PRODUCTION, 33
.set CYDEV_CHIP_REVISION_FM3_PRODUCTION, 0
.set CYDEV_CHIP_REVISION_FM4_PRODUCTION, 0
.set CYDEV_CHIP_REVISION_PDL_FM0P_TYPE1_PRODUCTION, 0
.set CYDEV_CHIP_REVISION_PDL_FM0P_TYPE2_PRODUCTION, 0
.set CYDEV_CHIP_REVISION_PDL_FM0P_TYPE3_PRODUCTION, 0
.set CYDEV_CHIP_REVISION_USED, CYDEV_CHIP_REVISION_5B_PRODUCTION
.set CYDEV_CHIP_REV_EXPECT, CYDEV_CHIP_REVISION_USED
.set CYDEV_CONFIG_FASTBOOT_ENABLED, 1
.set CYDEV_CONFIG_UNUSED_IO_AllowButWarn, 0
.set CYDEV_CONFIG_UNUSED_IO, CYDEV_CONFIG_UNUSED_IO_AllowButWarn
.set CYDEV_CONFIG_UNUSED_IO_AllowWithInfo, 1
.set CYDEV_CONFIG_UNUSED_IO_Disallowed, 2
.set CYDEV_CONFIGURATION_COMPRESSED, 1
.set CYDEV_CONFIGURATION_DMA, 0
.set CYDEV_CONFIGURATION_ECC, 1
.set CYDEV_CONFIGURATION_IMOENABLED, CYDEV_CONFIG_FASTBOOT_ENABLED
.set CYDEV_CONFIGURATION_MODE_COMPRESSED, 0
.set CYDEV_CONFIGURATION_MODE, CYDEV_CONFIGURATION_MODE_COMPRESSED
.set CYDEV_CONFIGURATION_MODE_DMA, 2
.set CYDEV_CONFIGURATION_MODE_UNCOMPRESSED, 1
.set CYDEV_DEBUG_ENABLE_MASK, 0x20
.set CYDEV_DEBUG_ENABLE_REGISTER, CYREG_MLOGIC_DEBUG
.set CYDEV_DEBUGGING_DPS_Disable, 3
.set CYDEV_DEBUGGING_DPS_JTAG_4, 1
.set CYDEV_DEBUGGING_DPS_JTAG_5, 0
.set CYDEV_DEBUGGING_DPS_SWD, 2
.set CYDEV_DEBUGGING_DPS_SWD_SWV, 6
.set CYDEV_DEBUGGING_DPS, CYDEV_DEBUGGING_DPS_SWD_SWV
.set CYDEV_DEBUGGING_ENABLE, 1
.set CYDEV_DEBUGGING_XRES, 0
.set CYDEV_DMA_CHANNELS_AVAILABLE, 24
.set CYDEV_ECC_ENABLE, 0
.set CYDEV_HEAP_SIZE, 0x80
.set CYDEV_INSTRUCT_CACHE_ENABLED, 1
.set CYDEV_INTR_RISING, 0x00000003
.set CYDEV_IS_EXPORTING_CODE, 0
.set CYDEV_IS_IMPORTING_CODE, 0
.set CYDEV_PROJ_TYPE, 0
.set CYDEV_PROJ_TYPE_BOOTLOADER, 1
.set CYDEV_PROJ_TYPE_LAUNCHER, 5
.set CYDEV_PROJ_TYPE_LOADABLE, 2
.set CYDEV_PROJ_TYPE_LOADABLEANDBOOTLOADER, 4
.set CYDEV_PROJ_TYPE_MULTIAPPBOOTLOADER, 3
.set CYDEV_PROJ_TYPE_STANDARD, 0
.set CYDEV_PROTECTION_ENABLE, 0
.set CYDEV_STACK_SIZE, 0x0800
.set CYDEV_USE_BUNDLED_CMSIS, 1
.set CYDEV_VARIABLE_VDDA, 0
.set CYDEV_VDDA_MV, 5000
.set CYDEV_VDDD_MV, 5000
.set CYDEV_VDDIO0_MV, 5000
.set CYDEV_VDDIO1_MV, 5000
.set CYDEV_VDDIO2_MV, 5000
.set CYDEV_VDDIO3_MV, 5000
.set CYDEV_VIO0_MV, 5000
.set CYDEV_VIO1_MV, 5000
.set CYDEV_VIO2_MV, 5000
.set CYDEV_VIO3_MV, 5000
.set CYIPBLOCK_ARM_CM3_VERSION, 0
.set CYIPBLOCK_P3_ANAIF_VERSION, 0
.set CYIPBLOCK_P3_CAN_VERSION, 0
.set CYIPBLOCK_P3_CAPSENSE_VERSION, 0
.set CYIPBLOCK_P3_COMP_VERSION, 0
.set CYIPBLOCK_P3_DECIMATOR_VERSION, 0
.set CYIPBLOCK_P3_DFB_VERSION, 0
.set CYIPBLOCK_P3_DMA_VERSION, 0
.set CYIPBLOCK_P3_DRQ_VERSION, 0
.set CYIPBLOCK_P3_DSM_VERSION, 0
.set CYIPBLOCK_P3_EMIF_VERSION, 0
.set CYIPBLOCK_P3_I2C_VERSION, 0
.set CYIPBLOCK_P3_LCD_VERSION, 0
.set CYIPBLOCK_P3_LPF_VERSION, 0
.set CYIPBLOCK_P3_OPAMP_VERSION, 0
.set CYIPBLOCK_P3_PM_VERSION, 0
.set CYIPBLOCK_P3_SCCT_VERSION, 0
.set CYIPBLOCK_P3_TIMER_VERSION, 0
.set CYIPBLOCK_P3_USB_VERSION, 0
.set CYIPBLOCK_P3_VIDAC_VERSION, 0
.set CYIPBLOCK_P3_VREF_VERSION, 0
.set CYIPBLOCK_S8_GPIO_VERSION, 0
.set CYIPBLOCK_S8_IRQ_VERSION, 0
.set CYIPBLOCK_S8_SAR_VERSION, 0
.set CYIPBLOCK_S8_SIO_VERSION, 0
.set CYIPBLOCK_S8_UDB_VERSION, 0
.set DMA_CHANNELS_USED__MASK0, 0x00000000
.set CYDEV_BOOTLOADER_ENABLE, 0
.endif
