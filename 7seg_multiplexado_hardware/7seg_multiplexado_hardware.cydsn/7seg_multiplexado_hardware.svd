# CY8C5888LTI_LP097 register map
File version: 0.1
CY8C58LP
Registers are 8-bit, read-write, no defined reset value unless marked. A register's access mark holds for its fields unless they carry their own. Offsets are from the block's base; lines under a group give offsets from that group; [hi:lo] are bit positions; {n}, {i} and the like mark numbered series; 'fields as' and 'values as' point back to an identical list; <NAME> marks a mode.

## Memory map
0x00000000 Control_ceros
0x00000000 num_Centenas_MIllar
0x00000000 num_Unidades_Decenas

## Control_ceros
Base 0x00000000
0x4000657B Control_ceros_CONTROL_REG

## num_Centenas_MIllar
Base 0x00000000
0x40006479 num_Centenas_MIllar_CONTROL_REG

## num_Unidades_Decenas
Base 0x00000000
0x40006579 num_Unidades_Decenas_CONTROL_REG
